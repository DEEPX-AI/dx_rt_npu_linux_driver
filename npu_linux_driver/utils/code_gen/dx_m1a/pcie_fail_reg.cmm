;;;Debug PCIE APB Register
;AREA.CLEAR REPORT
PRINT "----------------------------------------------------------------------------------------------------------"
;=================================================================================================
; Register:acc_pipe02, Member: ['phy_cfg_status', 'data']
;=================================================================================================
&phy_cfg_status = 0xC1000000+0x48
&mask = 0xf
&val  = ((Data.Long(A:&phy_cfg_status)&(&mask))>>0.)
IF &val!=0.
    PRINT "[phy_cfg_status:0x48] V:", &val, " Input bus that can optionally be used to read PHY status. The phy_cfg_status bus maps to the PHY Status register \ phy_cfg_status[0] = pipe_lane0_phystatus \ phy_cfg_status[1] = pipe_lane1_phystatus \ phy_cfg_status[2] = pipe_lane2_phystatus \ phy_cfg_status[3] = pipe_lane3_phystatus"
&data = 0xC1000000+0x48
&mask = 0xfffffff0
&val  = ((Data.Long(A:&data)&(&mask))>>4.)
IF &val!=0.
    PRINT "[data:0x48] V:", &val, " data"

;=================================================================================================
; Register:acc_etc_rw01, Member: ['app_sris_mode', 'app_ltssm_enable', 'app_hold_phy_rst', 'app_clk_req_n', 'app_clk_pm_en', 'app_init_rst', 'app_req_entr_l1', 'app_ready_entr_l23', 'app_req_exit_l1', 'app_xfer_pending', 'app_req_retry_en', 'app_pf_req_retry_en', 'app_drs_ready', 'app_pf_frs_ready', 'exp_rom_validation_status_strobe', 'exp_rom_validation_details_strobe', 'RESERVED_19']
;=================================================================================================
&app_sris_mode = 0xC1000000+0x84
&mask = 0x1
&val  = ((Data.Long(A:&app_sris_mode)&(&mask))>>0.)
IF &val!=0.
    PRINT "[app_sris_mode:0x84] V:", &val, " SRIS operating mode: 0b: non-SRIS mode 1b: SRIS mode"
&app_ltssm_enable = 0xC1000000+0x84
&mask = 0x2
&val  = ((Data.Long(A:&app_ltssm_enable)&(&mask))>>1.)
IF &val!=0.
    PRINT "[app_ltssm_enable:0x84] V:", &val, " Driven low by your application after cold, warm or hot reset to hold the LTSSM in the Detect state until your application is ready for the link training to begin."
&app_hold_phy_rst = 0xC1000000+0x84
&mask = 0x4
&val  = ((Data.Long(A:&app_hold_phy_rst)&(&mask))>>2.)
IF &val!=0.
    PRINT "[app_hold_phy_rst:0x84] V:", &val, " Set this signal to one before the de-assertion of power on reset to hold the PHY in reset."
&app_clk_req_n = 0xC1000000+0x84
&mask = 0x8
&val  = ((Data.Long(A:&app_clk_req_n)&(&mask))>>3.)
IF &val!=0.
    PRINT "[app_clk_req_n:0x84] V:", &val, " Indicates that the application logic is ready to have reference clock removed. In designs which support reference clock removal through either L1 PM Sub-states or L1 CPM, the application should set this signal to 1'b1 if it supports reference clock removal."
&app_clk_pm_en = 0xC1000000+0x84
&mask = 0x10
&val  = ((Data.Long(A:&app_clk_pm_en)&(&mask))>>4.)
IF &val!=0.
    PRINT "[app_clk_pm_en:0x84] V:", &val, " Clock PM feature enabled by application. Used to inhibit the programming of the Clock PM in Link Control Register."
&app_init_rst = 0xC1000000+0x84
&mask = 0x20
&val  = ((Data.Long(A:&app_init_rst)&(&mask))>>5.)
IF &val!=0.
    PRINT "[app_init_rst:0x84] V:", &val, " Request from your application to send a hot reset to the upstream port. The hot reset request is sent when a single cycle pulse is applied to this pin. In an upstream port, you should set this input to '0'."
&app_req_entr_l1 = 0xC1000000+0x84
&mask = 0x40
&val  = ((Data.Long(A:&app_req_entr_l1)&(&mask))>>6.)
IF &val!=0.
    PRINT "[app_req_entr_l1:0x84] V:", &val, " Application request to Enter L1 ASPM state. The app_req_entr_l1 signal is for use by applications that need to control L1 entry instead of using the L1 entry timer as defined in the PCI Express Specification."
&app_ready_entr_l23 = 0xC1000000+0x84
&mask = 0x80
&val  = ((Data.Long(A:&app_ready_entr_l23)&(&mask))>>7.)
IF &val!=0.
    PRINT "[app_ready_entr_l23:0x84] V:", &val, " Application Ready to Enter L23. Indication from your application that it is ready to enter the L23 state."
&app_req_exit_l1 = 0xC1000000+0x84
&mask = 0x100
&val  = ((Data.Long(A:&app_req_exit_l1)&(&mask))>>8.)
IF &val!=0.
    PRINT "[app_req_exit_l1:0x84] V:", &val, " Application request to Exit L1. Request from your application to exit L1. It is only effective when L1 is enabled."
&app_xfer_pending = 0xC1000000+0x84
&mask = 0x200
&val  = ((Data.Long(A:&app_xfer_pending)&(&mask))>>9.)
IF &val!=0.
    PRINT "[app_xfer_pending:0x84] V:", &val, " Indicates that your application has transfers pending and prevents the controller from entering L1"
&app_req_retry_en = 0xC1000000+0x84
&mask = 0x400
&val  = ((Data.Long(A:&app_req_retry_en)&(&mask))>>10.)
IF &val!=0.
    PRINT "[app_req_retry_en:0x84] V:", &val, " Provides a capability to defer incoming configuration requests until initialization is complete. When app_req_retry_en is asserted, the controller completes incoming configuration requests with a configuration request retry status."
&app_pf_req_retry_en = 0xC1000000+0x84
&mask = 0x7800
&val  = ((Data.Long(A:&app_pf_req_retry_en)&(&mask))>>11.)
IF &val!=0.
    PRINT "[app_pf_req_retry_en:0x84] V:", &val, " Provides a per Physical Function (PF) capability to defer incoming configuration requests until initialization is complete. When app_pf_req_retry_en is asserted for a certain PF, the controller completes incoming configuration requests with a configuration request retry status other incoming requests are not affected."
&app_drs_ready = 0xC1000000+0x84
&mask = 0x8000
&val  = ((Data.Long(A:&app_drs_ready)&(&mask))>>15.)
IF &val!=0.
    PRINT "[app_drs_ready:0x84] V:", &val, " Defers DRS messaging when set to '0'."
&app_pf_frs_ready = 0xC1000000+0x84
&mask = 0x10000
&val  = ((Data.Long(A:&app_pf_frs_ready)&(&mask))>>16.)
IF &val!=0.
    PRINT "[app_pf_frs_ready:0x84] V:", &val, " Defers FRS messaging when set to '0'."
&exp_rom_validation_status_strobe = 0xC1000000+0x84
&mask = 0x20000
&val  = ((Data.Long(A:&exp_rom_validation_status_strobe)&(&mask))>>17.)
IF &val!=0.
    PRINT "[exp_rom_validation_status_strobe:0x84] V:", &val, " This strobe sets the Expansion ROM Validation Status field (ROM_BAR_VALIDATION_STATUS) of the Expansion ROM BAR register as specified on the exp_rom_validation_status input signal."
&exp_rom_validation_details_strobe = 0xC1000000+0x84
&mask = 0x40000
&val  = ((Data.Long(A:&exp_rom_validation_details_strobe)&(&mask))>>18.)
IF &val!=0.
    PRINT "[exp_rom_validation_details_strobe:0x84] V:", &val, " This strobe sets the Expansion ROM Validation Details field (ROM_BAR_VALIDATION_DETAILS) of the Expansion ROM BAR register as specified on the exp_rom_validation_details input signal."

;=================================================================================================
; Register:acc_etc_rw06, Member: ['mstr_bmisc_info_tlpln', 'mstr_bmisc_info_cpl_stat', 'mstr_rmisc_info_tlpln', 'mstr_rmisc_info', 'mstr_rmisc_info_cpl_stat', 'mstr_csysreq', 'mstr_csysack', 'mstr_cactive', 'RESERVED_24']
;=================================================================================================
&mstr_bmisc_info_tlpln = 0xC1000000+0x98
&mask = 0x1
&val  = ((Data.Long(A:&mstr_bmisc_info_tlpln)&(&mask))>>0.)
IF &val!=0.
    PRINT "[mstr_bmisc_info_tlpln:0x98] V:", &val, " AXI Master Write Response TLP Lightweight Notification (LN) bit."
&mstr_bmisc_info_cpl_stat = 0xC1000000+0x98
&mask = 0xe
&val  = ((Data.Long(A:&mstr_bmisc_info_cpl_stat)&(&mask))>>1.)
IF &val!=0.
    PRINT "[mstr_bmisc_info_cpl_stat:0x98] V:", &val, " AXI Master Write Response selection bus. This controls the response to be sent on the wire in the case of successful write requests. \ 000: SC (Successful Completion) 001: UR (Unsupported Request) \ 010: RRS (Request Retry Status) 100: CA (Completer Abort) All others: Reserved"
&mstr_rmisc_info_tlpln = 0xC1000000+0x98
&mask = 0x10
&val  = ((Data.Long(A:&mstr_rmisc_info_tlpln)&(&mask))>>4.)
IF &val!=0.
    PRINT "[mstr_rmisc_info_tlpln:0x98] V:", &val, " AXI Master Read Response TLP Lightweight Notification (LN) bit."
&mstr_rmisc_info = 0xC1000000+0x98
&mask = 0x3ffe0
&val  = ((Data.Long(A:&mstr_rmisc_info)&(&mask))>>5.)
IF &val!=0.
    PRINT "[mstr_rmisc_info:0x98] V:", &val, " AXI Master Read Response Transaction Associated Misc Information. \ [1:0]: Reserved [2]: Reserved. [6:3]: Reserved [7]: TLP's EP bit [12:8]: Reserved"
&mstr_rmisc_info_cpl_stat = 0xC1000000+0x98
&mask = 0x1c0000
&val  = ((Data.Long(A:&mstr_rmisc_info_cpl_stat)&(&mask))>>18.)
IF &val!=0.
    PRINT "[mstr_rmisc_info_cpl_stat:0x98] V:", &val, " AXI Master Read Response selection bus. This bus controls the response sent on the PCIe wire in the case of successful read requests. \ 000: SC (Successful Completion) 001: UR (Unsupported Request) \ 010: RRS (Request Retry Status) 100: CA (Completer Abort) All others: Reserved"
&mstr_csysreq = 0xC1000000+0x98
&mask = 0x200000
&val  = ((Data.Long(A:&mstr_csysreq)&(&mask))>>21.)
IF &val!=0.
    PRINT "[mstr_csysreq:0x98] V:", &val, " AXI Master System Low-Power Request. System low-power request from system clock controller for AXI bridge master to enter low-power state."
&mstr_csysack = 0xC1000000+0x98
&mask = 0x400000
&val  = ((Data.Long(A:&mstr_csysack)&(&mask))>>22.)
IF &val!=0.
    PRINT "[mstr_csysack:0x98] V:", &val, " AXI Master Low-Power Request Acknowledgment. Indicates acknowledgment from AXI bridge master to a system low-power request. The controller does not support AXI power modes and always denies any request the mstr_csysreq input."
&mstr_cactive = 0xC1000000+0x98
&mask = 0x800000
&val  = ((Data.Long(A:&mstr_cactive)&(&mask))>>23.)
IF &val!=0.
    PRINT "[mstr_cactive:0x98] V:", &val, " AXI Master Clock Active. Indicates that AXI bridge master requires a clock signal. The controller does not support AXI power modes and always drives this output high."

;=================================================================================================
; Register:acc_etc_rw39, Member: ['rx_lane_flip_en', 'tx_lane_flip_en', 'sys_int', 'apps_pm_xmt_pme', 'RESERVED_4']
;=================================================================================================
&rx_lane_flip_en = 0xC1000000+0x11c
&mask = 0x1
&val  = ((Data.Long(A:&rx_lane_flip_en)&(&mask))>>0.)
IF &val!=0.
    PRINT "[rx_lane_flip_en:0x11c] V:", &val, " Performs manual lane reversal for receive lanes. For use when automatic lane reversal does not occur because lane 0 is not detected."
&tx_lane_flip_en = 0xC1000000+0x11c
&mask = 0x2
&val  = ((Data.Long(A:&tx_lane_flip_en)&(&mask))>>1.)
IF &val!=0.
    PRINT "[tx_lane_flip_en:0x11c] V:", &val, " Performs manual lane reversal for transmit lanes. For use when automatic lane reversal does not occur because lane 0 is not detected."
&sys_int = 0xC1000000+0x11c
&mask = 0x4
&val  = ((Data.Long(A:&sys_int)&(&mask))>>2.)
IF &val!=0.
    PRINT "[sys_int:0x11c] V:", &val, " When sys_int goes from low to high, the controller generates an Assert_INTx Message. When sys_int goes from high to low, the controller generates a Deassert_INTx Message."
&apps_pm_xmt_pme = 0xC1000000+0x11c
&mask = 0x8
&val  = ((Data.Long(A:&apps_pm_xmt_pme)&(&mask))>>3.)
IF &val!=0.
    PRINT "[apps_pm_xmt_pme:0x11c] V:", &val, " Wake Up. If PME is enabled and PME support is configured for current PMCSR D-state asserting this signal causes the controller to wake from either L1 or L2 state."

;=================================================================================================
; Register:acc_etc_ro044, Member: ['pm_xtlh_block_tlp', 'radm_q_not_empty', 'RESERVED_2']
;=================================================================================================
&pm_xtlh_block_tlp = 0xC1000000+0x204
&mask = 0x1
&val  = ((Data.Long(A:&pm_xtlh_block_tlp)&(&mask))>>0.)
IF &val!=0.
    PRINT "[pm_xtlh_block_tlp:0x204] V:", &val, " Indicates that your application must stop generating new outgoing request TLPs due to the current power management state."
&radm_q_not_empty = 0xC1000000+0x204
&mask = 0x2
&val  = ((Data.Long(A:&radm_q_not_empty)&(&mask))>>1.)
IF &val!=0.
    PRINT "[radm_q_not_empty:0x204] V:", &val, " Level indicating that the receive queues contain TLP header/data."

;=================================================================================================
; Register:acc_etc_ro045, Member: ['radm_qoverflow', 'RESERVED_1']
;=================================================================================================
&radm_qoverflow = 0xC1000000+0x208
&mask = 0x1
&val  = ((Data.Long(A:&radm_qoverflow)&(&mask))>>0.)
IF &val!=0.
    PRINT "[radm_qoverflow:0x208] V:", &val, " Pulse indicating that one or more of the P/NP/CPL receive queues have overflowed. There is a 1-bit indication for each configured virtual channel."

;=================================================================================================
; Register:acc_etc_ro132, Member: ['cfg_mem_space_en', 'cfg_max_rd_req_size', 'cfg_reg_serren', 'cfg_cor_err_rpt_en', 'cfg_nf_err_rpt_en', 'cfg_f_err_rpt_en', 'RESERVED_8']
;=================================================================================================
&cfg_mem_space_en = 0xC1000000+0x364
&mask = 0x1
&val  = ((Data.Long(A:&cfg_mem_space_en)&(&mask))>>0.)
IF &val!=0.
    PRINT "[cfg_mem_space_en:0x364] V:", &val, " The state of the Memory Space Enable bit in the PCI-compatible Command register. There is 1 bit of cfg_mem_space_en assigned to each configured function."
&cfg_max_rd_req_size = 0xC1000000+0x364
&mask = 0xe
&val  = ((Data.Long(A:&cfg_max_rd_req_size)&(&mask))>>1.)
IF &val!=0.
    PRINT "[cfg_max_rd_req_size:0x364] V:", &val, " The value of the Max_Read_Request_Size field in the Device Control register. There are 3 bits of cfg_max_rd_req_size assigned to each configured function."
&cfg_reg_serren = 0xC1000000+0x364
&mask = 0x10
&val  = ((Data.Long(A:&cfg_reg_serren)&(&mask))>>4.)
IF &val!=0.
    PRINT "[cfg_reg_serren:0x364] V:", &val, " PF's SERR# Enable registers value in Command Register of Type0 Header, for setting error status registers of external VFs."
&cfg_cor_err_rpt_en = 0xC1000000+0x364
&mask = 0x20
&val  = ((Data.Long(A:&cfg_cor_err_rpt_en)&(&mask))>>5.)
IF &val!=0.
    PRINT "[cfg_cor_err_rpt_en:0x364] V:", &val, " PF's Correctable Error Reporting Enable registers value in Device Control Register of PCIe Capability, for sending ERR_MSG of external VFs."
&cfg_nf_err_rpt_en = 0xC1000000+0x364
&mask = 0x40
&val  = ((Data.Long(A:&cfg_nf_err_rpt_en)&(&mask))>>6.)
IF &val!=0.
    PRINT "[cfg_nf_err_rpt_en:0x364] V:", &val, " PF's Non-Fatal Error Reporting Enable registers value in Device Control Register of PCIe Capability, for sending ERR_MSG of external VFs."
&cfg_f_err_rpt_en = 0xC1000000+0x364
&mask = 0x80
&val  = ((Data.Long(A:&cfg_f_err_rpt_en)&(&mask))>>7.)
IF &val!=0.
    PRINT "[cfg_f_err_rpt_en:0x364] V:", &val, " PF's Fatal Error Reporting Enable registers value in Device Control Register of PCIe Capability, for sending ERR_MSG of external VFs."

;=================================================================================================
; Register:acc_etc_ro133, Member: ['rdlh_link_up', 'smlh_ltssm_state', 'pm_curnt_state', 'smlh_ltssm_state_rcvry_eq', 'smlh_link_up', 'smlh_req_rst_not', 'link_req_rst_not', 'brdg_slv_xfer_pending', 'brdg_dbi_xfer_pending', 'edma_xfer_pending', 'radm_xfer_pending', 'RESERVED_18']
;=================================================================================================
&rdlh_link_up = 0xC1000000+0x368
&mask = 0x1
&val  = ((Data.Long(A:&rdlh_link_up)&(&mask))>>0.)
IF &val!=0.
    PRINT "[rdlh_link_up:0x368] V:", &val, " Data link layer up/down indicator: This status from the flow control initialization state machine indicates that flow control has been initiated and the Data link layer is ready to transmit and receive packets. For multi-VC designs, this signal indicates status for VC0 only. - 1: Link is up - 0: Link is down"
&smlh_ltssm_state = 0xC1000000+0x368
&mask = 0x7e
&val  = ((Data.Long(A:&smlh_ltssm_state)&(&mask))>>1.)
IF &val!=0.
    PRINT "[smlh_ltssm_state:0x368] V:", &val, " Current state of the LTSSM."
&pm_curnt_state = 0xC1000000+0x368
&mask = 0x380
&val  = ((Data.Long(A:&pm_curnt_state)&(&mask))>>7.)
IF &val!=0.
    PRINT "[pm_curnt_state:0x368] V:", &val, " Indicates the current power state. The pm_curnt_state output is intended for debugging purposes, not for system operation."
&smlh_ltssm_state_rcvry_eq = 0xC1000000+0x368
&mask = 0x400
&val  = ((Data.Long(A:&smlh_ltssm_state_rcvry_eq)&(&mask))>>10.)
IF &val!=0.
    PRINT "[smlh_ltssm_state_rcvry_eq:0x368] V:", &val, " This status signal is asserted during all Recovery Equalization states."
&smlh_link_up = 0xC1000000+0x368
&mask = 0x800
&val  = ((Data.Long(A:&smlh_link_up)&(&mask))>>11.)
IF &val!=0.
    PRINT "[smlh_link_up:0x368] V:", &val, " PHY Link up/down indicator: - 1: Link is up - 0: Link is down"
&smlh_req_rst_not = 0xC1000000+0x368
&mask = 0x1000
&val  = ((Data.Long(A:&smlh_req_rst_not)&(&mask))>>12.)
IF &val!=0.
    PRINT "[smlh_req_rst_not:0x368] V:", &val, " Early version of the link_req_rst_not signal."
&link_req_rst_not = 0xC1000000+0x368
&mask = 0x2000
&val  = ((Data.Long(A:&link_req_rst_not)&(&mask))>>13.)
IF &val!=0.
    PRINT "[link_req_rst_not:0x368] V:", &val, " Reset request because the link has gone down or the controller received a hot-reset request. A low level indicates that the controller is requesting external logic to reset the controller because the PHY link is down."
&brdg_slv_xfer_pending = 0xC1000000+0x368
&mask = 0x4000
&val  = ((Data.Long(A:&brdg_slv_xfer_pending)&(&mask))>>14.)
IF &val!=0.
    PRINT "[brdg_slv_xfer_pending:0x368] V:", &val, " AXI Slave non-DBI transfer pending status. Indicates AXI non-DBI Slave Read or Write transfers are pending, that is, AXI Slave transfers are awaiting a response from the controller."
&brdg_dbi_xfer_pending = 0xC1000000+0x368
&mask = 0x8000
&val  = ((Data.Long(A:&brdg_dbi_xfer_pending)&(&mask))>>15.)
IF &val!=0.
    PRINT "[brdg_dbi_xfer_pending:0x368] V:", &val, " AXI Slave DBI transfer pending status. Indicates AXI DBI Slave Read or Write transfers are pending, that is, AXI Slave transfers are awaiting a response from the controller."
&edma_xfer_pending = 0xC1000000+0x368
&mask = 0x10000
&val  = ((Data.Long(A:&edma_xfer_pending)&(&mask))>>16.)
IF &val!=0.
    PRINT "[edma_xfer_pending:0x368] V:", &val, " eDMA transfer pending status. Indicates eDMA Write or Read Channel transfers are pending, that is, DMA Write or Read Channels have not finished transferring data."
&radm_xfer_pending = 0xC1000000+0x368
&mask = 0x20000
&val  = ((Data.Long(A:&radm_xfer_pending)&(&mask))>>17.)
IF &val!=0.
    PRINT "[radm_xfer_pending:0x368] V:", &val, " Receive request pending status. Indicates Receive TLP requests are pending, that is, requests sent to the RTRGT1 or RTRGT0 interfaces are awaiting a response from your application."

;=================================================================================================
; Register:acc_etc_ro134, Member: ['cxpl_debug_info0']
;=================================================================================================
&cxpl_debug_info0 = 0xC1000000+0x36c
&mask = 0x3f
&val  = ((Data.Long(A:&cxpl_debug_info0)&(&mask))>>0.)
IF &val!=0.
    PRINT "[cxpl_debug_info0:0x36c] V:", &val, " : smlh_ltssm_state: LTSSM current state. Encoding is same as the dedicated smlh_ltssm_state output."
&mask = 0xc0
&val  = ((Data.Long(A:&cxpl_debug_info0)&(&mask))>>6.)
IF &val!=0.
    PRINT "[cxpl_debug_info0:0x36c] V:", &val, " : mac_phy_txdatak: PIPE transmit K indication"
&mask = 0xffff00
&val  = ((Data.Long(A:&cxpl_debug_info0)&(&mask))>>8.)
IF &val!=0.
    PRINT "[cxpl_debug_info0:0x36c] V:", &val, " : mac_phy_txdata: PIPE Transmit data"
&mask = 0x1000000
&val  = ((Data.Long(A:&cxpl_debug_info0)&(&mask))>>24.)
IF &val!=0.
    PRINT "[cxpl_debug_info0:0x36c] V:", &val, " : rplh_rcvd_idle[1]: 2n symbol is also idle (16bit PHY interface only)"
&mask = 0x2000000
&val  = ((Data.Long(A:&cxpl_debug_info0)&(&mask))>>25.)
IF &val!=0.
    PRINT "[cxpl_debug_info0:0x36c] V:", &val, " : rplh_rcvd_idle[0]: Receiver is receiving logical idle"
&mask = 0x4000000
&val  = ((Data.Long(A:&cxpl_debug_info0)&(&mask))>>26.)
IF &val!=0.
    PRINT "[cxpl_debug_info0:0x36c] V:", &val, " : smlh_ts_link_num_is_k237: Currently receiving k237 (PAD) in place of link number"
&mask = 0x8000000
&val  = ((Data.Long(A:&cxpl_debug_info0)&(&mask))>>27.)
IF &val!=0.
    PRINT "[cxpl_debug_info0:0x36c] V:", &val, " : smlh_ts_lane_num_is_k237: Currently receiving k237 (PAD) in place of lane number"
&mask = 0xf0000000
&val  = ((Data.Long(A:&cxpl_debug_info0)&(&mask))>>28.)
IF &val!=0.
    PRINT "[cxpl_debug_info0:0x36c] V:", &val, " : smlh_ts_link_ctrl: Link control bits advertised by link partner"

;=================================================================================================
; Register:acc_etc_ro135, Member: ['cxpl_debug_info1']
;=================================================================================================
&cxpl_debug_info1 = 0xC1000000+0x370
&mask = 0x1
&val  = ((Data.Long(A:&cxpl_debug_info1)&(&mask))>>0.)
IF &val!=0.
    PRINT "[cxpl_debug_info1:0x370] V:", &val, " : smlh_rcvd_lane_rev: Receiver detected lane reversal"
&mask = 0x2
&val  = ((Data.Long(A:&cxpl_debug_info1)&(&mask))>>1.)
IF &val!=0.
    PRINT "[cxpl_debug_info1:0x370] V:", &val, " : smlh_ts2_rcvd: TS2 training sequence received (pulse)"
&mask = 0x4
&val  = ((Data.Long(A:&cxpl_debug_info1)&(&mask))>>2.)
IF &val!=0.
    PRINT "[cxpl_debug_info1:0x370] V:", &val, " : smlh_ts1_rcvd: TS1 training sequence received (pulse)"
&mask = 0x8
&val  = ((Data.Long(A:&cxpl_debug_info1)&(&mask))>>3.)
IF &val!=0.
    PRINT "[cxpl_debug_info1:0x370] V:", &val, " : smlh_inskip_rcv: Receiver reports skip reception"
&mask = 0x10
&val  = ((Data.Long(A:&cxpl_debug_info1)&(&mask))>>4.)
IF &val!=0.
    PRINT "[cxpl_debug_info1:0x370] V:", &val, " : smlh_link_up: LTSSM reports PHY link up or LTSSM is in Loopback.Active for Loopback Master"
&mask = 0x20
&val  = ((Data.Long(A:&cxpl_debug_info1)&(&mask))>>5.)
IF &val!=0.
    PRINT "[cxpl_debug_info1:0x370] V:", &val, " : xmtbyte_skip_sent: A skip ordered set has been transmitted"
&mask = 0xc0
&val  = ((Data.Long(A:&cxpl_debug_info1)&(&mask))>>6.)
IF &val!=0.
    PRINT "[cxpl_debug_info1:0x370] V:", &val, " : 00b: Reserved"
&mask = 0xff00
&val  = ((Data.Long(A:&cxpl_debug_info1)&(&mask))>>8.)
IF &val!=0.
    PRINT "[cxpl_debug_info1:0x370] V:", &val, " : rmlh_ts_link_num: Link number advertised/confirmed by link partner"
&mask = 0x70000
&val  = ((Data.Long(A:&cxpl_debug_info1)&(&mask))>>16.)
IF &val!=0.
    PRINT "[cxpl_debug_info1:0x370] V:", &val, " : 000b: Reserved"
&mask = 0x80000
&val  = ((Data.Long(A:&cxpl_debug_info1)&(&mask))>>19.)
IF &val!=0.
    PRINT "[cxpl_debug_info1:0x370] V:", &val, " : app_init_rst: Application request to initiate training reset"
&mask = 0x100000
&val  = ((Data.Long(A:&cxpl_debug_info1)&(&mask))>>20.)
IF &val!=0.
    PRINT "[cxpl_debug_info1:0x370] V:", &val, " : mac_phy_txcompliance[0]: PIPE transmit compliance request"
&mask = 0x200000
&val  = ((Data.Long(A:&cxpl_debug_info1)&(&mask))>>21.)
IF &val!=0.
    PRINT "[cxpl_debug_info1:0x370] V:", &val, " : mac_phy_txelecidle[0]: PIPE transmit electrical idle request"
&mask = 0x400000
&val  = ((Data.Long(A:&cxpl_debug_info1)&(&mask))>>22.)
IF &val!=0.
    PRINT "[cxpl_debug_info1:0x370] V:", &val, " : mac_phy_txdetectrx_loopback: PIPE receiver detect/loopback request"
&mask = 0x7800000
&val  = ((Data.Long(A:&cxpl_debug_info1)&(&mask))>>23.)
IF &val!=0.
    PRINT "[cxpl_debug_info1:0x370] V:", &val, " : 0000b: Reserved"
&mask = 0x8000000
&val  = ((Data.Long(A:&cxpl_debug_info1)&(&mask))>>27.)
IF &val!=0.
    PRINT "[cxpl_debug_info1:0x370] V:", &val, " : smlh_training_rst_n: LTSSM-negotiated link reset"
&mask = 0x10000000
&val  = ((Data.Long(A:&cxpl_debug_info1)&(&mask))>>28.)
IF &val!=0.
    PRINT "[cxpl_debug_info1:0x370] V:", &val, " : smlh_ltssm_in_pollconfig: LTSSM is in Polling.Configuration state"
&mask = 0x20000000
&val  = ((Data.Long(A:&cxpl_debug_info1)&(&mask))>>29.)
IF &val!=0.
    PRINT "[cxpl_debug_info1:0x370] V:", &val, " : smlh_link_in_training: LTSSM performing link training"
&mask = 0x40000000
&val  = ((Data.Long(A:&cxpl_debug_info1)&(&mask))>>30.)
IF &val!=0.
    PRINT "[cxpl_debug_info1:0x370] V:", &val, " : smlh_link_disable: TSSM in DISABLE state. Link inoperable"
&mask = 0x80000000
&val  = ((Data.Long(A:&cxpl_debug_info1)&(&mask))>>31.)
IF &val!=0.
    PRINT "[cxpl_debug_info1:0x370] V:", &val, " : smlh_scrambler_disable: Scrambling disabled for the link"

;=================================================================================================
; Register:acc_etc_ro136, Member: ['cxpl_debug_info_ei', 'training_rst_n', 'radm_pm_turnoff', 'radm_msg_unlock', 'RESERVED_19']
;=================================================================================================
&cxpl_debug_info_ei = 0xC1000000+0x374
&mask = 0x1
&val  = ((Data.Long(A:&cxpl_debug_info_ei)&(&mask))>>0.)
IF &val!=0.
    PRINT "[cxpl_debug_info_ei:0x374] V:", &val, " : EIOS detected Group 2 (level) - LTSSM is in one of the states that depend rxelecidle =0:"
&mask = 0x2
&val  = ((Data.Long(A:&cxpl_debug_info_ei)&(&mask))>>1.)
IF &val!=0.
    PRINT "[cxpl_debug_info_ei:0x374] V:", &val, " : L1"
&mask = 0x4
&val  = ((Data.Long(A:&cxpl_debug_info_ei)&(&mask))>>2.)
IF &val!=0.
    PRINT "[cxpl_debug_info_ei:0x374] V:", &val, " : L2"
&mask = 0x8
&val  = ((Data.Long(A:&cxpl_debug_info_ei)&(&mask))>>3.)
IF &val!=0.
    PRINT "[cxpl_debug_info_ei:0x374] V:", &val, " : RxL0s"
&mask = 0x10
&val  = ((Data.Long(A:&cxpl_debug_info_ei)&(&mask))>>4.)
IF &val!=0.
    PRINT "[cxpl_debug_info_ei:0x374] V:", &val, " : Disabled"
&mask = 0x20
&val  = ((Data.Long(A:&cxpl_debug_info_ei)&(&mask))>>5.)
IF &val!=0.
    PRINT "[cxpl_debug_info_ei:0x374] V:", &val, " : Detect.Quiet"
&mask = 0x40
&val  = ((Data.Long(A:&cxpl_debug_info_ei)&(&mask))>>6.)
IF &val!=0.
    PRINT "[cxpl_debug_info_ei:0x374] V:", &val, " : Polling.Active"
&mask = 0x80
&val  = ((Data.Long(A:&cxpl_debug_info_ei)&(&mask))>>7.)
IF &val!=0.
    PRINT "[cxpl_debug_info_ei:0x374] V:", &val, " : Polling.Compliance Group 3 (level) - LTSSM is in one of the states that depend rxelecidle =1:"
&mask = 0x100
&val  = ((Data.Long(A:&cxpl_debug_info_ei)&(&mask))>>8.)
IF &val!=0.
    PRINT "[cxpl_debug_info_ei:0x374] V:", &val, " : LTSSM is in a transitory state prior to L1 or L2"
&mask = 0x200
&val  = ((Data.Long(A:&cxpl_debug_info_ei)&(&mask))>>9.)
IF &val!=0.
    PRINT "[cxpl_debug_info_ei:0x374] V:", &val, " : LTSSM is in a transitory state prior to Disabled"
&mask = 0x400
&val  = ((Data.Long(A:&cxpl_debug_info_ei)&(&mask))>>10.)
IF &val!=0.
    PRINT "[cxpl_debug_info_ei:0x374] V:", &val, " : LTSSM is in Loopback.Active as a Slave at Gen1"
&mask = 0x800
&val  = ((Data.Long(A:&cxpl_debug_info_ei)&(&mask))>>11.)
IF &val!=0.
    PRINT "[cxpl_debug_info_ei:0x374] V:", &val, " : LTSSM is in Polling.Active Group 4 (pulse) - LTSSM state transitions with EI inferred:"
&mask = 0x1000
&val  = ((Data.Long(A:&cxpl_debug_info_ei)&(&mask))>>12.)
IF &val!=0.
    PRINT "[cxpl_debug_info_ei:0x374] V:", &val, " : LTSSM enters Recovery from L0 with EI inferred, first row in base spec Table 4-11"
&mask = 0x2000
&val  = ((Data.Long(A:&cxpl_debug_info_ei)&(&mask))>>13.)
IF &val!=0.
    PRINT "[cxpl_debug_info_ei:0x374] V:", &val, " : LTSSM enters Recovery.Speed from Recovery.RcvrCfg with EI inferred, second row in Table 4-11 of PCI Express  Specification"
&mask = 0x4000
&val  = ((Data.Long(A:&cxpl_debug_info_ei)&(&mask))>>14.)
IF &val!=0.
    PRINT "[cxpl_debug_info_ei:0x374] V:", &val, " : EI inferred while LTSSM in Recovery.Speed, third/fourth rows in base spec Table 4-11"
&mask = 0x8000
&val  = ((Data.Long(A:&cxpl_debug_info_ei)&(&mask))>>15.)
IF &val!=0.
    PRINT "[cxpl_debug_info_ei:0x374] V:", &val, " : EI inferred while LTSSM"
&training_rst_n = 0xC1000000+0x374
&mask = 0x10000
&val  = ((Data.Long(A:&training_rst_n)&(&mask))>>16.)
IF &val!=0.
    PRINT "[training_rst_n:0x374] V:", &val, " Hot reset from upstream component. When the controller LTSSM receives two consecutive TS1 ordered sets with the hot_reset bit asserted, it asserts training_rst_n for one clock cycle."
&radm_pm_turnoff = 0xC1000000+0x374
&mask = 0x20000
&val  = ((Data.Long(A:&radm_pm_turnoff)&(&mask))>>17.)
IF &val!=0.
    PRINT "[radm_pm_turnoff:0x374] V:", &val, " One-clock-cycle pulse that indicates that the controller received a PME Turnoff message. When FX_TLP > 1 and when two messages of the same type are received in the same clock cycle (back-to-back), then no indication is given for the second message."
&radm_msg_unlock = 0xC1000000+0x374
&mask = 0x40000
&val  = ((Data.Long(A:&radm_msg_unlock)&(&mask))>>18.)
IF &val!=0.
    PRINT "[radm_msg_unlock:0x374] V:", &val, " One-cycle pulse that indicates that the controller received an Unlock message. When FX_TLP > 1 and when two messages of the same type are received in the same clock cycle (back-to-back), then no separate indication is given for the second message."

;=================================================================================================
; Register:acc_etc_ro137, Member: ['pm_dstate', 'aux_pm_en', 'pm_pme_en', 'pm_linkst_in_l0s', 'pm_linkst_in_l1', 'pm_l1_entry_started', 'pm_linkst_in_l2', 'pm_linkst_l2_exit', 'pm_linkst_in_l1sub', 'cfg_l1sub_en', 'pm_status', 'RESERVED_13']
;=================================================================================================
&pm_dstate = 0xC1000000+0x378
&mask = 0x7
&val  = ((Data.Long(A:&pm_dstate)&(&mask))>>0.)
IF &val!=0.
    PRINT "[pm_dstate:0x378] V:", &val, " The current power management D-state of the function:  \ 000b: D0, 001b: D1, 010b: D2,  \ 011b: D3, 100b: Uninitialized, Other values: Not applicable"
&aux_pm_en = 0xC1000000+0x378
&mask = 0x8
&val  = ((Data.Long(A:&aux_pm_en)&(&mask))>>3.)
IF &val!=0.
    PRINT "[aux_pm_en:0x378] V:", &val, " Auxiliary Power Enable bit in the Device Control register. There is 1 bit of aux_pm_en for each configured function."
&pm_pme_en = 0xC1000000+0x378
&mask = 0x10
&val  = ((Data.Long(A:&pm_pme_en)&(&mask))>>4.)
IF &val!=0.
    PRINT "[pm_pme_en:0x378] V:", &val, " PME Enable bit in the PMCSR. There is 1 bit of pm_pme_en for each configured function."
&pm_linkst_in_l0s = 0xC1000000+0x378
&mask = 0x20
&val  = ((Data.Long(A:&pm_linkst_in_l0s)&(&mask))>>5.)
IF &val!=0.
    PRINT "[pm_linkst_in_l0s:0x378] V:", &val, " Power management is in L0s state."
&pm_linkst_in_l1 = 0xC1000000+0x378
&mask = 0x40
&val  = ((Data.Long(A:&pm_linkst_in_l1)&(&mask))>>6.)
IF &val!=0.
    PRINT "[pm_linkst_in_l1:0x378] V:", &val, " Power management is in L1 state."
&pm_l1_entry_started = 0xC1000000+0x378
&mask = 0x80
&val  = ((Data.Long(A:&pm_l1_entry_started)&(&mask))>>7.)
IF &val!=0.
    PRINT "[pm_l1_entry_started:0x378] V:", &val, " L1 entry process is in progress."
&pm_linkst_in_l2 = 0xC1000000+0x378
&mask = 0x100
&val  = ((Data.Long(A:&pm_linkst_in_l2)&(&mask))>>8.)
IF &val!=0.
    PRINT "[pm_linkst_in_l2:0x378] V:", &val, " Power management is in L2 state"
&pm_linkst_l2_exit = 0xC1000000+0x378
&mask = 0x200
&val  = ((Data.Long(A:&pm_linkst_l2_exit)&(&mask))>>9.)
IF &val!=0.
    PRINT "[pm_linkst_l2_exit:0x378] V:", &val, " Power management is exiting L2 state. Not applicable for downstream port."
&pm_linkst_in_l1sub = 0xC1000000+0x378
&mask = 0x400
&val  = ((Data.Long(A:&pm_linkst_in_l1sub)&(&mask))>>10.)
IF &val!=0.
    PRINT "[pm_linkst_in_l1sub:0x378] V:", &val, " Power management is in L1 substate. Indicates when the link has entered L1 substates. It is used in DWC_pcie_clkrst.v (see 'Clock Generation and Gating Design Example') to ensure that the switching back of aux_clk from AUXCLK to PCLK occurs only after L1 substates have been exited."
&cfg_l1sub_en = 0xC1000000+0x378
&mask = 0x800
&val  = ((Data.Long(A:&cfg_l1sub_en)&(&mask))>>11.)
IF &val!=0.
    PRINT "[cfg_l1sub_en:0x378] V:", &val, " Indicates that any of the L1 Substates are enabled in the L1 Substates Control 1 Register. Could be used by your application in a downstream port to determine when not to drive CLKREQ# such as when L1 Substates are not enabled."
&pm_status = 0xC1000000+0x378
&mask = 0x1000
&val  = ((Data.Long(A:&pm_status)&(&mask))>>12.)
IF &val!=0.
    PRINT "[pm_status:0x378] V:", &val, " PME Status bit from the PMCSR. There is 1 bit of pm_status for each configured function."

;=================================================================================================
; Register:acc_etc_ro145, Member: ['trgt_lookup_id', 'trgt_lookup_empty', 'radm_cpl_timeout', 'radm_timeout_func_num', 'RESERVED_11']
;=================================================================================================
&trgt_lookup_id = 0xC1000000+0x390
&mask = 0xff
&val  = ((Data.Long(A:&trgt_lookup_id)&(&mask))>>0.)
IF &val!=0.
    PRINT "[trgt_lookup_id:0x390] V:", &val, " The target completion LUT lookup ID for the incoming request TLP. When using the optional target completion lookup table feature, the application must save the lookup ID and assert the same lookup ID client0/1/2_cpl_lookup_id when generating a completion for the request."
&trgt_lookup_empty = 0xC1000000+0x390
&mask = 0x100
&val  = ((Data.Long(A:&trgt_lookup_empty)&(&mask))>>8.)
IF &val!=0.
    PRINT "[trgt_lookup_empty:0x390] V:", &val, " When this signal is asserted with radm_trgt1_hv, it indicates that the target completion LUT is not full."
&radm_cpl_timeout = 0xC1000000+0x390
&mask = 0x200
&val  = ((Data.Long(A:&radm_cpl_timeout)&(&mask))>>9.)
IF &val!=0.
    PRINT "[radm_cpl_timeout:0x390] V:", &val, " Indicates that the completion TLP for a request has not been received within the expected time window."
&radm_timeout_func_num = 0xC1000000+0x390
&mask = 0x400
&val  = ((Data.Long(A:&radm_timeout_func_num)&(&mask))>>10.)
IF &val!=0.
    PRINT "[radm_timeout_func_num:0x390] V:", &val, " The function Number of the timed out completion. Function numbering starts at '0'."

;=================================================================================================
; Register:acc_etc_ro148, Member: ['radm_timeout_cpl_tc', 'radm_timeout_cpl_attr', 'radm_timeout_cpl_ln', 'radm_timeout_cpl_len', 'radm_timeout_cpl_tag', 'RESERVED_26']
;=================================================================================================
&radm_timeout_cpl_tc = 0xC1000000+0x3a4
&mask = 0x7
&val  = ((Data.Long(A:&radm_timeout_cpl_tc)&(&mask))>>0.)
IF &val!=0.
    PRINT "[radm_timeout_cpl_tc:0x3a4] V:", &val, " The Traffic Class of the timed out completion."
&radm_timeout_cpl_attr = 0xC1000000+0x3a4
&mask = 0x18
&val  = ((Data.Long(A:&radm_timeout_cpl_attr)&(&mask))>>3.)
IF &val!=0.
    PRINT "[radm_timeout_cpl_attr:0x3a4] V:", &val, " The Attributes field of the timed out completion."
&radm_timeout_cpl_ln = 0xC1000000+0x3a4
&mask = 0x20
&val  = ((Data.Long(A:&radm_timeout_cpl_ln)&(&mask))>>5.)
IF &val!=0.
    PRINT "[radm_timeout_cpl_ln:0x3a4] V:", &val, " The Lightweight Notification (LN) field of the timed out completion."
&radm_timeout_cpl_len = 0xC1000000+0x3a4
&mask = 0x3ffc0
&val  = ((Data.Long(A:&radm_timeout_cpl_len)&(&mask))>>6.)
IF &val!=0.
    PRINT "[radm_timeout_cpl_len:0x3a4] V:", &val, " Length (in bytes) of the timed out completion. For a split completion, it indicates the number of bytes remaining to be delivered when the completion timed out."
&radm_timeout_cpl_tag = 0xC1000000+0x3a4
&mask = 0x3fc0000
&val  = ((Data.Long(A:&radm_timeout_cpl_tag)&(&mask))>>18.)
IF &val!=0.
    PRINT "[radm_timeout_cpl_tag:0x3a4] V:", &val, " The Tag field of the timed out completion."

;=================================================================================================
; Register:acc_etc_ro154, Member: ['cfg_uncor_internal_err_sts', 'cfg_rcvr_overflow_err_sts', 'cfg_fc_protocol_err_sts', 'cfg_mlf_tlp_err_sts', 'cfg_surprise_down_er_sts', 'cfg_dl_protocol_err_sts', 'cfg_ecrc_err_sts', 'cfg_corrected_internal_err_sts', 'cfg_replay_number_rollover_err_sts', 'cfg_replay_timer_timeout_err_sts', 'cfg_bad_dllp_err_sts', 'cfg_bad_tlp_err_sts', 'cfg_rcvr_err_sts', 'radm_trgt1_atu_sloc_match', 'radm_trgt1_atu_cbuf_err', 'pm_aspm_l1_enter_ready', 'radm_slot_pwr_limit', 'RESERVED_31']
;=================================================================================================
&cfg_uncor_internal_err_sts = 0xC1000000+0x3bc
&mask = 0x1
&val  = ((Data.Long(A:&cfg_uncor_internal_err_sts)&(&mask))>>0.)
IF &val!=0.
    PRINT "[cfg_uncor_internal_err_sts:0x3bc] V:", &val, " Indication from the controller that the controller has detected an Uncorrectable Internal Error."
&cfg_rcvr_overflow_err_sts = 0xC1000000+0x3bc
&mask = 0x2
&val  = ((Data.Long(A:&cfg_rcvr_overflow_err_sts)&(&mask))>>1.)
IF &val!=0.
    PRINT "[cfg_rcvr_overflow_err_sts:0x3bc] V:", &val, " Indication from the controller that the controller has detected an Receiver Overflow Error."
&cfg_fc_protocol_err_sts = 0xC1000000+0x3bc
&mask = 0x4
&val  = ((Data.Long(A:&cfg_fc_protocol_err_sts)&(&mask))>>2.)
IF &val!=0.
    PRINT "[cfg_fc_protocol_err_sts:0x3bc] V:", &val, " Indication from the controller that the controller has detected an Flow Control Protocol Error."
&cfg_mlf_tlp_err_sts = 0xC1000000+0x3bc
&mask = 0x8
&val  = ((Data.Long(A:&cfg_mlf_tlp_err_sts)&(&mask))>>3.)
IF &val!=0.
    PRINT "[cfg_mlf_tlp_err_sts:0x3bc] V:", &val, " Indication from the controller that the controller detected an Malformed TLP Error."
&cfg_surprise_down_er_sts = 0xC1000000+0x3bc
&mask = 0x10
&val  = ((Data.Long(A:&cfg_surprise_down_er_sts)&(&mask))>>4.)
IF &val!=0.
    PRINT "[cfg_surprise_down_er_sts:0x3bc] V:", &val, " Indication from the controller that the controller detected an Surprise Down Error."
&cfg_dl_protocol_err_sts = 0xC1000000+0x3bc
&mask = 0x20
&val  = ((Data.Long(A:&cfg_dl_protocol_err_sts)&(&mask))>>5.)
IF &val!=0.
    PRINT "[cfg_dl_protocol_err_sts:0x3bc] V:", &val, " Indication from the controller that the controller detected an Data Link Protocol Error."
&cfg_ecrc_err_sts = 0xC1000000+0x3bc
&mask = 0x40
&val  = ((Data.Long(A:&cfg_ecrc_err_sts)&(&mask))>>6.)
IF &val!=0.
    PRINT "[cfg_ecrc_err_sts:0x3bc] V:", &val, " Indication from the controller that the controller detected an ECRC Error."
&cfg_corrected_internal_err_sts = 0xC1000000+0x3bc
&mask = 0x80
&val  = ((Data.Long(A:&cfg_corrected_internal_err_sts)&(&mask))>>7.)
IF &val!=0.
    PRINT "[cfg_corrected_internal_err_sts:0x3bc] V:", &val, " Indication from the controller that the controller detected an Corrected Internal Error."
&cfg_replay_number_rollover_err_sts = 0xC1000000+0x3bc
&mask = 0x100
&val  = ((Data.Long(A:&cfg_replay_number_rollover_err_sts)&(&mask))>>8.)
IF &val!=0.
    PRINT "[cfg_replay_number_rollover_err_sts:0x3bc] V:", &val, " Indication from the controller that the controller detected an REPLAY_NUMBER Rollover Error."
&cfg_replay_timer_timeout_err_sts = 0xC1000000+0x3bc
&mask = 0x200
&val  = ((Data.Long(A:&cfg_replay_timer_timeout_err_sts)&(&mask))>>9.)
IF &val!=0.
    PRINT "[cfg_replay_timer_timeout_err_sts:0x3bc] V:", &val, " Indication from the controller that the controller detected an Replay Timer Timeout."
&cfg_bad_dllp_err_sts = 0xC1000000+0x3bc
&mask = 0x400
&val  = ((Data.Long(A:&cfg_bad_dllp_err_sts)&(&mask))>>10.)
IF &val!=0.
    PRINT "[cfg_bad_dllp_err_sts:0x3bc] V:", &val, " Indication from the controller that the controller detected an Bad DLLP Error."
&cfg_bad_tlp_err_sts = 0xC1000000+0x3bc
&mask = 0x800
&val  = ((Data.Long(A:&cfg_bad_tlp_err_sts)&(&mask))>>11.)
IF &val!=0.
    PRINT "[cfg_bad_tlp_err_sts:0x3bc] V:", &val, " Indication from the controller that the controller detected an Bad TLP Error."
&cfg_rcvr_err_sts = 0xC1000000+0x3bc
&mask = 0x1000
&val  = ((Data.Long(A:&cfg_rcvr_err_sts)&(&mask))>>12.)
IF &val!=0.
    PRINT "[cfg_rcvr_err_sts:0x3bc] V:", &val, " Indication from the controller that the controller detected an Receiver Error."
&radm_trgt1_atu_sloc_match = 0xC1000000+0x3bc
&mask = 0x1fe000
&val  = ((Data.Long(A:&radm_trgt1_atu_sloc_match)&(&mask))>>13.)
IF &val!=0.
    PRINT "[radm_trgt1_atu_sloc_match:0x3bc] V:", &val, " ATU Single Location match indication per ATU region. Set for 1 core_clk period pulse when the ATU region matched a received VDM Single Location Address translation."
&radm_trgt1_atu_cbuf_err = 0xC1000000+0x3bc
&mask = 0x1fe00000
&val  = ((Data.Long(A:&radm_trgt1_atu_cbuf_err)&(&mask))>>21.)
IF &val!=0.
    PRINT "[radm_trgt1_atu_cbuf_err:0x3bc] V:", &val, " ATU Error indication per ATU region. Set for 1 core_clk period pulse when the ATU region matched received VDM size (payload + 3rd and 4th DW of Header) is greater than the programmed Circular Buffer Increment size (CBUF_INCR) for Single Location Address translation."
&pm_aspm_l1_enter_ready = 0xC1000000+0x3bc
&mask = 0x20000000
&val  = ((Data.Long(A:&pm_aspm_l1_enter_ready)&(&mask))>>29.)
IF &val!=0.
    PRINT "[pm_aspm_l1_enter_ready:0x3bc] V:", &val, " Indicates the controller is idle in L0 or L0s, and it is ready to enter L1 as soon as application releases app_xfer_pending AND the L1 ASPM timer expires."
&radm_slot_pwr_limit = 0xC1000000+0x3bc
&mask = 0x40000000
&val  = ((Data.Long(A:&radm_slot_pwr_limit)&(&mask))>>30.)
IF &val!=0.
    PRINT "[radm_slot_pwr_limit:0x3bc] V:", &val, " One-Clock-Cycle pulse that indicates the controller received a Set_Slot_Power_Limit message."

;=================================================================================================
; Register:acc_etc_ro158, Member: ['app_parity_errs', 'axi_parity_errs', 'cfg_ext_tag_en', 'slv_rasdp_err_mode', 'mstr_rasdp_err_mode', 'cfg_neg_link_width', 'cfg_advisory_nf_sts', 'cfg_hdr_log_overflow_sts', 'RESERVED_21']
;=================================================================================================
&app_parity_errs = 0xC1000000+0x3cc
&mask = 0x7
&val  = ((Data.Long(A:&app_parity_errs)&(&mask))>>0.)
IF &val!=0.
    PRINT "[app_parity_errs:0x3cc] V:", &val, " Indicates that the controller detected a datapath parity error, one bit for each of the following parity errors: ▪ app_parity_errs[0]: Parity error at front end of the transmit datapath. ▪ app_parity_errs[1]: Parity error at back end of the transmit data_x0002_path. ▪ app_parity_errs[2]: Parity error the receive datapath. The app_parity_errs signals are one-cycle pulses that indicate the as_x0002_sociated parity error occurred they do not indicate which packet con_x0002_tained the parity error. A suggested usage of the app_parity_errs sig_x0002_nals is to register each bit and to provide a control to turn off system notification of parity errors. By doing so, your application can choose to only respond to the first detection of a parity error. The controller per_x0002_forms transmit and receive datapath parity if data path protection is se_x0002_lected."
&axi_parity_errs = 0xC1000000+0x3cc
&mask = 0x3f8
&val  = ((Data.Long(A:&axi_parity_errs)&(&mask))>>3.)
IF &val!=0.
    PRINT "[axi_parity_errs:0x3cc] V:", &val, " axi_parity_errs"
&cfg_ext_tag_en = 0xC1000000+0x3cc
&mask = 0x400
&val  = ((Data.Long(A:&cfg_ext_tag_en)&(&mask))>>10.)
IF &val!=0.
    PRINT "[cfg_ext_tag_en:0x3cc] V:", &val, " When enabled, controller supports up to 8-bit tag values."
&slv_rasdp_err_mode = 0xC1000000+0x3cc
&mask = 0x800
&val  = ((Data.Long(A:&slv_rasdp_err_mode)&(&mask))>>11.)
IF &val!=0.
    PRINT "[slv_rasdp_err_mode:0x3cc] V:", &val, " Indication (slv_aclk version) from the controller that it has entered RASDP error mode. The controller enters RASDP error mode (if the ERROR_MODE_EN register field =1) upon detection of the first uncor_x0002_rectable error. During this mode: ▪ Controller sets mstr_rasdp_error_mode =1 ▪ Controller sets slv_rasdp_error_mode =1 ▪ Controller sets dbi_rasdp_error_mode =1 ▪ Rx TLPs that are forwarded to your application are not guaranteed to be correct you must discard them."
&mstr_rasdp_err_mode = 0xC1000000+0x3cc
&mask = 0x1000
&val  = ((Data.Long(A:&mstr_rasdp_err_mode)&(&mask))>>12.)
IF &val!=0.
    PRINT "[mstr_rasdp_err_mode:0x3cc] V:", &val, " Indicates (mstr_aclk version) that the controller has entered the RASDP error mode. The controller enters RASDP error mode (if the ERROR_MODE_EN register field =1) upon detection of the first uncor_x0002_rectable error. During this mode: ▪ Controller sets slv_rasdp_err_mode =1 ▪ Controller sets mstr_rasdp_err_mode =1 ▪ Controller sets dbi_rasdp_err_mode =1 ▪ Rx TLPs that are forwarded to your application are not guaranteed to be correct you must discard them."
&cfg_neg_link_width = 0xC1000000+0x3cc
&mask = 0x7e000
&val  = ((Data.Long(A:&cfg_neg_link_width)&(&mask))>>13.)
IF &val!=0.
    PRINT "[cfg_neg_link_width:0x3cc] V:", &val, " Negotiated Link Width Field of Link Status Register Indicates the nego_x0002_tiated width of the given PCI Express Link"
&cfg_advisory_nf_sts = 0xC1000000+0x3cc
&mask = 0x80000
&val  = ((Data.Long(A:&cfg_advisory_nf_sts)&(&mask))>>19.)
IF &val!=0.
    PRINT "[cfg_advisory_nf_sts:0x3cc] V:", &val, " Indication from the controller that the controller detected an Advisory Non-Fatal Error."
&cfg_hdr_log_overflow_sts = 0xC1000000+0x3cc
&mask = 0x100000
&val  = ((Data.Long(A:&cfg_hdr_log_overflow_sts)&(&mask))>>20.)
IF &val!=0.
    PRINT "[cfg_hdr_log_overflow_sts:0x3cc] V:", &val, " Indication from the controller that the controller detected a Header Log Overflow Error."

;=================================================================================================
; Register:acc_ras_st_bus_ro00, Member: ['diag_status_bus0']
;=================================================================================================
&diag_status_bus0 = 0xC1000000+0xc00
&mask = 0x3ffff
&val  = ((Data.Long(A:&diag_status_bus0)&(&mask))>>0.)
IF &val!=0.
    PRINT "[diag_status_bus0:0xc00] V:", &val, "  = Payload flow control credits consumed. NOTE: hdr credits consumed is always 1"
&mask = 0xc0000
&val  = ((Data.Long(A:&diag_status_bus0)&(&mask))>>18.)
IF &val!=0.
    PRINT "[diag_status_bus0:0xc00] V:", &val, "  = Header flow control credit consumed"
&mask = 0xf00000
&val  = ((Data.Long(A:&diag_status_bus0)&(&mask))>>20.)
IF &val!=0.
    PRINT "[diag_status_bus0:0xc00] V:", &val, "  = Flow control type consumed (P=0, NP=1, CPL=2)"
&mask = 0x3f000000
&val  = ((Data.Long(A:&diag_status_bus0)&(&mask))>>24.)
IF &val!=0.
    PRINT "[diag_status_bus0:0xc00] V:", &val, "  = Virtual channel of received TLP"
&mask = 0x40000000
&val  = ((Data.Long(A:&diag_status_bus0)&(&mask))>>30.)
IF &val!=0.
    PRINT "[diag_status_bus0:0xc00] V:", &val, " = Layer2 is not accepting data to transmit this cycle "
&mask_0 = 0x80000000
&mask_1 = 0xffffffff
&mask_2 = 0xffffffff
&mask_3 = 0xffffffff
&mask_4 = 0xffffffff
&mask_5 = 0xffffffff
&mask_6 = 0xffffffff
&mask_7 = 0xffffffff
&mask_8 = 0xffffffff
&mask_9 = 0x7fffffff
&val_0 = ((Data.Long(A:&diag_status_bus0+0x0)&(&mask_0))>>31.)|(((Data.Long(A:&diag_status_bus0+0x4)&(&mask_1))<<1.)&0xFFFFFFFF)
&val_1 = ((Data.Long(A:&diag_status_bus0+0x4)&(&mask_1))>>31.)|(((Data.Long(A:&diag_status_bus0+0x8)&(&mask_2))<<1.)&0xFFFFFFFF)
&val_2 = ((Data.Long(A:&diag_status_bus0+0x8)&(&mask_2))>>31.)|(((Data.Long(A:&diag_status_bus0+0xc)&(&mask_3))<<1.)&0xFFFFFFFF)
&val_3 = ((Data.Long(A:&diag_status_bus0+0xc)&(&mask_3))>>31.)|(((Data.Long(A:&diag_status_bus0+0x10)&(&mask_4))<<1.)&0xFFFFFFFF)
&val_4 = ((Data.Long(A:&diag_status_bus0+0x10)&(&mask_4))>>31.)|(((Data.Long(A:&diag_status_bus0+0x14)&(&mask_5))<<1.)&0xFFFFFFFF)
&val_5 = ((Data.Long(A:&diag_status_bus0+0x14)&(&mask_5))>>31.)|(((Data.Long(A:&diag_status_bus0+0x18)&(&mask_6))<<1.)&0xFFFFFFFF)
&val_6 = ((Data.Long(A:&diag_status_bus0+0x18)&(&mask_6))>>31.)|(((Data.Long(A:&diag_status_bus0+0x1c)&(&mask_7))<<1.)&0xFFFFFFFF)
&val_7 = ((Data.Long(A:&diag_status_bus0+0x1c)&(&mask_7))>>31.)|(((Data.Long(A:&diag_status_bus0+0x20)&(&mask_8))<<1.)&0xFFFFFFFF)
&val_8 = ((Data.Long(A:&diag_status_bus0+0x20)&(&mask_8))>>31.)|(((Data.Long(A:&diag_status_bus0+0x24)&(&mask_9))<<1.)&0xFFFFFFFF)
IF (&val_0!=0.)||(&val_1!=0.)||(&val_2!=0.)||(&val_3!=0.)||(&val_4!=0.)||(&val_5!=0.)||(&val_6!=0.)||(&val_7!=0.)||(&val_8!=0.)
    PRINT "[diag_status_bus0:0xc00] V:",FORMAT.HEX(0.,&val_0),"_",FORMAT.HEX(0.,&val_1),"_",FORMAT.HEX(0.,&val_2),"_",FORMAT.HEX(0.,&val_3),"_",FORMAT.HEX(0.,&val_4),"_",FORMAT.HEX(0.,&val_5),"_",FORMAT.HEX(0.,&val_6),"_",FORMAT.HEX(0.,&val_7),"_",FORMAT.HEX(0.,&val_8),"_","  = Transmit data at the interface between Layer3 and Layer2. If RASDP is enabled, includes the ECC or parity protection code bits."
&mask_0 = 0x80000000
&mask_1 = 0x7f
&val_0 = ((Data.Long(A:&diag_status_bus0+0x24)&(&mask_0))>>31.)|(((Data.Long(A:&diag_status_bus0+0x28)&(&mask_1))<<1.)&0xFFFFFFFF)
IF (&val_0!=0.)
    PRINT "[diag_status_bus0:0xc24] V:",FORMAT.HEX(0.,&val_0),"_","  = Nullify this transmit TLP (invert CRC, append EDB)"
&mask_0 = 0x7f8
&val_0 = ((Data.Long(A:&diag_status_bus0+0x28)&(&mask_0))>>7.)
IF (&val_0!=0.)
    PRINT "[diag_status_bus0:0xc28] V:",FORMAT.HEX(0.,&val_0),"_","  = Transmit End of TLP this cycle"
&mask_0 = 0x7f8
&val_0 = ((Data.Long(A:&diag_status_bus0+0x28)&(&mask_0))>>15.)
IF (&val_0!=0.)
    PRINT "[diag_status_bus0:0xc28] V:",FORMAT.HEX(0.,&val_0),"_","  = Transmit Start of TLP this cycle"
&mask_0 = 0x8
&val_0 = ((Data.Long(A:&diag_status_bus0+0x28)&(&mask_0))>>23.)
IF (&val_0!=0.)
    PRINT "[diag_status_bus0:0xc28] V:",FORMAT.HEX(0.,&val_0),"_"," = End-to-end CRC corrupted for this packet"
&mask_0 = 0x1
&val_0 = ((Data.Long(A:&diag_status_bus0+0x28)&(&mask_0))>>24.)
IF (&val_0!=0.)
    PRINT "[diag_status_bus0:0xc28] V:",FORMAT.HEX(0.,&val_0),"_"," = Link CRC corrupted for this packet"
&mask_0 = 0x2
&val_0 = ((Data.Long(A:&diag_status_bus0+0x28)&(&mask_0))>>25.)
IF (&val_0!=0.)
    PRINT "[diag_status_bus0:0xc28] V:",FORMAT.HEX(0.,&val_0),"_"," = PHY Layer not accepting data this cycle"
&mask_0 = 0xfc000000
&mask_1 = 0xffffffff
&mask_2 = 0xffffffff
&mask_3 = 0xffffffff
&mask_4 = 0xffffffff
&mask_5 = 0xffffffff
&mask_6 = 0xffffffff
&mask_7 = 0xffffffff
&mask_8 = 0x3ffffff
&val_0 = ((Data.Long(A:&diag_status_bus0+0x28)&(&mask_0))>>26.)|(((Data.Long(A:&diag_status_bus0+0x2c)&(&mask_1))<<6.)&0xFFFFFFFF)
&val_1 = ((Data.Long(A:&diag_status_bus0+0x2c)&(&mask_1))>>26.)|(((Data.Long(A:&diag_status_bus0+0x30)&(&mask_2))<<6.)&0xFFFFFFFF)
&val_2 = ((Data.Long(A:&diag_status_bus0+0x30)&(&mask_2))>>26.)|(((Data.Long(A:&diag_status_bus0+0x34)&(&mask_3))<<6.)&0xFFFFFFFF)
&val_3 = ((Data.Long(A:&diag_status_bus0+0x34)&(&mask_3))>>26.)|(((Data.Long(A:&diag_status_bus0+0x38)&(&mask_4))<<6.)&0xFFFFFFFF)
&val_4 = ((Data.Long(A:&diag_status_bus0+0x38)&(&mask_4))>>26.)|(((Data.Long(A:&diag_status_bus0+0x3c)&(&mask_5))<<6.)&0xFFFFFFFF)
&val_5 = ((Data.Long(A:&diag_status_bus0+0x3c)&(&mask_5))>>26.)|(((Data.Long(A:&diag_status_bus0+0x40)&(&mask_6))<<6.)&0xFFFFFFFF)
&val_6 = ((Data.Long(A:&diag_status_bus0+0x40)&(&mask_6))>>26.)|(((Data.Long(A:&diag_status_bus0+0x44)&(&mask_7))<<6.)&0xFFFFFFFF)
&val_7 = ((Data.Long(A:&diag_status_bus0+0x44)&(&mask_7))>>26.)|(((Data.Long(A:&diag_status_bus0+0x48)&(&mask_8))<<6.)&0xFFFFFFFF)
IF (&val_0!=0.)||(&val_1!=0.)||(&val_2!=0.)||(&val_3!=0.)||(&val_4!=0.)||(&val_5!=0.)||(&val_6!=0.)||(&val_7!=0.)
    PRINT "[diag_status_bus0:0xc28] V:",FORMAT.HEX(0.,&val_0),"_",FORMAT.HEX(0.,&val_1),"_",FORMAT.HEX(0.,&val_2),"_",FORMAT.HEX(0.,&val_3),"_",FORMAT.HEX(0.,&val_4),"_",FORMAT.HEX(0.,&val_5),"_",FORMAT.HEX(0.,&val_6),"_",FORMAT.HEX(0.,&val_7),"_","  = Transmit packet payload (completely framed)"
&mask_0 = 0xfc000000
&mask_1 = 0x3
&val_0 = ((Data.Long(A:&diag_status_bus0+0x48)&(&mask_0))>>26.)|(((Data.Long(A:&diag_status_bus0+0x4c)&(&mask_1))<<6.)&0xFFFFFFFF)
IF (&val_0!=0.)
    PRINT "[diag_status_bus0:0xc48] V:",FORMAT.HEX(0.,&val_0),"_","  = Transmit Start of DLLP (per dword)"
&mask_0 = 0x3fc
&val_0 = ((Data.Long(A:&diag_status_bus0+0x4c)&(&mask_0))>>2.)
IF (&val_0!=0.)
    PRINT "[diag_status_bus0:0xc4c] V:",FORMAT.HEX(0.,&val_0),"_","  = Transmit Start of TLP (per dword)"
&mask_0 = 0x3fc
&val_0 = ((Data.Long(A:&diag_status_bus0+0x4c)&(&mask_0))>>10.)
IF (&val_0!=0.)
    PRINT "[diag_status_bus0:0xc4c] V:",FORMAT.HEX(0.,&val_0),"_","  = Transmit end of TLP/DLLP (per dword)"
&mask_0 = 0x3ffc
&val_0 = ((Data.Long(A:&diag_status_bus0+0x4c)&(&mask_0))>>18.)
IF (&val_0!=0.)
    PRINT "[diag_status_bus0:0xc4c] V:",FORMAT.HEX(0.,&val_0),"_","  = Sequence Number for ACK/NAK DLLP"
&mask_0 = 0x4
&val_0 = ((Data.Long(A:&diag_status_bus0+0x4c)&(&mask_0))>>30.)
IF (&val_0!=0.)
    PRINT "[diag_status_bus0:0xc4c] V:",FORMAT.HEX(0.,&val_0),"_"," = DataLink Layer request to send NAK"
&mask_0 = 0x8
&val_0 = ((Data.Long(A:&diag_status_bus0+0x4c)&(&mask_0))>>31.)
IF (&val_0!=0.)
    PRINT "[diag_status_bus0:0xc4c] V:",FORMAT.HEX(0.,&val_0),"_"," = Request to send ACK due to duplicate TLP"
&mask_0 = 0x1
&val_0 = ((Data.Long(A:&diag_status_bus0+0x50)&(&mask_0))>>0.)
IF (&val_0!=0.)
    PRINT "[diag_status_bus0:0xc50] V:",FORMAT.HEX(0.,&val_0),"_"," = DataLink Layer request to send ACK"
&mask_0 = 0x1ffe
&val_0 = ((Data.Long(A:&diag_status_bus0+0x50)&(&mask_0))>>1.)
IF (&val_0!=0.)
    PRINT "[diag_status_bus0:0xc50] V:",FORMAT.HEX(0.,&val_0),"_","  = Sequence number corresponding to NAK/ACK"
&mask_0 = 0x2
&val_0 = ((Data.Long(A:&diag_status_bus0+0x50)&(&mask_0))>>13.)
IF (&val_0!=0.)
    PRINT "[diag_status_bus0:0xc50] V:",FORMAT.HEX(0.,&val_0),"_"," = DataLink Layer received ACK DLLP"
&mask_0 = 0x4
&val_0 = ((Data.Long(A:&diag_status_bus0+0x50)&(&mask_0))>>14.)
IF (&val_0!=0.)
    PRINT "[diag_status_bus0:0xc50] V:",FORMAT.HEX(0.,&val_0),"_"," = DataLink Layer received NAK DLLP"
&mask_0 = 0x8
&val_0 = ((Data.Long(A:&diag_status_bus0+0x50)&(&mask_0))>>15.)
IF (&val_0!=0.)
    PRINT "[diag_status_bus0:0xc50] V:",FORMAT.HEX(0.,&val_0),"_"," = Software programmed link retrain request"
&mask_0 = 0x1
&val_0 = ((Data.Long(A:&diag_status_bus0+0x50)&(&mask_0))>>16.)
IF (&val_0!=0.)
    PRINT "[diag_status_bus0:0xc50] V:",FORMAT.HEX(0.,&val_0),"_"," = Receive watchdog timer expired, retrain link"
&mask_0 = 0x2
&val_0 = ((Data.Long(A:&diag_status_bus0+0x50)&(&mask_0))>>17.)
IF (&val_0!=0.)
    PRINT "[diag_status_bus0:0xc50] V:",FORMAT.HEX(0.,&val_0),"_"," = vMax retries attempted, request to retrain link"
&mask_0 = 0x4
&val_0 = ((Data.Long(A:&diag_status_bus0+0x50)&(&mask_0))>>18.)
IF (&val_0!=0.)
    PRINT "[diag_status_bus0:0xc50] V:",FORMAT.HEX(0.,&val_0),"_"," = Receive data interface from DLL to Transaction Layer valid this cycle (rdlh_rtlh_*)"
&mask_0 = 0x7f8
&val_0 = ((Data.Long(A:&diag_status_bus0+0x50)&(&mask_0))>>19.)
IF (&val_0!=0.)
    PRINT "[diag_status_bus0:0xc50] V:",FORMAT.HEX(0.,&val_0),"_","  = End of TLP (per dword)"
&mask_0 = 0xf8000000
&mask_1 = 0x7
&val_0 = ((Data.Long(A:&diag_status_bus0+0x50)&(&mask_0))>>27.)|(((Data.Long(A:&diag_status_bus0+0x54)&(&mask_1))<<5.)&0xFFFFFFFF)
IF (&val_0!=0.)
    PRINT "[diag_status_bus0:0xc50] V:",FORMAT.HEX(0.,&val_0),"_","  = Start of TLP (per dword) "
&mask_0 = 0xfffffff8
&mask_1 = 0xffffffff
&mask_2 = 0xffffffff
&mask_3 = 0xffffffff
&mask_4 = 0xffffffff
&mask_5 = 0xffffffff
&mask_6 = 0xffffffff
&mask_7 = 0xffffffff
&mask_8 = 0x7
&val_0 = ((Data.Long(A:&diag_status_bus0+0x54)&(&mask_0))>>3.)|(((Data.Long(A:&diag_status_bus0+0x58)&(&mask_1))<<29.)&0xFFFFFFFF)
&val_1 = ((Data.Long(A:&diag_status_bus0+0x58)&(&mask_1))>>3.)|(((Data.Long(A:&diag_status_bus0+0x5c)&(&mask_2))<<29.)&0xFFFFFFFF)
&val_2 = ((Data.Long(A:&diag_status_bus0+0x5c)&(&mask_2))>>3.)|(((Data.Long(A:&diag_status_bus0+0x60)&(&mask_3))<<29.)&0xFFFFFFFF)
&val_3 = ((Data.Long(A:&diag_status_bus0+0x60)&(&mask_3))>>3.)|(((Data.Long(A:&diag_status_bus0+0x64)&(&mask_4))<<29.)&0xFFFFFFFF)
&val_4 = ((Data.Long(A:&diag_status_bus0+0x64)&(&mask_4))>>3.)|(((Data.Long(A:&diag_status_bus0+0x68)&(&mask_5))<<29.)&0xFFFFFFFF)
&val_5 = ((Data.Long(A:&diag_status_bus0+0x68)&(&mask_5))>>3.)|(((Data.Long(A:&diag_status_bus0+0x6c)&(&mask_6))<<29.)&0xFFFFFFFF)
&val_6 = ((Data.Long(A:&diag_status_bus0+0x6c)&(&mask_6))>>3.)|(((Data.Long(A:&diag_status_bus0+0x70)&(&mask_7))<<29.)&0xFFFFFFFF)
&val_7 = ((Data.Long(A:&diag_status_bus0+0x70)&(&mask_7))>>3.)|(((Data.Long(A:&diag_status_bus0+0x74)&(&mask_8))<<29.)&0xFFFFFFFF)
IF (&val_0!=0.)||(&val_1!=0.)||(&val_2!=0.)||(&val_3!=0.)||(&val_4!=0.)||(&val_5!=0.)||(&val_6!=0.)||(&val_7!=0.)
    PRINT "[diag_status_bus0:0xc54] V:",FORMAT.HEX(0.,&val_0),"_",FORMAT.HEX(0.,&val_1),"_",FORMAT.HEX(0.,&val_2),"_",FORMAT.HEX(0.,&val_3),"_",FORMAT.HEX(0.,&val_4),"_",FORMAT.HEX(0.,&val_5),"_",FORMAT.HEX(0.,&val_6),"_",FORMAT.HEX(0.,&val_7),"_","  = Received packet payload"
&mask_0 = 0x7f8
&val_0 = ((Data.Long(A:&diag_status_bus0+0x74)&(&mask_0))>>3.)
IF (&val_0!=0.)
    PRINT "[diag_status_bus0:0xc74] V:",FORMAT.HEX(0.,&val_0),"_","  = Physical Error detected (per dword)"
&mask_0 = 0x8
&val_0 = ((Data.Long(A:&diag_status_bus0+0x74)&(&mask_0))>>11.)
IF (&val_0!=0.)
    PRINT "[diag_status_bus0:0xc74] V:",FORMAT.HEX(0.,&val_0),"_"," = Receive data interface from PHY to DLL valid this cycle (rplh_rdlh_*)"
&mask_0 = 0xff
&val_0 = ((Data.Long(A:&diag_status_bus0+0x74)&(&mask_0))>>12.)
IF (&val_0!=0.)
    PRINT "[diag_status_bus0:0xc74] V:",FORMAT.HEX(0.,&val_0),"_","  = Packet terminated with EDB (per dword)"
&mask_0 = 0xff
&val_0 = ((Data.Long(A:&diag_status_bus0+0x74)&(&mask_0))>>20.)
IF (&val_0!=0.)
    PRINT "[diag_status_bus0:0xc74] V:",FORMAT.HEX(0.,&val_0),"_","  = DLLP/TLP ending (per dword)"
&mask_0 = 0xf0000000
&mask_1 = 0xf
&val_0 = ((Data.Long(A:&diag_status_bus0+0x74)&(&mask_0))>>28.)|(((Data.Long(A:&diag_status_bus0+0x78)&(&mask_1))<<4.)&0xFFFFFFFF)
IF (&val_0!=0.)
    PRINT "[diag_status_bus0:0xc74] V:",FORMAT.HEX(0.,&val_0),"_","  = DLLP starting (per dword)"
&mask_0 = 0xff
&val_0 = ((Data.Long(A:&diag_status_bus0+0x78)&(&mask_0))>>4.)
IF (&val_0!=0.)
    PRINT "[diag_status_bus0:0xc78] V:",FORMAT.HEX(0.,&val_0),"_","  = MAC layer detected runt STP (per dword)"
&mask_0 = 0xff
&val_0 = ((Data.Long(A:&diag_status_bus0+0x78)&(&mask_0))>>12.)
IF (&val_0!=0.)
    PRINT "[diag_status_bus0:0xc78] V:",FORMAT.HEX(0.,&val_0),"_","  = MAC layer detected runt STP (per dword)"
&mask_0 = 0xf
&val_0 = ((Data.Long(A:&diag_status_bus0+0x78)&(&mask_0))>>20.)
IF (&val_0!=0.)
    PRINT "[diag_status_bus0:0xc78] V:",FORMAT.HEX(0.,&val_0),"_","  = lanes active in link training"
&mask_0 = 0x1
&val_0 = ((Data.Long(A:&diag_status_bus0+0x78)&(&mask_0))>>24.)
IF (&val_0!=0.)
    PRINT "[diag_status_bus0:0xc78] V:",FORMAT.HEX(0.,&val_0),"_"," = Received EIDLE ordered set, any active lane"
&mask_0 = 0x2
&val_0 = ((Data.Long(A:&diag_status_bus0+0x78)&(&mask_0))>>25.)
IF (&val_0!=0.)
    PRINT "[diag_status_bus0:0xc78] V:",FORMAT.HEX(0.,&val_0),"_"," = Logical Idle seen for 1+ symbols on all active lanes"
&mask_0 = 0x4
&val_0 = ((Data.Long(A:&diag_status_bus0+0x78)&(&mask_0))>>26.)
IF (&val_0!=0.)
    PRINT "[diag_status_bus0:0xc78] V:",FORMAT.HEX(0.,&val_0),"_"," = Logical Idle seen for 8+ symbols on all active lanes"
&mask_0 = 0x8
&val_0 = ((Data.Long(A:&diag_status_bus0+0x78)&(&mask_0))>>27.)
IF (&val_0!=0.)
    PRINT "[diag_status_bus0:0xc78] V:",FORMAT.HEX(0.,&val_0),"_"," = Receive logic detected logical lane reversal"
&mask_0 = 0x1
&val_0 = ((Data.Long(A:&diag_status_bus0+0x78)&(&mask_0))>>28.)
IF (&val_0!=0.)
    PRINT "[diag_status_bus0:0xc78] V:",FORMAT.HEX(0.,&val_0),"_"," = Received Link number (lane 0) is PAD (k237)"
&mask_0 = 0x2
&val_0 = ((Data.Long(A:&diag_status_bus0+0x78)&(&mask_0))>>29.)
IF (&val_0!=0.)
    PRINT "[diag_status_bus0:0xc78] V:",FORMAT.HEX(0.,&val_0),"_"," = Deskew logic overflow. Unable to align lanes [level]"
&mask_0 = 0x4
&val_0 = ((Data.Long(A:&diag_status_bus0+0x78)&(&mask_0))>>30.)
IF (&val_0!=0.)
    PRINT "[diag_status_bus0:0xc78] V:",FORMAT.HEX(0.,&val_0),"_"," = Received lane number (lane 0) is PAD (k237)"
&mask_0 = 0x8
&val_0 = ((Data.Long(A:&diag_status_bus0+0x78)&(&mask_0))>>31.)
IF (&val_0!=0.)
    PRINT "[diag_status_bus0:0xc78] V:",FORMAT.HEX(0.,&val_0),"_"," = At least one active lane received TS2 this cycle"
&mask_0 = 0x1
&val_0 = ((Data.Long(A:&diag_status_bus0+0x7c)&(&mask_0))>>0.)
IF (&val_0!=0.)
    PRINT "[diag_status_bus0:0xc7c] V:",FORMAT.HEX(0.,&val_0),"_"," = At least one active lane received TS1 this cycle"
&mask_0 = 0x2
&val_0 = ((Data.Long(A:&diag_status_bus0+0x7c)&(&mask_0))>>1.)
IF (&val_0!=0.)
    PRINT "[diag_status_bus0:0xc7c] V:",FORMAT.HEX(0.,&val_0),"_"," = Assert when the received data is not an expected"
&mask_0 = 0x4
&val_0 = ((Data.Long(A:&diag_status_bus0+0x7c)&(&mask_0))>>2.)
IF (&val_0!=0.)
    PRINT "[diag_status_bus0:0xc7c] V:",FORMAT.HEX(0.,&val_0),"_"," = Skip character is received this cyclePM Diagnostic Bus"
&mask_0 = 0x8
&val_0 = ((Data.Long(A:&diag_status_bus0+0x7c)&(&mask_0))>>3.)
IF (&val_0!=0.)
    PRINT "[diag_status_bus0:0xc7c] V:",FORMAT.HEX(0.,&val_0),"_","  = No credits of any type are available (per VC)."
&mask_0 = 0x1
&val_0 = ((Data.Long(A:&diag_status_bus0+0x7c)&(&mask_0))>>4.)
IF (&val_0!=0.)
    PRINT "[diag_status_bus0:0xc7c] V:",FORMAT.HEX(0.,&val_0),"_"," = No TLP transmit requests currently pending (from internal or external clients)."
&mask_0 = 0x2
&val_0 = ((Data.Long(A:&diag_status_bus0+0x7c)&(&mask_0))>>5.)
IF (&val_0!=0.)
    PRINT "[diag_status_bus0:0xc7c] V:",FORMAT.HEX(0.,&val_0),"_","  = The controller has enough transmit credits of each type (per VC) to meet the PM entry criteria."
&mask_0 = 0x4
&val_0 = ((Data.Long(A:&diag_status_bus0+0x7c)&(&mask_0))>>6.)
IF (&val_0!=0.)
    PRINT "[diag_status_bus0:0xc7c] V:",FORMAT.HEX(0.,&val_0),"_"," = All transmitted TLPs have been acknowledged by the link partner."
&mask_0 = 0x8
&val_0 = ((Data.Long(A:&diag_status_bus0+0x7c)&(&mask_0))>>7.)
IF (&val_0!=0.)
    PRINT "[diag_status_bus0:0xc7c] V:",FORMAT.HEX(0.,&val_0),"_"," = DataLink layer just transmitted a PME_TO_ACK msg."
&mask_0 = 0x1
&val_0 = ((Data.Long(A:&diag_status_bus0+0x7c)&(&mask_0))>>8.)
IF (&val_0!=0.)
    PRINT "[diag_status_bus0:0xc7c] V:",FORMAT.HEX(0.,&val_0),"_"," = There are no pending or in-progress packets going to the PHY."
&mask_0 = 0xe
&val_0 = ((Data.Long(A:&diag_status_bus0+0x7c)&(&mask_0))>>9.)
IF (&val_0!=0.)
    PRINT "[diag_status_bus0:0xc7c] V:",FORMAT.HEX(0.,&val_0),"_","  = L1 FSM sub-state (Tied to 3'b000 when !CX_L1_SUBSTATES_ENABLE)"
&mask_0 = 0x1
&val_0 = ((Data.Long(A:&diag_status_bus0+0x7c)&(&mask_0))>>12.)
IF (&val_0!=0.)
    PRINT "[diag_status_bus0:0xc7c] V:",FORMAT.HEX(0.,&val_0),"_"," = Received a completion that was unexpected"
&mask_0 = 0x2
&val_0 = ((Data.Long(A:&diag_status_bus0+0x7c)&(&mask_0))>>13.)
IF (&val_0!=0.)
    PRINT "[diag_status_bus0:0xc7c] V:",FORMAT.HEX(0.,&val_0),"_"," = Received completion with CA status"
&mask_0 = 0x4
&val_0 = ((Data.Long(A:&diag_status_bus0+0x7c)&(&mask_0))>>14.)
IF (&val_0!=0.)
    PRINT "[diag_status_bus0:0xc7c] V:",FORMAT.HEX(0.,&val_0),"_"," = Received completion with UR status"
&mask_0 = 0x8
&val_0 = ((Data.Long(A:&diag_status_bus0+0x7c)&(&mask_0))>>15.)
IF (&val_0!=0.)
    PRINT "[diag_status_bus0:0xc7c] V:",FORMAT.HEX(0.,&val_0),"_"," = Final completion for the transaction"
&mask_0 = 0x1
&val_0 = ((Data.Long(A:&diag_status_bus0+0x7c)&(&mask_0))>>16.)
IF (&val_0!=0.)
    PRINT "[diag_status_bus0:0xc7c] V:",FORMAT.HEX(0.,&val_0),"_"," = Current completion is being aborted (trashed)"
&mask_0 = 0x2
&val_0 = ((Data.Long(A:&diag_status_bus0+0x7c)&(&mask_0))>>17.)
IF (&val_0!=0.)
    PRINT "[diag_status_bus0:0xc7c] V:",FORMAT.HEX(0.,&val_0),"_"," = Malformed completion"
&mask_0 = 0x1c
&val_0 = ((Data.Long(A:&diag_status_bus0+0x7c)&(&mask_0))>>18.)
IF (&val_0!=0.)
    PRINT "[diag_status_bus0:0xc7c] V:",FORMAT.HEX(0.,&val_0),"_","  = Indicates the filtering result for the current RX request or the completion status for the current RX received completion."
&mask_0 = 0x6
&val_0 = ((Data.Long(A:&diag_status_bus0+0x7c)&(&mask_0))>>21.)
IF (&val_0!=0.)
    PRINT "[diag_status_bus0:0xc7c] V:",FORMAT.HEX(0.,&val_0),"_","  = Destination interface."
&mask_0 = 0x8
&val_0 = ((Data.Long(A:&diag_status_bus0+0x7c)&(&mask_0))>>23.)
IF (&val_0!=0.)
    PRINT "[diag_status_bus0:0xc7c] V:",FORMAT.HEX(0.,&val_0),"_"," = This TLP had an ECRC error"
&mask_0 = 0x1
&val_0 = ((Data.Long(A:&diag_status_bus0+0x7c)&(&mask_0))>>24.)
IF (&val_0!=0.)
    PRINT "[diag_status_bus0:0xc7c] V:",FORMAT.HEX(0.,&val_0),"_"," = This TLP is malformed"
&mask_0 = 0x2
&val_0 = ((Data.Long(A:&diag_status_bus0+0x7c)&(&mask_0))>>25.)
IF (&val_0!=0.)
    PRINT "[diag_status_bus0:0xc7c] V:",FORMAT.HEX(0.,&val_0),"_"," = This TLP has a DataLink Layer Error (for example, LCRC)"
&mask_0 = 0x4
&val_0 = ((Data.Long(A:&diag_status_bus0+0x7c)&(&mask_0))>>26.)
IF (&val_0!=0.)
    PRINT "[diag_status_bus0:0xc7c] V:",FORMAT.HEX(0.,&val_0),"_"," = End of TLP received this cycle"
&mask_0 = 0xf8000000
&mask_1 = 0x7
&val_0 = ((Data.Long(A:&diag_status_bus0+0x7c)&(&mask_0))>>27.)|(((Data.Long(A:&diag_status_bus0+0x80)&(&mask_1))<<5.)&0xFFFFFFFF)
IF (&val_0!=0.)
    PRINT "[diag_status_bus0:0xc7c] V:",FORMAT.HEX(0.,&val_0),"_","  = Dword enables"
&mask_0 = 0xfffffff8
&mask_1 = 0xffffffff
&mask_2 = 0xffffffff
&mask_3 = 0xffffffff
&mask_4 = 0xffffffff
&mask_5 = 0xffffffff
&mask_6 = 0xffffffff
&mask_7 = 0xffffffff
&mask_8 = 0x7
&val_0 = ((Data.Long(A:&diag_status_bus0+0x80)&(&mask_0))>>3.)|(((Data.Long(A:&diag_status_bus0+0x84)&(&mask_1))<<29.)&0xFFFFFFFF)
&val_1 = ((Data.Long(A:&diag_status_bus0+0x84)&(&mask_1))>>3.)|(((Data.Long(A:&diag_status_bus0+0x88)&(&mask_2))<<29.)&0xFFFFFFFF)
&val_2 = ((Data.Long(A:&diag_status_bus0+0x88)&(&mask_2))>>3.)|(((Data.Long(A:&diag_status_bus0+0x8c)&(&mask_3))<<29.)&0xFFFFFFFF)
&val_3 = ((Data.Long(A:&diag_status_bus0+0x8c)&(&mask_3))>>3.)|(((Data.Long(A:&diag_status_bus0+0x90)&(&mask_4))<<29.)&0xFFFFFFFF)
&val_4 = ((Data.Long(A:&diag_status_bus0+0x90)&(&mask_4))>>3.)|(((Data.Long(A:&diag_status_bus0+0x94)&(&mask_5))<<29.)&0xFFFFFFFF)
&val_5 = ((Data.Long(A:&diag_status_bus0+0x94)&(&mask_5))>>3.)|(((Data.Long(A:&diag_status_bus0+0x98)&(&mask_6))<<29.)&0xFFFFFFFF)
&val_6 = ((Data.Long(A:&diag_status_bus0+0x98)&(&mask_6))>>3.)|(((Data.Long(A:&diag_status_bus0+0x9c)&(&mask_7))<<29.)&0xFFFFFFFF)
&val_7 = ((Data.Long(A:&diag_status_bus0+0x9c)&(&mask_7))>>3.)|(((Data.Long(A:&diag_status_bus0+0xa0)&(&mask_8))<<29.)&0xFFFFFFFF)
IF (&val_0!=0.)||(&val_1!=0.)||(&val_2!=0.)||(&val_3!=0.)||(&val_4!=0.)||(&val_5!=0.)||(&val_6!=0.)||(&val_7!=0.)
    PRINT "[diag_status_bus0:0xc80] V:",FORMAT.HEX(0.,&val_0),"_",FORMAT.HEX(0.,&val_1),"_",FORMAT.HEX(0.,&val_2),"_",FORMAT.HEX(0.,&val_3),"_",FORMAT.HEX(0.,&val_4),"_",FORMAT.HEX(0.,&val_5),"_",FORMAT.HEX(0.,&val_6),"_",FORMAT.HEX(0.,&val_7),"_","  = Packet data from receive Transaction Layer"
&mask_0 = 0x8
&val_0 = ((Data.Long(A:&diag_status_bus0+0xa0)&(&mask_0))>>3.)
IF (&val_0!=0.)
    PRINT "[diag_status_bus0:0xca0] V:",FORMAT.HEX(0.,&val_0),"_"," = Packet is in payload stage"
&mask_0 = 0xfffffff0
&mask_1 = 0xffffffff
&mask_2 = 0xffffffff
&mask_3 = 0xffffffff
&mask_4 = 0xf
&val_0 = ((Data.Long(A:&diag_status_bus0+0xa0)&(&mask_0))>>4.)|(((Data.Long(A:&diag_status_bus0+0xa4)&(&mask_1))<<28.)&0xFFFFFFFF)
&val_1 = ((Data.Long(A:&diag_status_bus0+0xa4)&(&mask_1))>>4.)|(((Data.Long(A:&diag_status_bus0+0xa8)&(&mask_2))<<28.)&0xFFFFFFFF)
&val_2 = ((Data.Long(A:&diag_status_bus0+0xa8)&(&mask_2))>>4.)|(((Data.Long(A:&diag_status_bus0+0xac)&(&mask_3))<<28.)&0xFFFFFFFF)
&val_3 = ((Data.Long(A:&diag_status_bus0+0xac)&(&mask_3))>>4.)|(((Data.Long(A:&diag_status_bus0+0xb0)&(&mask_4))<<28.)&0xFFFFFFFF)
IF (&val_0!=0.)||(&val_1!=0.)||(&val_2!=0.)||(&val_3!=0.)
    PRINT "[diag_status_bus0:0xca0] V:",FORMAT.HEX(0.,&val_0),"_",FORMAT.HEX(0.,&val_1),"_",FORMAT.HEX(0.,&val_2),"_",FORMAT.HEX(0.,&val_3),"_","  = Header data (size of stored header is configurable)"
&mask_0 = 0x1
&val_0 = ((Data.Long(A:&diag_status_bus0+0xb0)&(&mask_0))>>4.)
IF (&val_0!=0.)
    PRINT "[diag_status_bus0:0xcb0] V:",FORMAT.HEX(0.,&val_0),"_"," = Information to the receive packet filter block is valid"
&mask_0 = 0x2
&val_0 = ((Data.Long(A:&diag_status_bus0+0xb0)&(&mask_0))>>5.)
IF (&val_0!=0.)
    PRINT "[diag_status_bus0:0xcb0] V:",FORMAT.HEX(0.,&val_0),"_"," = Received a completion that was unexpected"
&mask_0 = 0x4
&val_0 = ((Data.Long(A:&diag_status_bus0+0xb0)&(&mask_0))>>6.)
IF (&val_0!=0.)
    PRINT "[diag_status_bus0:0xcb0] V:",FORMAT.HEX(0.,&val_0),"_"," = Received completion with CA status"
&mask_0 = 0x8
&val_0 = ((Data.Long(A:&diag_status_bus0+0xb0)&(&mask_0))>>7.)
IF (&val_0!=0.)
    PRINT "[diag_status_bus0:0xcb0] V:",FORMAT.HEX(0.,&val_0),"_"," = Received completion with UR status"
&mask_0 = 0x1
&val_0 = ((Data.Long(A:&diag_status_bus0+0xb0)&(&mask_0))>>8.)
IF (&val_0!=0.)
    PRINT "[diag_status_bus0:0xcb0] V:",FORMAT.HEX(0.,&val_0),"_"," = Final completion for the transaction"
&mask_0 = 0x2
&val_0 = ((Data.Long(A:&diag_status_bus0+0xb0)&(&mask_0))>>9.)
IF (&val_0!=0.)
    PRINT "[diag_status_bus0:0xcb0] V:",FORMAT.HEX(0.,&val_0),"_"," = Current completion is being aborted (trashed)"
&mask_0 = 0x4
&val_0 = ((Data.Long(A:&diag_status_bus0+0xb0)&(&mask_0))>>10.)
IF (&val_0!=0.)
    PRINT "[diag_status_bus0:0xcb0] V:",FORMAT.HEX(0.,&val_0),"_"," = Malformed completion"
&mask_0 = 0x38
&val_0 = ((Data.Long(A:&diag_status_bus0+0xb0)&(&mask_0))>>11.)
IF (&val_0!=0.)
    PRINT "[diag_status_bus0:0xcb0] V:",FORMAT.HEX(0.,&val_0),"_","  = Indicates the filtering result for the current RX request or the completion status for the current RX received completion."
&mask_0 = 0xc
&val_0 = ((Data.Long(A:&diag_status_bus0+0xb0)&(&mask_0))>>14.)
IF (&val_0!=0.)
    PRINT "[diag_status_bus0:0xcb0] V:",FORMAT.HEX(0.,&val_0),"_","  = Destination interface."
&mask_0 = 0x1
&val_0 = ((Data.Long(A:&diag_status_bus0+0xb0)&(&mask_0))>>16.)
IF (&val_0!=0.)
    PRINT "[diag_status_bus0:0xcb0] V:",FORMAT.HEX(0.,&val_0),"_"," = This TLP had an ECRC error"
&mask_0 = 0x2
&val_0 = ((Data.Long(A:&diag_status_bus0+0xb0)&(&mask_0))>>17.)
IF (&val_0!=0.)
    PRINT "[diag_status_bus0:0xcb0] V:",FORMAT.HEX(0.,&val_0),"_"," = This TLP is malformed"
&mask_0 = 0x4
&val_0 = ((Data.Long(A:&diag_status_bus0+0xb0)&(&mask_0))>>18.)
IF (&val_0!=0.)
    PRINT "[diag_status_bus0:0xcb0] V:",FORMAT.HEX(0.,&val_0),"_"," = This TLP has a DataLink Layer Error (for example, LCRC)"
&mask_0 = 0x8
&val_0 = ((Data.Long(A:&diag_status_bus0+0xb0)&(&mask_0))>>19.)
IF (&val_0!=0.)
    PRINT "[diag_status_bus0:0xcb0] V:",FORMAT.HEX(0.,&val_0),"_"," = End of TLP received this cycle"
&mask_0 = 0xff
&val_0 = ((Data.Long(A:&diag_status_bus0+0xb0)&(&mask_0))>>20.)
IF (&val_0!=0.)
    PRINT "[diag_status_bus0:0xcb0] V:",FORMAT.HEX(0.,&val_0),"_","  = Dword enables"
&mask_0 = 0xf0000000
&mask_1 = 0xffffffff
&mask_2 = 0xffffffff
&mask_3 = 0xffffffff
&mask_4 = 0xffffffff
&mask_5 = 0xffffffff
&mask_6 = 0xffffffff
&mask_7 = 0xffffffff
&mask_8 = 0xfffffff
&val_0 = ((Data.Long(A:&diag_status_bus0+0xb0)&(&mask_0))>>28.)|(((Data.Long(A:&diag_status_bus0+0xb4)&(&mask_1))<<4.)&0xFFFFFFFF)
&val_1 = ((Data.Long(A:&diag_status_bus0+0xb4)&(&mask_1))>>28.)|(((Data.Long(A:&diag_status_bus0+0xb8)&(&mask_2))<<4.)&0xFFFFFFFF)
&val_2 = ((Data.Long(A:&diag_status_bus0+0xb8)&(&mask_2))>>28.)|(((Data.Long(A:&diag_status_bus0+0xbc)&(&mask_3))<<4.)&0xFFFFFFFF)
&val_3 = ((Data.Long(A:&diag_status_bus0+0xbc)&(&mask_3))>>28.)|(((Data.Long(A:&diag_status_bus0+0xc0)&(&mask_4))<<4.)&0xFFFFFFFF)
&val_4 = ((Data.Long(A:&diag_status_bus0+0xc0)&(&mask_4))>>28.)|(((Data.Long(A:&diag_status_bus0+0xc4)&(&mask_5))<<4.)&0xFFFFFFFF)
&val_5 = ((Data.Long(A:&diag_status_bus0+0xc4)&(&mask_5))>>28.)|(((Data.Long(A:&diag_status_bus0+0xc8)&(&mask_6))<<4.)&0xFFFFFFFF)
&val_6 = ((Data.Long(A:&diag_status_bus0+0xc8)&(&mask_6))>>28.)|(((Data.Long(A:&diag_status_bus0+0xcc)&(&mask_7))<<4.)&0xFFFFFFFF)
&val_7 = ((Data.Long(A:&diag_status_bus0+0xcc)&(&mask_7))>>28.)|(((Data.Long(A:&diag_status_bus0+0xd0)&(&mask_8))<<4.)&0xFFFFFFFF)
IF (&val_0!=0.)||(&val_1!=0.)||(&val_2!=0.)||(&val_3!=0.)||(&val_4!=0.)||(&val_5!=0.)||(&val_6!=0.)||(&val_7!=0.)
    PRINT "[diag_status_bus0:0xcb0] V:",FORMAT.HEX(0.,&val_0),"_",FORMAT.HEX(0.,&val_1),"_",FORMAT.HEX(0.,&val_2),"_",FORMAT.HEX(0.,&val_3),"_",FORMAT.HEX(0.,&val_4),"_",FORMAT.HEX(0.,&val_5),"_",FORMAT.HEX(0.,&val_6),"_",FORMAT.HEX(0.,&val_7),"_","  = Packet data from receive Transaction Layer"
&mask_0 = 0x1
&val_0 = ((Data.Long(A:&diag_status_bus0+0xd0)&(&mask_0))>>28.)
IF (&val_0!=0.)
    PRINT "[diag_status_bus0:0xcd0] V:",FORMAT.HEX(0.,&val_0),"_"," = Packet is in payload stage"
&mask_0 = 0xe0000000
&mask_1 = 0xffffffff
&mask_2 = 0xffffffff
&mask_3 = 0xffffffff
&mask_4 = 0x1fffffff
&val_0 = ((Data.Long(A:&diag_status_bus0+0xd0)&(&mask_0))>>29.)|(((Data.Long(A:&diag_status_bus0+0xd4)&(&mask_1))<<3.)&0xFFFFFFFF)
&val_1 = ((Data.Long(A:&diag_status_bus0+0xd4)&(&mask_1))>>29.)|(((Data.Long(A:&diag_status_bus0+0xd8)&(&mask_2))<<3.)&0xFFFFFFFF)
&val_2 = ((Data.Long(A:&diag_status_bus0+0xd8)&(&mask_2))>>29.)|(((Data.Long(A:&diag_status_bus0+0xdc)&(&mask_3))<<3.)&0xFFFFFFFF)
&val_3 = ((Data.Long(A:&diag_status_bus0+0xdc)&(&mask_3))>>29.)|(((Data.Long(A:&diag_status_bus0+0xe0)&(&mask_4))<<3.)&0xFFFFFFFF)
IF (&val_0!=0.)||(&val_1!=0.)||(&val_2!=0.)||(&val_3!=0.)
    PRINT "[diag_status_bus0:0xcd0] V:",FORMAT.HEX(0.,&val_0),"_",FORMAT.HEX(0.,&val_1),"_",FORMAT.HEX(0.,&val_2),"_",FORMAT.HEX(0.,&val_3),"_","  = Header data (size of stored header is configurable)"
&mask_0 = 0x2
&val_0 = ((Data.Long(A:&diag_status_bus0+0xe0)&(&mask_0))>>29.)
IF (&val_0!=0.)
    PRINT "[diag_status_bus0:0xce0] V:",FORMAT.HEX(0.,&val_0),"_"," = Information to the receive packet filter block is valid RADM Diagnostic Dual Bus Selector."
&mask_0 = 0x4
&val_0 = ((Data.Long(A:&diag_status_bus0+0xe0)&(&mask_0))>>30.)
IF (&val_0!=0.)
    PRINT "[diag_status_bus0:0xce0] V:",FORMAT.HEX(0.,&val_0),"_"," = Indicates which TLP was received first by the controller for 256-bit configurations."
&mask_0 = 0x80000000
&mask_1 = 0xf
&val_0 = ((Data.Long(A:&diag_status_bus0+0xe0)&(&mask_0))>>31.)|(((Data.Long(A:&diag_status_bus0+0xe4)&(&mask_1))<<1.)&0xFFFFFFFF)
IF (&val_0!=0.)
    PRINT "[diag_status_bus0:0xce0] V:",FORMAT.HEX(0.,&val_0),"_","  = Currently granted client (1-hot)"
&mask_0 = 0x1f
&val_0 = ((Data.Long(A:&diag_status_bus0+0xe4)&(&mask_0))>>4.)
IF (&val_0!=0.)
    PRINT "[diag_status_bus0:0xce4] V:",FORMAT.HEX(0.,&val_0),"_","  = This client has completed his request (1-hot)"
&mask_0 = 0x3e
&val_0 = ((Data.Long(A:&diag_status_bus0+0xe4)&(&mask_0))>>9.)
IF (&val_0!=0.)
    PRINT "[diag_status_bus0:0xce4] V:",FORMAT.HEX(0.,&val_0),"_","  = Credit check passed for each request"
&mask_0 = 0x7c
&val_0 = ((Data.Long(A:&diag_status_bus0+0xe4)&(&mask_0))>>14.)
IF (&val_0!=0.)
    PRINT "[diag_status_bus0:0xce4] V:",FORMAT.HEX(0.,&val_0),"_","  = Transmit requests from each client "
&mask_0 = 0x7f8
&val_0 = ((Data.Long(A:&diag_status_bus0+0xe4)&(&mask_0))>>19.)
IF (&val_0!=0.)
    PRINT "[diag_status_bus0:0xce4] V:",FORMAT.HEX(0.,&val_0),"_","  = Bus number; 8 bits per function when MULTI_DEVICE_AND_BUS_PER_FUNC_EN=1, else 8 bits in total."
&mask_0 = 0xf8
&val_0 = ((Data.Long(A:&diag_status_bus0+0xe4)&(&mask_0))>>27.)
IF (&val_0!=0.)
    PRINT "[diag_status_bus0:0xce4] V:",FORMAT.HEX(0.,&val_0),"_","  = Device number; 5 bits per function when MULTI_DEVICE_AND_BUS_PER_FUNC_EN=1, else 5 bits in total."
&mask_0 = 0x1
&val_0 = ((Data.Long(A:&diag_status_bus0+0xe8)&(&mask_0))>>0.)
IF (&val_0!=0.)
    PRINT "[diag_status_bus0:0xce8] V:",FORMAT.HEX(0.,&val_0),"_"," = Retry timer expired [pulse]"
&mask_0 = 0x2
&val_0 = ((Data.Long(A:&diag_status_bus0+0xe8)&(&mask_0))>>1.)
IF (&val_0!=0.)
    PRINT "[diag_status_bus0:0xce8] V:",FORMAT.HEX(0.,&val_0),"_"," = Max retries exceeded [pulse]"
&mask_0 = 0x4
&val_0 = ((Data.Long(A:&diag_status_bus0+0xe8)&(&mask_0))>>2.)
IF (&val_0!=0.)
    PRINT "[diag_status_bus0:0xce8] V:",FORMAT.HEX(0.,&val_0),"_"," = Received DLLP with DataLink Layer error [pulse]"
&mask_0 = 0x8
&val_0 = ((Data.Long(A:&diag_status_bus0+0xe8)&(&mask_0))>>3.)
IF (&val_0!=0.)
    PRINT "[diag_status_bus0:0xce8] V:",FORMAT.HEX(0.,&val_0),"_"," = Received TLP with DataLink Layer error [pulse]"
&mask_0 = 0x1
&val_0 = ((Data.Long(A:&diag_status_bus0+0xe8)&(&mask_0))>>4.)
IF (&val_0!=0.)
    PRINT "[diag_status_bus0:0xce8] V:",FORMAT.HEX(0.,&val_0),"_"," = DLLP protocol error (out of sequence DLLP) [pulse]"
&mask_0 = 0x2
&val_0 = ((Data.Long(A:&diag_status_bus0+0xe8)&(&mask_0))>>5.)
IF (&val_0!=0.)
    PRINT "[diag_status_bus0:0xce8] V:",FORMAT.HEX(0.,&val_0),"_"," = Flow control protocol violation (watchdog timer) [pulse]"
&mask_0 = 0x4
&val_0 = ((Data.Long(A:&diag_status_bus0+0xe8)&(&mask_0))>>6.)
IF (&val_0!=0.)
    PRINT "[diag_status_bus0:0xce8] V:",FORMAT.HEX(0.,&val_0),"_"," = Received PHY error this cycle [pulse]"
&mask_0 = 0x8
&val_0 = ((Data.Long(A:&diag_status_bus0+0xe8)&(&mask_0))>>7.)
IF (&val_0!=0.)
    PRINT "[diag_status_bus0:0xce8] V:",FORMAT.HEX(0.,&val_0),"_"," = Flow control update protocol violation (opt.checks)"
&mask_0 = 0x1
&val_0 = ((Data.Long(A:&diag_status_bus0+0xe8)&(&mask_0))>>8.)
IF (&val_0!=0.)
    PRINT "[diag_status_bus0:0xce8] V:",FORMAT.HEX(0.,&val_0),"_"," = An request failed to complete in the allotted time"
&mask_0 = 0x2
&val_0 = ((Data.Long(A:&diag_status_bus0+0xe8)&(&mask_0))>>9.)
IF (&val_0!=0.)
    PRINT "[diag_status_bus0:0xce8] V:",FORMAT.HEX(0.,&val_0),"_","  = Receive queue overflow. Normally happens only when flow control advertisements are ignored"
&mask_0 = 0x4
&val_0 = ((Data.Long(A:&diag_status_bus0+0xe8)&(&mask_0))>>10.)
IF (&val_0!=0.)
    PRINT "[diag_status_bus0:0xce8] V:",FORMAT.HEX(0.,&val_0),"_","  = Received an unexpected completion [pulse]"
&mask_0 = 0x8
&val_0 = ((Data.Long(A:&diag_status_bus0+0xe8)&(&mask_0))>>11.)
IF (&val_0!=0.)
    PRINT "[diag_status_bus0:0xce8] V:",FORMAT.HEX(0.,&val_0),"_","  = Received a completion with UR status"
&mask_0 = 0x1
&val_0 = ((Data.Long(A:&diag_status_bus0+0xe8)&(&mask_0))>>12.)
IF (&val_0!=0.)
    PRINT "[diag_status_bus0:0xce8] V:",FORMAT.HEX(0.,&val_0),"_","  = Received a completion with CA status"
&mask_0 = 0x2
&val_0 = ((Data.Long(A:&diag_status_bus0+0xe8)&(&mask_0))>>13.)
IF (&val_0!=0.)
    PRINT "[diag_status_bus0:0xce8] V:",FORMAT.HEX(0.,&val_0),"_","  = Completer aborted request"
&mask_0 = 0x4
&val_0 = ((Data.Long(A:&diag_status_bus0+0xe8)&(&mask_0))>>14.)
IF (&val_0!=0.)
    PRINT "[diag_status_bus0:0xce8] V:",FORMAT.HEX(0.,&val_0),"_","  = Received a request which device does not support"
&mask_0 = 0x8
&val_0 = ((Data.Long(A:&diag_status_bus0+0xe8)&(&mask_0))>>15.)
IF (&val_0!=0.)
    PRINT "[diag_status_bus0:0xce8] V:",FORMAT.HEX(0.,&val_0),"_","  = Received a TLP with ECRC error"
&mask_0 = 0x1
&val_0 = ((Data.Long(A:&diag_status_bus0+0xe8)&(&mask_0))>>16.)
IF (&val_0!=0.)
    PRINT "[diag_status_bus0:0xce8] V:",FORMAT.HEX(0.,&val_0),"_","  = Received a malformed TLP [pulse]"
&mask_0 = 0x2
&val_0 = ((Data.Long(A:&diag_status_bus0+0xe8)&(&mask_0))>>17.)
IF (&val_0!=0.)
    PRINT "[diag_status_bus0:0xce8] V:",FORMAT.HEX(0.,&val_0),"_","  = Received a completion with poisoned payload"
&mask_0 = 0x4
&val_0 = ((Data.Long(A:&diag_status_bus0+0xe8)&(&mask_0))>>18.)
IF (&val_0!=0.)
    PRINT "[diag_status_bus0:0xce8] V:",FORMAT.HEX(0.,&val_0),"_","  = Received a write with poisoned payload"
&mask_0 = 0x8
&val_0 = ((Data.Long(A:&diag_status_bus0+0xe8)&(&mask_0))>>19.)
IF (&val_0!=0.)
    PRINT "[diag_status_bus0:0xce8] V:",FORMAT.HEX(0.,&val_0),"_","  = Local bus Acknowledge"
&mask_0 = 0xf
&val_0 = ((Data.Long(A:&diag_status_bus0+0xe8)&(&mask_0))>>20.)
IF (&val_0!=0.)
    PRINT "[diag_status_bus0:0xce8] V:",FORMAT.HEX(0.,&val_0),"_","  = Local bus Write enable (per byte)"
&mask_0 = 0x1
&val_0 = ((Data.Long(A:&diag_status_bus0+0xe8)&(&mask_0))>>24.)
IF (&val_0!=0.)
    PRINT "[diag_status_bus0:0xce8] V:",FORMAT.HEX(0.,&val_0),"_","  = Local bus chip select"
&mask_0 = 0xfe000000
&mask_1 = 0x1ffffff
&val_0 = ((Data.Long(A:&diag_status_bus0+0xe8)&(&mask_0))>>25.)|(((Data.Long(A:&diag_status_bus0+0xec)&(&mask_1))<<7.)&0xFFFFFFFF)
IF (&val_0!=0.)
    PRINT "[diag_status_bus0:0xce8] V:",FORMAT.HEX(0.,&val_0),"_","  = Local bus Data"
&mask_0 = 0xfe000000
&mask_1 = 0x1ffffff
&val_0 = ((Data.Long(A:&diag_status_bus0+0xec)&(&mask_0))>>25.)|(((Data.Long(A:&diag_status_bus0+0xf0)&(&mask_1))<<7.)&0xFFFFFFFF)
IF (&val_0!=0.)
    PRINT "[diag_status_bus0:0xcec] V:",FORMAT.HEX(0.,&val_0),"_","  = Local bus Address"
&mask_0 = 0x2
&val_0 = ((Data.Long(A:&diag_status_bus0+0xf0)&(&mask_0))>>25.)
IF (&val_0!=0.)
    PRINT "[diag_status_bus0:0xcf0] V:",FORMAT.HEX(0.,&val_0),"_"," = System Error caused by Correctable "
&mask_0 = 0x4
&val_0 = ((Data.Long(A:&diag_status_bus0+0xf0)&(&mask_0))>>26.)
IF (&val_0!=0.)
    PRINT "[diag_status_bus0:0xcf0] V:",FORMAT.HEX(0.,&val_0),"_"," = System Error caused by Non-Fatal"
&mask_0 = 0x8
&val_0 = ((Data.Long(A:&diag_status_bus0+0xf0)&(&mask_0))>>27.)
IF (&val_0!=0.)
    PRINT "[diag_status_bus0:0xcf0] V:",FORMAT.HEX(0.,&val_0),"_"," = System Error caused by Fatal"
&mask_0 = 0x1
&val_0 = ((Data.Long(A:&diag_status_bus0+0xf0)&(&mask_0))>>28.)
IF (&val_0!=0.)
    PRINT "[diag_status_bus0:0xcf0] V:",FORMAT.HEX(0.,&val_0),"_"," = Received a TLP with PCRC error (Tied 0 if PCIe IDE is not enabled)"
&mask_0 = 0x2
&val_0 = ((Data.Long(A:&diag_status_bus0+0xf0)&(&mask_0))>>29.)
IF (&val_0!=0.)
    PRINT "[diag_status_bus0:0xcf0] V:",FORMAT.HEX(0.,&val_0),"_"," = Received an IDE Misrouted TLP (Tied 0 if PCIe IDE is not enabled)"
&mask_0 = 0x4
&val_0 = ((Data.Long(A:&diag_status_bus0+0xf0)&(&mask_0))>>30.)
IF (&val_0!=0.)
    PRINT "[diag_status_bus0:0xcf0] V:",FORMAT.HEX(0.,&val_0),"_"," = Received an IDE TLP with an IDE Check"

;=================================================================================================
; Register:acc_ras_ec_com_ro00, Member: ['cdm_ras_des_ec_info_common0']
;=================================================================================================
&cdm_ras_des_ec_info_common0 = 0xC1000000+0x45c
&mask = 0x1
&val  = ((Data.Long(A:&cdm_ras_des_ec_info_common0)&(&mask))>>0.)
IF &val!=0.
    PRINT "[cdm_ras_des_ec_info_common0:0x45c] V:", &val, " : Reserved (fixed 0)"
&mask = 0x2
&val  = ((Data.Long(A:&cdm_ras_des_ec_info_common0)&(&mask))>>1.)
IF &val!=0.
    PRINT "[cdm_ras_des_ec_info_common0:0x45c] V:", &val, " : Reserved (fixed 0)"
&mask = 0x4
&val  = ((Data.Long(A:&cdm_ras_des_ec_info_common0)&(&mask))>>2.)
IF &val!=0.
    PRINT "[cdm_ras_des_ec_info_common0:0x45c] V:", &val, " : Reserved (fixed 0)"
&mask = 0x8
&val  = ((Data.Long(A:&cdm_ras_des_ec_info_common0)&(&mask))>>3.)
IF &val!=0.
    PRINT "[cdm_ras_des_ec_info_common0:0x45c] V:", &val, " : Reserved (fixed 0)"
&mask = 0x10
&val  = ((Data.Long(A:&cdm_ras_des_ec_info_common0)&(&mask))>>4.)
IF &val!=0.
    PRINT "[cdm_ras_des_ec_info_common0:0x45c] V:", &val, " : Reserved (fixed 0)"
&mask = 0x20
&val  = ((Data.Long(A:&cdm_ras_des_ec_info_common0)&(&mask))>>5.)
IF &val!=0.
    PRINT "[cdm_ras_des_ec_info_common0:0x45c] V:", &val, " : smlh_eidle_inferred_in_l0: Level: Detect EI Infer"
&mask = 0x40
&val  = ((Data.Long(A:&cdm_ras_des_ec_info_common0)&(&mask))>>6.)
IF &val!=0.
    PRINT "[cdm_ras_des_ec_info_common0:0x45c] V:", &val, " : rmlh_rcvd_err: Pulse: Receiver Error"
&mask = 0x80
&val  = ((Data.Long(A:&cdm_ras_des_ec_info_common0)&(&mask))>>7.)
IF &val!=0.
    PRINT "[cdm_ras_des_ec_info_common0:0x45c] V:", &val, " : smlh_rx_rcvry_req: Level: Rx Recovery Request"
&mask = 0x100
&val  = ((Data.Long(A:&cdm_ras_des_ec_info_common0)&(&mask))>>8.)
IF &val!=0.
    PRINT "[cdm_ras_des_ec_info_common0:0x45c] V:", &val, " : smlh_timeout_nfts: Level: FTS Timeout"
&mask = 0x200
&val  = ((Data.Long(A:&cdm_ras_des_ec_info_common0)&(&mask))>>9.)
IF &val!=0.
    PRINT "[cdm_ras_des_ec_info_common0:0x45c] V:", &val, " : rmlh_framing_err: Pulse: Framing Error"
&mask = 0x400
&val  = ((Data.Long(A:&cdm_ras_des_ec_info_common0)&(&mask))>>10.)
IF &val!=0.
    PRINT "[cdm_ras_des_ec_info_common0:0x45c] V:", &val, " : rmlh_deskew_alignment_err: Level: Deskew Error"
&mask = 0x7800
&val  = ((Data.Long(A:&cdm_ras_des_ec_info_common0)&(&mask))>>11.)
IF &val!=0.
    PRINT "[cdm_ras_des_ec_info_common0:0x45c] V:", &val, " : rdlh_bad_tlp_err_pertlp : Pulse: BAD TLP"
&mask = 0x78000
&val  = ((Data.Long(A:&cdm_ras_des_ec_info_common0)&(&mask))>>15.)
IF &val!=0.
    PRINT "[cdm_ras_des_ec_info_common0:0x45c] V:", &val, " : rdlh_lcrc_tlp_err_pertlp : Pulse: LCRC Error"
&mask = 0x7f80000
&val  = ((Data.Long(A:&cdm_ras_des_ec_info_common0)&(&mask))>>19.)
IF &val!=0.
    PRINT "[cdm_ras_des_ec_info_common0:0x45c] V:", &val, " : rdlh_bad_dllp_err_perdllp: Pulse: BAD DLLP"
&mask = 0x8000000
&val  = ((Data.Long(A:&cdm_ras_des_ec_info_common0)&(&mask))>>27.)
IF &val!=0.
    PRINT "[cdm_ras_des_ec_info_common0:0x45c] V:", &val, " : xdlh_replay_num_rlover_err: Pulse: Replay_Num Rollover"
&mask = 0x10000000
&val  = ((Data.Long(A:&cdm_ras_des_ec_info_common0)&(&mask))>>28.)
IF &val!=0.
    PRINT "[cdm_ras_des_ec_info_common0:0x45c] V:", &val, " : xdlh_replay_timeout_err: Pulse: Replay Timeout"
&mask = 0xe0000000
&val  = ((Data.Long(A:&cdm_ras_des_ec_info_common0)&(&mask))>>29.)
IF &val!=0.
    PRINT "[cdm_ras_des_ec_info_common0:0x45c] V:", &val, " : rdlh_rcvd_nack_perdllp: Pulse: Rx Nak DLLP"
&mask_0 = 0x1f
&val_0 = ((Data.Long(A:&cdm_ras_des_ec_info_common0+0x0)&(&mask_0))>>0.)
IF (&val_0!=0.)
    PRINT "[cdm_ras_des_ec_info_common0:0x45c] V:",FORMAT.HEX(0.,&val_0),"_"," : rdlh_rcvd_nack_perdllp: Pulse: Rx Nak DLLP"
&mask_0 = 0x2
&val_0 = ((Data.Long(A:&cdm_ras_des_ec_info_common0+0x4)&(&mask_0))>>5.)
IF (&val_0!=0.)
    PRINT "[cdm_ras_des_ec_info_common0:0x460] V:",FORMAT.HEX(0.,&val_0),"_"," : xdlh_nak_sent: Pulse: Tx Nak DLLP"
&mask_0 = 0x4
&val_0 = ((Data.Long(A:&cdm_ras_des_ec_info_common0+0x4)&(&mask_0))>>6.)
IF (&val_0!=0.)
    PRINT "[cdm_ras_des_ec_info_common0:0x460] V:",FORMAT.HEX(0.,&val_0),"_"," : xdlh_retry_req: Pulse: Retry TLP"
&mask_0 = 0x8
&val_0 = ((Data.Long(A:&cdm_ras_des_ec_info_common0+0x4)&(&mask_0))>>7.)
IF (&val_0!=0.)
    PRINT "[cdm_ras_des_ec_info_common0:0x460] V:",FORMAT.HEX(0.,&val_0),"_"," : rtlh_req_link_retrain: Level: FC Timeout"
&mask_0 = 0xf
&val_0 = ((Data.Long(A:&cdm_ras_des_ec_info_common0+0x4)&(&mask_0))>>8.)
IF (&val_0!=0.)
    PRINT "[cdm_ras_des_ec_info_common0:0x460] V:",FORMAT.HEX(0.,&val_0),"_"," : cfg_poisned_tlp: Pulse: Poisoned TLP"
&mask_0 = 0xf
&val_0 = ((Data.Long(A:&cdm_ras_des_ec_info_common0+0x4)&(&mask_0))>>12.)
IF (&val_0!=0.)
    PRINT "[cdm_ras_des_ec_info_common0:0x460] V:",FORMAT.HEX(0.,&val_0),"_"," : cfg_ecrc_tlp_err: Pulse: ECRC Error"
&mask_0 = 0xf
&val_0 = ((Data.Long(A:&cdm_ras_des_ec_info_common0+0x4)&(&mask_0))>>16.)
IF (&val_0!=0.)
    PRINT "[cdm_ras_des_ec_info_common0:0x460] V:",FORMAT.HEX(0.,&val_0),"_"," : cfg_ur_tlp: Pulse: Unsupported Request"
&mask_0 = 0xf
&val_0 = ((Data.Long(A:&cdm_ras_des_ec_info_common0+0x4)&(&mask_0))>>20.)
IF (&val_0!=0.)
    PRINT "[cdm_ras_des_ec_info_common0:0x460] V:",FORMAT.HEX(0.,&val_0),"_"," : cfg_ca_tlp: Pulse: Completer Abort"
&mask_0 = 0x3
&val_0 = ((Data.Long(A:&cdm_ras_des_ec_info_common0+0x4)&(&mask_0))>>24.)
IF (&val_0!=0.)
    PRINT "[cdm_ras_des_ec_info_common0:0x460] V:",FORMAT.HEX(0.,&val_0),"_"," : cfg_cpl_timeout[1:0]: Pulse: Completion Timeout"
&mask_0 = 0x4
&val_0 = ((Data.Long(A:&cdm_ras_des_ec_info_common0+0x4)&(&mask_0))>>26.)
IF (&val_0!=0.)
    PRINT "[cdm_ras_des_ec_info_common0:0x460] V:",FORMAT.HEX(0.,&val_0),"_"," : smlh_l0_to_recovery: Pulse: L0 to Recovery Entry"
&mask_0 = 0x8
&val_0 = ((Data.Long(A:&cdm_ras_des_ec_info_common0+0x4)&(&mask_0))>>27.)
IF (&val_0!=0.)
    PRINT "[cdm_ras_des_ec_info_common0:0x460] V:",FORMAT.HEX(0.,&val_0),"_"," : smlh_l1_to_recovery: Pulse: L1 to Recovery Entry"
&mask_0 = 0x1
&val_0 = ((Data.Long(A:&cdm_ras_des_ec_info_common0+0x4)&(&mask_0))>>28.)
IF (&val_0!=0.)
    PRINT "[cdm_ras_des_ec_info_common0:0x460] V:",FORMAT.HEX(0.,&val_0),"_"," : smlh_in_l0s: Level: Tx L0s Entry"
&mask_0 = 0x2
&val_0 = ((Data.Long(A:&cdm_ras_des_ec_info_common0+0x4)&(&mask_0))>>29.)
IF (&val_0!=0.)
    PRINT "[cdm_ras_des_ec_info_common0:0x460] V:",FORMAT.HEX(0.,&val_0),"_"," : smlh_in_rl0s: Level: Rx L0s Entry"
&mask_0 = 0x4
&val_0 = ((Data.Long(A:&cdm_ras_des_ec_info_common0+0x4)&(&mask_0))>>30.)
IF (&val_0!=0.)
    PRINT "[cdm_ras_des_ec_info_common0:0x460] V:",FORMAT.HEX(0.,&val_0),"_"," : pm_asnak: Level: ASPM L1 reject"
&mask_0 = 0x8
&val_0 = ((Data.Long(A:&cdm_ras_des_ec_info_common0+0x4)&(&mask_0))>>31.)
IF (&val_0!=0.)
    PRINT "[cdm_ras_des_ec_info_common0:0x460] V:",FORMAT.HEX(0.,&val_0),"_"," : smlh_in_l1: Level: L1 Entry"
&mask_0 = 0x1
&val_0 = ((Data.Long(A:&cdm_ras_des_ec_info_common0+0x8)&(&mask_0))>>0.)
IF (&val_0!=0.)
    PRINT "[cdm_ras_des_ec_info_common0:0x464] V:",FORMAT.HEX(0.,&val_0),"_"," : pm_in_l11: Level: L1.1 Entry"
&mask_0 = 0x2
&val_0 = ((Data.Long(A:&cdm_ras_des_ec_info_common0+0x8)&(&mask_0))>>1.)
IF (&val_0!=0.)
    PRINT "[cdm_ras_des_ec_info_common0:0x464] V:",FORMAT.HEX(0.,&val_0),"_"," : pm_in_l12: Level: L1.2 Entry"
&mask_0 = 0x4
&val_0 = ((Data.Long(A:&cdm_ras_des_ec_info_common0+0x8)&(&mask_0))>>2.)
IF (&val_0!=0.)
    PRINT "[cdm_ras_des_ec_info_common0:0x464] V:",FORMAT.HEX(0.,&val_0),"_"," : pm_in_l1_short: Level: L1 short duration"
&mask_0 = 0x8
&val_0 = ((Data.Long(A:&cdm_ras_des_ec_info_common0+0x8)&(&mask_0))>>3.)
IF (&val_0!=0.)
    PRINT "[cdm_ras_des_ec_info_common0:0x464] V:",FORMAT.HEX(0.,&val_0),"_"," : pm_in_l1_cpm: Level: L1 Clock PM (L1 with REFCLK removal/PLL Off)"
&mask_0 = 0x1
&val_0 = ((Data.Long(A:&cdm_ras_des_ec_info_common0+0x8)&(&mask_0))>>4.)
IF (&val_0!=0.)
    PRINT "[cdm_ras_des_ec_info_common0:0x464] V:",FORMAT.HEX(0.,&val_0),"_"," : pm_in_l1_abort: Level: L1.2 abort"
&mask_0 = 0x2
&val_0 = ((Data.Long(A:&cdm_ras_des_ec_info_common0+0x8)&(&mask_0))>>5.)
IF (&val_0!=0.)
    PRINT "[cdm_ras_des_ec_info_common0:0x464] V:",FORMAT.HEX(0.,&val_0),"_"," : smlh_in_l23: Level: L2 Entry"
&mask_0 = 0x4
&val_0 = ((Data.Long(A:&cdm_ras_des_ec_info_common0+0x8)&(&mask_0))>>6.)
IF (&val_0!=0.)
    PRINT "[cdm_ras_des_ec_info_common0:0x464] V:",FORMAT.HEX(0.,&val_0),"_"," : smlh_spd_change: Pulse: Speed Change"
&mask_0 = 0x8
&val_0 = ((Data.Long(A:&cdm_ras_des_ec_info_common0+0x8)&(&mask_0))>>7.)
IF (&val_0!=0.)
    PRINT "[cdm_ras_des_ec_info_common0:0x464] V:",FORMAT.HEX(0.,&val_0),"_"," : smlh_lwd_change: Pulse: Link width Change"
&mask_0 = 0x1
&val_0 = ((Data.Long(A:&cdm_ras_des_ec_info_common0+0x8)&(&mask_0))>>8.)
IF (&val_0!=0.)
    PRINT "[cdm_ras_des_ec_info_common0:0x464] V:",FORMAT.HEX(0.,&val_0),"_"," : xdlh_ack_sent: Pulse: Tx Ack DLLP"
&mask_0 = 0x2
&val_0 = ((Data.Long(A:&cdm_ras_des_ec_info_common0+0x8)&(&mask_0))>>9.)
IF (&val_0!=0.)
    PRINT "[cdm_ras_des_ec_info_common0:0x464] V:",FORMAT.HEX(0.,&val_0),"_"," : xdlh_update_fc_sent: Pulse: Tx Update FC DLLP"
&mask_0 = 0x3fc
&val_0 = ((Data.Long(A:&cdm_ras_des_ec_info_common0+0x8)&(&mask_0))>>10.)
IF (&val_0!=0.)
    PRINT "[cdm_ras_des_ec_info_common0:0x464] V:",FORMAT.HEX(0.,&val_0),"_"," : rdlh_rcvd_ack_perdllp: Pulse: Rx Ack DLLP"
&mask_0 = 0x3fc
&val_0 = ((Data.Long(A:&cdm_ras_des_ec_info_common0+0x8)&(&mask_0))>>18.)
IF (&val_0!=0.)
    PRINT "[cdm_ras_des_ec_info_common0:0x464] V:",FORMAT.HEX(0.,&val_0),"_"," : rtlh_rcvd_ufc_perdllp: Pulse: Rx Update FC DLLP"
&mask_0 = 0x3c
&val_0 = ((Data.Long(A:&cdm_ras_des_ec_info_common0+0x8)&(&mask_0))>>26.)
IF (&val_0!=0.)
    PRINT "[cdm_ras_des_ec_info_common0:0x464] V:",FORMAT.HEX(0.,&val_0),"_"," : rdlh_nulified_tlp_err_pertlp : Pulse: Rx Nullified TLP"
&mask_0 = 0x4
&val_0 = ((Data.Long(A:&cdm_ras_des_ec_info_common0+0x8)&(&mask_0))>>30.)
IF (&val_0!=0.)
    PRINT "[cdm_ras_des_ec_info_common0:0x464] V:",FORMAT.HEX(0.,&val_0),"_"," : xtlh_xadm_restore_enable: Pulse: Tx Nullified TLP"
&mask_0 = 0x8
&val_0 = ((Data.Long(A:&cdm_ras_des_ec_info_common0+0x8)&(&mask_0))>>31.)
IF (&val_0!=0.)
    PRINT "[cdm_ras_des_ec_info_common0:0x464] V:",FORMAT.HEX(0.,&val_0),"_"," : rdlh_duplicate_tlp_err_pertlp: Pulse: Rx Duplicate TLP"
&mask_0 = 0x7
&val_0 = ((Data.Long(A:&cdm_ras_des_ec_info_common0+0xc)&(&mask_0))>>0.)
IF (&val_0!=0.)
    PRINT "[cdm_ras_des_ec_info_common0:0x468] V:",FORMAT.HEX(0.,&val_0),"_"," : rdlh_duplicate_tlp_err_pertlp: Pulse: Rx Duplicate TLP"
&mask_0 = 0x18
&val_0 = ((Data.Long(A:&cdm_ras_des_ec_info_common0+0xc)&(&mask_0))>>3.)
IF (&val_0!=0.)
    PRINT "[cdm_ras_des_ec_info_common0:0x468] V:",FORMAT.HEX(0.,&val_0),"_"," : xtlh_tx_memwr_evt: Pulse: Tx Memory Write"
&mask_0 = 0x6
&val_0 = ((Data.Long(A:&cdm_ras_des_ec_info_common0+0xc)&(&mask_0))>>5.)
IF (&val_0!=0.)
    PRINT "[cdm_ras_des_ec_info_common0:0x468] V:",FORMAT.HEX(0.,&val_0),"_"," : xtlh_tx_memrd_evt: Pulse: Tx Memory Read"
&mask_0 = 0x18
&val_0 = ((Data.Long(A:&cdm_ras_des_ec_info_common0+0xc)&(&mask_0))>>7.)
IF (&val_0!=0.)
    PRINT "[cdm_ras_des_ec_info_common0:0x468] V:",FORMAT.HEX(0.,&val_0),"_"," : xtlh_tx_cfgwr_evt: Pulse: Tx Config Write"
&mask_0 = 0x6
&val_0 = ((Data.Long(A:&cdm_ras_des_ec_info_common0+0xc)&(&mask_0))>>9.)
IF (&val_0!=0.)
    PRINT "[cdm_ras_des_ec_info_common0:0x468] V:",FORMAT.HEX(0.,&val_0),"_"," : xtlh_tx_cfgrd_evt: Pulse: Tx Config Read"
&mask_0 = 0x18
&val_0 = ((Data.Long(A:&cdm_ras_des_ec_info_common0+0xc)&(&mask_0))>>11.)
IF (&val_0!=0.)
    PRINT "[cdm_ras_des_ec_info_common0:0x468] V:",FORMAT.HEX(0.,&val_0),"_"," : xtlh_tx_iowr_evt: Pulse: Tx IO Write"
&mask_0 = 0x6
&val_0 = ((Data.Long(A:&cdm_ras_des_ec_info_common0+0xc)&(&mask_0))>>13.)
IF (&val_0!=0.)
    PRINT "[cdm_ras_des_ec_info_common0:0x468] V:",FORMAT.HEX(0.,&val_0),"_"," : xtlh_tx_iord_evt: Pulse: Tx IO Read"
&mask_0 = 0x18
&val_0 = ((Data.Long(A:&cdm_ras_des_ec_info_common0+0xc)&(&mask_0))>>15.)
IF (&val_0!=0.)
    PRINT "[cdm_ras_des_ec_info_common0:0x468] V:",FORMAT.HEX(0.,&val_0),"_"," : xtlh_tx_cplwod_evt: Pulse: Tx Completion wo data"
&mask_0 = 0x6
&val_0 = ((Data.Long(A:&cdm_ras_des_ec_info_common0+0xc)&(&mask_0))>>17.)
IF (&val_0!=0.)
    PRINT "[cdm_ras_des_ec_info_common0:0x468] V:",FORMAT.HEX(0.,&val_0),"_"," : xtlh_tx_cplwd_evt: Pulse: Tx Completion w data"
&mask_0 = 0x18
&val_0 = ((Data.Long(A:&cdm_ras_des_ec_info_common0+0xc)&(&mask_0))>>19.)
IF (&val_0!=0.)
    PRINT "[cdm_ras_des_ec_info_common0:0x468] V:",FORMAT.HEX(0.,&val_0),"_"," : xtlh_tx_msg_evt: Pulse: Tx Message"
&mask_0 = 0x6
&val_0 = ((Data.Long(A:&cdm_ras_des_ec_info_common0+0xc)&(&mask_0))>>21.)
IF (&val_0!=0.)
    PRINT "[cdm_ras_des_ec_info_common0:0x468] V:",FORMAT.HEX(0.,&val_0),"_"," : xtlh_tx_atmcop_evt: Pulse: Tx AtomicOp"
&mask_0 = 0x18
&val_0 = ((Data.Long(A:&cdm_ras_des_ec_info_common0+0xc)&(&mask_0))>>23.)
IF (&val_0!=0.)
    PRINT "[cdm_ras_des_ec_info_common0:0x468] V:",FORMAT.HEX(0.,&val_0),"_"," : xtlh_tx_tlpwprefix_evt: Pulse: Tx TLP with Prefix"
&mask_0 = 0x1e
&val_0 = ((Data.Long(A:&cdm_ras_des_ec_info_common0+0xc)&(&mask_0))>>25.)
IF (&val_0!=0.)
    PRINT "[cdm_ras_des_ec_info_common0:0x468] V:",FORMAT.HEX(0.,&val_0),"_"," : rtlh_rx_memwr_evt: Pulse: Rx Memory Write"
&mask_0 = 0xe
&val_0 = ((Data.Long(A:&cdm_ras_des_ec_info_common0+0xc)&(&mask_0))>>29.)
IF (&val_0!=0.)
    PRINT "[cdm_ras_des_ec_info_common0:0x468] V:",FORMAT.HEX(0.,&val_0),"_"," : rtlh_rx_memrd_evt: Pulse: Rx Memory Read"
&mask_0 = 0x1
&val_0 = ((Data.Long(A:&cdm_ras_des_ec_info_common0+0x10)&(&mask_0))>>0.)
IF (&val_0!=0.)
    PRINT "[cdm_ras_des_ec_info_common0:0x46c] V:",FORMAT.HEX(0.,&val_0),"_"," : rtlh_rx_memrd_evt: Pulse: Rx Memory Read+J402"
&mask_0 = 0x1e
&val_0 = ((Data.Long(A:&cdm_ras_des_ec_info_common0+0x10)&(&mask_0))>>1.)
IF (&val_0!=0.)
    PRINT "[cdm_ras_des_ec_info_common0:0x46c] V:",FORMAT.HEX(0.,&val_0),"_"," : rtlh_rx_cfgwr_evt: Pulse: Rx Config Write"
&mask_0 = 0x1e
&val_0 = ((Data.Long(A:&cdm_ras_des_ec_info_common0+0x10)&(&mask_0))>>5.)
IF (&val_0!=0.)
    PRINT "[cdm_ras_des_ec_info_common0:0x46c] V:",FORMAT.HEX(0.,&val_0),"_"," : rtlh_rx_cfgrd_evt: Pulse: Rx Config Read"
&mask_0 = 0x1e
&val_0 = ((Data.Long(A:&cdm_ras_des_ec_info_common0+0x10)&(&mask_0))>>9.)
IF (&val_0!=0.)
    PRINT "[cdm_ras_des_ec_info_common0:0x46c] V:",FORMAT.HEX(0.,&val_0),"_"," : rtlh_rx_iowr_evt: Pulse: Rx IO Write"
&mask_0 = 0x1e
&val_0 = ((Data.Long(A:&cdm_ras_des_ec_info_common0+0x10)&(&mask_0))>>13.)
IF (&val_0!=0.)
    PRINT "[cdm_ras_des_ec_info_common0:0x46c] V:",FORMAT.HEX(0.,&val_0),"_"," : rtlh_rx_iord_evt: Pulse: Rx IO Read"
&mask_0 = 0x1e
&val_0 = ((Data.Long(A:&cdm_ras_des_ec_info_common0+0x10)&(&mask_0))>>17.)
IF (&val_0!=0.)
    PRINT "[cdm_ras_des_ec_info_common0:0x46c] V:",FORMAT.HEX(0.,&val_0),"_"," : rtlh_rx_cplwod_evt: Pulse: Rx Completion wo data"
&mask_0 = 0x1e
&val_0 = ((Data.Long(A:&cdm_ras_des_ec_info_common0+0x10)&(&mask_0))>>21.)
IF (&val_0!=0.)
    PRINT "[cdm_ras_des_ec_info_common0:0x46c] V:",FORMAT.HEX(0.,&val_0),"_"," : rtlh_rx_cplwd_evt: Pulse: Rx Completion w data"
&mask_0 = 0x1e
&val_0 = ((Data.Long(A:&cdm_ras_des_ec_info_common0+0x10)&(&mask_0))>>25.)
IF (&val_0!=0.)
    PRINT "[cdm_ras_des_ec_info_common0:0x46c] V:",FORMAT.HEX(0.,&val_0),"_"," : rtlh_rx_msg_evt: Pulse: Rx Message TLP"
&mask_0 = 0xe
&val_0 = ((Data.Long(A:&cdm_ras_des_ec_info_common0+0x10)&(&mask_0))>>29.)
IF (&val_0!=0.)
    PRINT "[cdm_ras_des_ec_info_common0:0x46c] V:",FORMAT.HEX(0.,&val_0),"_"," : rtlh_rx_atmcop_evt: Pulse: Rx Atomic"
&mask_0 = 0x1
&val_0 = ((Data.Long(A:&cdm_ras_des_ec_info_common0+0x14)&(&mask_0))>>0.)
IF (&val_0!=0.)
    PRINT "[cdm_ras_des_ec_info_common0:0x470] V:",FORMAT.HEX(0.,&val_0),"_"," : rtlh_rx_atmcop_evt: Pulse: Rx Atomic"
&mask_0 = 0x1e
&val_0 = ((Data.Long(A:&cdm_ras_des_ec_info_common0+0x14)&(&mask_0))>>1.)
IF (&val_0!=0.)
    PRINT "[cdm_ras_des_ec_info_common0:0x470] V:",FORMAT.HEX(0.,&val_0),"_"," : rtlh_rx_tlpwprefix_evt: Pulse: Rx TLP with Prefix"
&mask_0 = 0x6
&val_0 = ((Data.Long(A:&cdm_ras_des_ec_info_common0+0x14)&(&mask_0))>>5.)
IF (&val_0!=0.)
    PRINT "[cdm_ras_des_ec_info_common0:0x470] V:",FORMAT.HEX(0.,&val_0),"_"," : xtlh_tx_ccix_tlp_evt: Pulse: Tx CCIX TLP"
&mask_0 = 0x78
&val_0 = ((Data.Long(A:&cdm_ras_des_ec_info_common0+0x14)&(&mask_0))>>7.)
IF (&val_0!=0.)
    PRINT "[cdm_ras_des_ec_info_common0:0x470] V:",FORMAT.HEX(0.,&val_0),"_"," : rtlh_rx_ccix_tlp_evt: Pulse: Rx CCIX TLP"
&mask_0 = 0x18
&val_0 = ((Data.Long(A:&cdm_ras_des_ec_info_common0+0x14)&(&mask_0))>>11.)
IF (&val_0!=0.)
    PRINT "[cdm_ras_des_ec_info_common0:0x470] V:",FORMAT.HEX(0.,&val_0),"_"," : xtlh_tx_defmemwr_evt: Pulse: Tx Deferrable Memory Write "
&mask_0 = 0x1e
&val_0 = ((Data.Long(A:&cdm_ras_des_ec_info_common0+0x14)&(&mask_0))>>13.)
IF (&val_0!=0.)
    PRINT "[cdm_ras_des_ec_info_common0:0x470] V:",FORMAT.HEX(0.,&val_0),"_"," : rtlh_rx_defmemwr_evt: Pulse: Rx Deferrable Memory Write"

;=================================================================================================
; Register:acc_ras_ec_lxx_ro00, Member: ['cdm_ras_des_ec_info_l0', 'RESERVED_26']
;=================================================================================================
&cdm_ras_des_ec_info_l0 = 0xC1000000+0x474
&mask = 0x1
&val  = ((Data.Long(A:&cdm_ras_des_ec_info_l0)&(&mask))>>0.)
IF &val!=0.
    PRINT "[cdm_ras_des_ec_info_l0:0x474] V:", &val, " : l0_rmlh_ebuf_rxoverflow: Pulse: EBUF Overflow"
&mask = 0x2
&val  = ((Data.Long(A:&cdm_ras_des_ec_info_l0)&(&mask))>>1.)
IF &val!=0.
    PRINT "[cdm_ras_des_ec_info_l0:0x474] V:", &val, " : l0_rmlh_ebuf_rxunderflow: Pulse: EBUF underrun"
&mask = 0x4
&val  = ((Data.Long(A:&cdm_ras_des_ec_info_l0)&(&mask))>>2.)
IF &val!=0.
    PRINT "[cdm_ras_des_ec_info_l0:0x474] V:", &val, " : l0_rmlh_phy_rxcodeerror: Pulse: Decode Error"
&mask = 0x8
&val  = ((Data.Long(A:&cdm_ras_des_ec_info_l0)&(&mask))>>3.)
IF &val!=0.
    PRINT "[cdm_ras_des_ec_info_l0:0x474] V:", &val, " : l0_rmlh_phy_rxdisperror: Pulse: Running Disparity Error"
&mask = 0x10
&val  = ((Data.Long(A:&cdm_ras_des_ec_info_l0)&(&mask))>>4.)
IF &val!=0.
    PRINT "[cdm_ras_des_ec_info_l0:0x474] V:", &val, " : l0_rmlh_skp_parity_err: Pulse: SKP OS Parity Error"
&mask = 0x20
&val  = ((Data.Long(A:&cdm_ras_des_ec_info_l0)&(&mask))>>5.)
IF &val!=0.
    PRINT "[cdm_ras_des_ec_info_l0:0x474] V:", &val, " : l0_rmlh_sync_header_err: Pulse: SYNC Header Error"
&mask = 0x40
&val  = ((Data.Long(A:&cdm_ras_des_ec_info_l0)&(&mask))>>6.)
IF &val!=0.
    PRINT "[cdm_ras_des_ec_info_l0:0x474] V:", &val, " : l0_rmlh_rxvalid_deasserted: Pulse: Rx Valid de-assertion"
&mask = 0x80
&val  = ((Data.Long(A:&cdm_ras_des_ec_info_l0)&(&mask))>>7.)
IF &val!=0.
    PRINT "[cdm_ras_des_ec_info_l0:0x474] V:", &val, " : l0_rmlh_ebuf_rxskipadded: Pulse: EBUF SKP Add"
&mask = 0x100
&val  = ((Data.Long(A:&cdm_ras_des_ec_info_l0)&(&mask))>>8.)
IF &val!=0.
    PRINT "[cdm_ras_des_ec_info_l0:0x474] V:", &val, " : l0_rmlh_ebuf_rxskipremoved: Pulse: EBUF SKP Del"
&mask = 0x200
&val  = ((Data.Long(A:&cdm_ras_des_ec_info_l0)&(&mask))>>9.)
IF &val!=0.
    PRINT "[cdm_ras_des_ec_info_l0:0x474] V:", &val, " : l0_rmlh_deskew_ctlskp_err[i*5]: Pulse: CTL SKP OS Data Parity Error"
&mask = 0x400
&val  = ((Data.Long(A:&cdm_ras_des_ec_info_l0)&(&mask))>>10.)
IF &val!=0.
    PRINT "[cdm_ras_des_ec_info_l0:0x474] V:", &val, " : l0_rmlh_deskew_ctlskp_err[i*5+1]: Pulse: 1st Retimer Parity Error"
&mask = 0x800
&val  = ((Data.Long(A:&cdm_ras_des_ec_info_l0)&(&mask))>>11.)
IF &val!=0.
    PRINT "[cdm_ras_des_ec_info_l0:0x474] V:", &val, " : l0_rmlh_deskew_ctlskp_err[i*5+2]: Pulse: 2nd Retimer Parity Error"
&mask = 0x1000
&val  = ((Data.Long(A:&cdm_ras_des_ec_info_l0)&(&mask))>>12.)
IF &val!=0.
    PRINT "[cdm_ras_des_ec_info_l0:0x474] V:", &val, " : l0_rmlh_deskew_ctlskp_err[i*5+4:i*5+3]: Pulse: Margin CRC and Parity Error"
&mask = 0x2000
&val  = ((Data.Long(A:&cdm_ras_des_ec_info_l0)&(&mask))>>13.)
IF &val!=0.
    PRINT "[cdm_ras_des_ec_info_l0:0x474] V:", &val, " : l1_rmlh_ebuf_rxoverflow: Pulse: EBUF Overflow"
&mask = 0x4000
&val  = ((Data.Long(A:&cdm_ras_des_ec_info_l0)&(&mask))>>14.)
IF &val!=0.
    PRINT "[cdm_ras_des_ec_info_l0:0x474] V:", &val, " : l1_rmlh_ebuf_rxunderflow: Pulse: EBUF underrun"
&mask = 0x8000
&val  = ((Data.Long(A:&cdm_ras_des_ec_info_l0)&(&mask))>>15.)
IF &val!=0.
    PRINT "[cdm_ras_des_ec_info_l0:0x474] V:", &val, " : l1_rmlh_phy_rxcodeerror: Pulse: Decode Error"
&mask = 0x10000
&val  = ((Data.Long(A:&cdm_ras_des_ec_info_l0)&(&mask))>>16.)
IF &val!=0.
    PRINT "[cdm_ras_des_ec_info_l0:0x474] V:", &val, " : l1_rmlh_phy_rxdisperror: Pulse: Running Disparity Error"
&mask = 0x20000
&val  = ((Data.Long(A:&cdm_ras_des_ec_info_l0)&(&mask))>>17.)
IF &val!=0.
    PRINT "[cdm_ras_des_ec_info_l0:0x474] V:", &val, " : l1_rmlh_skp_parity_err: Pulse: SKP OS Parity Error"
&mask = 0x40000
&val  = ((Data.Long(A:&cdm_ras_des_ec_info_l0)&(&mask))>>18.)
IF &val!=0.
    PRINT "[cdm_ras_des_ec_info_l0:0x474] V:", &val, " : l1_rmlh_sync_header_err: Pulse: SYNC Header Error"
&mask = 0x80000
&val  = ((Data.Long(A:&cdm_ras_des_ec_info_l0)&(&mask))>>19.)
IF &val!=0.
    PRINT "[cdm_ras_des_ec_info_l0:0x474] V:", &val, " : l1_rmlh_rxvalid_deasserted: Pulse: Rx Valid de-assertion"
&mask = 0x100000
&val  = ((Data.Long(A:&cdm_ras_des_ec_info_l0)&(&mask))>>20.)
IF &val!=0.
    PRINT "[cdm_ras_des_ec_info_l0:0x474] V:", &val, " : l1_rmlh_ebuf_rxskipadded: Pulse: EBUF SKP Add"
&mask = 0x200000
&val  = ((Data.Long(A:&cdm_ras_des_ec_info_l0)&(&mask))>>21.)
IF &val!=0.
    PRINT "[cdm_ras_des_ec_info_l0:0x474] V:", &val, " : l1_rmlh_ebuf_rxskipremoved: Pulse: EBUF SKP Del"
&mask = 0x400000
&val  = ((Data.Long(A:&cdm_ras_des_ec_info_l0)&(&mask))>>22.)
IF &val!=0.
    PRINT "[cdm_ras_des_ec_info_l0:0x474] V:", &val, " : l1_rmlh_deskew_ctlskp_err[i*5]: Pulse: CTL SKP OS Data Parity Error"
&mask = 0x800000
&val  = ((Data.Long(A:&cdm_ras_des_ec_info_l0)&(&mask))>>23.)
IF &val!=0.
    PRINT "[cdm_ras_des_ec_info_l0:0x474] V:", &val, " : l1_rmlh_deskew_ctlskp_err[i*5+1]: Pulse: 1st Retimer Parity Error"
&mask = 0x1000000
&val  = ((Data.Long(A:&cdm_ras_des_ec_info_l0)&(&mask))>>24.)
IF &val!=0.
    PRINT "[cdm_ras_des_ec_info_l0:0x474] V:", &val, " : l1_rmlh_deskew_ctlskp_err[i*5+2]: Pulse: 2nd Retimer Parity Error"
&mask = 0x2000000
&val  = ((Data.Long(A:&cdm_ras_des_ec_info_l0)&(&mask))>>25.)
IF &val!=0.
    PRINT "[cdm_ras_des_ec_info_l0:0x474] V:", &val, " : l1_rmlh_deskew_ctlskp_err[i*5+4:i*5+3]: Pulse: Margin CRC and Parity Error"

;=================================================================================================
; Register:acc_ras_ec_lxx_ro01, Member: ['cdm_ras_des_ec_info_l2', 'RESERVED_26']
;=================================================================================================
&cdm_ras_des_ec_info_l2 = 0xC1000000+0x478
&mask = 0x1
&val  = ((Data.Long(A:&cdm_ras_des_ec_info_l2)&(&mask))>>0.)
IF &val!=0.
    PRINT "[cdm_ras_des_ec_info_l2:0x478] V:", &val, " : l2_rmlh_ebuf_rxoverflow: Pulse: EBUF Overflow"
&mask = 0x2
&val  = ((Data.Long(A:&cdm_ras_des_ec_info_l2)&(&mask))>>1.)
IF &val!=0.
    PRINT "[cdm_ras_des_ec_info_l2:0x478] V:", &val, " : l2_rmlh_ebuf_rxunderflow: Pulse: EBUF underrun"
&mask = 0x4
&val  = ((Data.Long(A:&cdm_ras_des_ec_info_l2)&(&mask))>>2.)
IF &val!=0.
    PRINT "[cdm_ras_des_ec_info_l2:0x478] V:", &val, " : l2_rmlh_phy_rxcodeerror: Pulse: Decode Error"
&mask = 0x8
&val  = ((Data.Long(A:&cdm_ras_des_ec_info_l2)&(&mask))>>3.)
IF &val!=0.
    PRINT "[cdm_ras_des_ec_info_l2:0x478] V:", &val, " : l2_rmlh_phy_rxdisperror: Pulse: Running Disparity Error"
&mask = 0x10
&val  = ((Data.Long(A:&cdm_ras_des_ec_info_l2)&(&mask))>>4.)
IF &val!=0.
    PRINT "[cdm_ras_des_ec_info_l2:0x478] V:", &val, " : l2_rmlh_skp_parity_err: Pulse: SKP OS Parity Error"
&mask = 0x20
&val  = ((Data.Long(A:&cdm_ras_des_ec_info_l2)&(&mask))>>5.)
IF &val!=0.
    PRINT "[cdm_ras_des_ec_info_l2:0x478] V:", &val, " : l2_rmlh_sync_header_err: Pulse: SYNC Header Error"
&mask = 0x40
&val  = ((Data.Long(A:&cdm_ras_des_ec_info_l2)&(&mask))>>6.)
IF &val!=0.
    PRINT "[cdm_ras_des_ec_info_l2:0x478] V:", &val, " : l2_rmlh_rxvalid_deasserted: Pulse: Rx Valid de-assertion"
&mask = 0x80
&val  = ((Data.Long(A:&cdm_ras_des_ec_info_l2)&(&mask))>>7.)
IF &val!=0.
    PRINT "[cdm_ras_des_ec_info_l2:0x478] V:", &val, " : l2_rmlh_ebuf_rxskipadded: Pulse: EBUF SKP Add"
&mask = 0x100
&val  = ((Data.Long(A:&cdm_ras_des_ec_info_l2)&(&mask))>>8.)
IF &val!=0.
    PRINT "[cdm_ras_des_ec_info_l2:0x478] V:", &val, " : l2_rmlh_ebuf_rxskipremoved: Pulse: EBUF SKP Del"
&mask = 0x200
&val  = ((Data.Long(A:&cdm_ras_des_ec_info_l2)&(&mask))>>9.)
IF &val!=0.
    PRINT "[cdm_ras_des_ec_info_l2:0x478] V:", &val, " : l2_rmlh_deskew_ctlskp_err[i*5]: Pulse: CTL SKP OS Data Parity Error"
&mask = 0x400
&val  = ((Data.Long(A:&cdm_ras_des_ec_info_l2)&(&mask))>>10.)
IF &val!=0.
    PRINT "[cdm_ras_des_ec_info_l2:0x478] V:", &val, " : l2_rmlh_deskew_ctlskp_err[i*5+1]: Pulse: 1st Retimer Parity Error"
&mask = 0x800
&val  = ((Data.Long(A:&cdm_ras_des_ec_info_l2)&(&mask))>>11.)
IF &val!=0.
    PRINT "[cdm_ras_des_ec_info_l2:0x478] V:", &val, " : l2_rmlh_deskew_ctlskp_err[i*5+2]: Pulse: 2nd Retimer Parity Error"
&mask = 0x1000
&val  = ((Data.Long(A:&cdm_ras_des_ec_info_l2)&(&mask))>>12.)
IF &val!=0.
    PRINT "[cdm_ras_des_ec_info_l2:0x478] V:", &val, " : l2_rmlh_deskew_ctlskp_err[i*5+4:i*5+3]: Pulse: Margin CRC and Parity Error"
&mask = 0x2000
&val  = ((Data.Long(A:&cdm_ras_des_ec_info_l2)&(&mask))>>13.)
IF &val!=0.
    PRINT "[cdm_ras_des_ec_info_l2:0x478] V:", &val, " : l3_rmlh_ebuf_rxoverflow: Pulse: EBUF Overflow"
&mask = 0x4000
&val  = ((Data.Long(A:&cdm_ras_des_ec_info_l2)&(&mask))>>14.)
IF &val!=0.
    PRINT "[cdm_ras_des_ec_info_l2:0x478] V:", &val, " : l3_rmlh_ebuf_rxunderflow: Pulse: EBUF underrun"
&mask = 0x8000
&val  = ((Data.Long(A:&cdm_ras_des_ec_info_l2)&(&mask))>>15.)
IF &val!=0.
    PRINT "[cdm_ras_des_ec_info_l2:0x478] V:", &val, " : l3_rmlh_phy_rxcodeerror: Pulse: Decode Error"
&mask = 0x10000
&val  = ((Data.Long(A:&cdm_ras_des_ec_info_l2)&(&mask))>>16.)
IF &val!=0.
    PRINT "[cdm_ras_des_ec_info_l2:0x478] V:", &val, " : l3_rmlh_phy_rxdisperror: Pulse: Running Disparity Error"
&mask = 0x20000
&val  = ((Data.Long(A:&cdm_ras_des_ec_info_l2)&(&mask))>>17.)
IF &val!=0.
    PRINT "[cdm_ras_des_ec_info_l2:0x478] V:", &val, " : l3_rmlh_skp_parity_err: Pulse: SKP OS Parity Error"
&mask = 0x40000
&val  = ((Data.Long(A:&cdm_ras_des_ec_info_l2)&(&mask))>>18.)
IF &val!=0.
    PRINT "[cdm_ras_des_ec_info_l2:0x478] V:", &val, " : l3_rmlh_sync_header_err: Pulse: SYNC Header Error"
&mask = 0x80000
&val  = ((Data.Long(A:&cdm_ras_des_ec_info_l2)&(&mask))>>19.)
IF &val!=0.
    PRINT "[cdm_ras_des_ec_info_l2:0x478] V:", &val, " : l3_rmlh_rxvalid_deasserted: Pulse: Rx Valid de-assertion"
&mask = 0x100000
&val  = ((Data.Long(A:&cdm_ras_des_ec_info_l2)&(&mask))>>20.)
IF &val!=0.
    PRINT "[cdm_ras_des_ec_info_l2:0x478] V:", &val, " : l3_rmlh_ebuf_rxskipadded: Pulse: EBUF SKP Add"
&mask = 0x200000
&val  = ((Data.Long(A:&cdm_ras_des_ec_info_l2)&(&mask))>>21.)
IF &val!=0.
    PRINT "[cdm_ras_des_ec_info_l2:0x478] V:", &val, " : l3_rmlh_ebuf_rxskipremoved: Pulse: EBUF SKP Del"
&mask = 0x400000
&val  = ((Data.Long(A:&cdm_ras_des_ec_info_l2)&(&mask))>>22.)
IF &val!=0.
    PRINT "[cdm_ras_des_ec_info_l2:0x478] V:", &val, " : l3_rmlh_deskew_ctlskp_err[i*5]: Pulse: CTL SKP OS Data Parity Error"
&mask = 0x800000
&val  = ((Data.Long(A:&cdm_ras_des_ec_info_l2)&(&mask))>>23.)
IF &val!=0.
    PRINT "[cdm_ras_des_ec_info_l2:0x478] V:", &val, " : l3_rmlh_deskew_ctlskp_err[i*5+1]: Pulse: 1st Retimer Parity Error"
&mask = 0x1000000
&val  = ((Data.Long(A:&cdm_ras_des_ec_info_l2)&(&mask))>>24.)
IF &val!=0.
    PRINT "[cdm_ras_des_ec_info_l2:0x478] V:", &val, " : l3_rmlh_deskew_ctlskp_err[i*5+2]: Pulse: 2nd Retimer Parity Error"
&mask = 0x2000000
&val  = ((Data.Long(A:&cdm_ras_des_ec_info_l2)&(&mask))>>25.)
IF &val!=0.
    PRINT "[cdm_ras_des_ec_info_l2:0x478] V:", &val, " : l3_rmlh_deskew_ctlskp_err[i*5+4:i*5+3]: Pulse: Margin CRC and Parity Error"

;=================================================================================================
; Register:acc_ras_sd_com_ro00, Member: ['cdm_ras_des_sd_info_common0']
;=================================================================================================
&cdm_ras_des_sd_info_common0 = 0xC1000000+0x47c
&mask = 0x1f
&val  = ((Data.Long(A:&cdm_ras_des_sd_info_common0)&(&mask))>>0.)
IF &val!=0.
    PRINT "[cdm_ras_des_sd_info_common0:0x47c] V:", &val, " : pm_master_state[4:0]: Level: PM Internal State (Master)"
&mask = 0x1e0
&val  = ((Data.Long(A:&cdm_ras_des_sd_info_common0)&(&mask))>>5.)
IF &val!=0.
    PRINT "[cdm_ras_des_sd_info_common0:0x47c] V:", &val, " : pm_slave_state[3:0]: Level: PM Internal State (Slave)"
&mask = 0xfe00
&val  = ((Data.Long(A:&cdm_ras_des_sd_info_common0)&(&mask))>>9.)
IF &val!=0.
    PRINT "[cdm_ras_des_sd_info_common0:0x47c] V:", &val, " : rmlh_framing_err_ptr[6:0]: Pulse: 1st Framing Error Pointer"
&mask = 0x10000
&val  = ((Data.Long(A:&cdm_ras_des_sd_info_common0)&(&mask))>>16.)
IF &val!=0.
    PRINT "[cdm_ras_des_sd_info_common0:0x47c] V:", &val, " : smlh_lane_reversed: Level: Lane Reversal Operation"
&mask = 0x20000
&val  = ((Data.Long(A:&cdm_ras_des_sd_info_common0)&(&mask))>>17.)
IF &val!=0.
    PRINT "[cdm_ras_des_sd_info_common0:0x47c] V:", &val, " : pm_pme_resend_flag: Pulse: PME Re-Send flag"
&mask = 0xfffc0000
&val  = ((Data.Long(A:&cdm_ras_des_sd_info_common0)&(&mask))>>18.)
IF &val!=0.
    PRINT "[cdm_ras_des_sd_info_common0:0x47c] V:", &val, " : smlh_ltssm_variable [15:0]: Level: LTSSM Variable"
&mask_0 = 0x3
&val_0 = ((Data.Long(A:&cdm_ras_des_sd_info_common0+0x0)&(&mask_0))>>0.)
IF (&val_0!=0.)
    PRINT "[cdm_ras_des_sd_info_common0:0x47c] V:",FORMAT.HEX(0.,&val_0),"_"," : smlh_ltssm_variable [15:0]: Level: LTSSM Variable"
&mask_0 = 0x1c
&val_0 = ((Data.Long(A:&cdm_ras_des_sd_info_common0+0x4)&(&mask_0))>>2.)
IF (&val_0!=0.)
    PRINT "[cdm_ras_des_sd_info_common0:0x480] V:",FORMAT.HEX(0.,&val_0),"_"," : ltssm_powerdown[1:0]: Level: PIPE: Power Down"
&mask_0 = 0x1fe
&val_0 = ((Data.Long(A:&cdm_ras_des_sd_info_common0+0x4)&(&mask_0))>>5.)
IF (&val_0!=0.)
    PRINT "[cdm_ras_des_sd_info_common0:0x480] V:",FORMAT.HEX(0.,&val_0),"_"," : latched_ts_nfts[7:0]: Level: Latched NFTS"
&mask_0 = 0x6
&val_0 = ((Data.Long(A:&cdm_ras_des_sd_info_common0+0x4)&(&mask_0))>>13.)
IF (&val_0!=0.)
    PRINT "[cdm_ras_des_sd_info_common0:0x480] V:",FORMAT.HEX(0.,&val_0),"_"," : rdlh_dlcntrl_state [1:0]: Level: DLCM"
&mask_0 = 0x8
&val_0 = ((Data.Long(A:&cdm_ras_des_sd_info_common0+0x4)&(&mask_0))>>15.)
IF (&val_0!=0.)
    PRINT "[cdm_ras_des_sd_info_common0:0x480] V:",FORMAT.HEX(0.,&val_0),"_"," : rdlh_vc0_initfc1_status: Level: Init-FC Flag1 VC0"
&mask_0 = 0x1
&val_0 = ((Data.Long(A:&cdm_ras_des_sd_info_common0+0x4)&(&mask_0))>>16.)
IF (&val_0!=0.)
    PRINT "[cdm_ras_des_sd_info_common0:0x480] V:",FORMAT.HEX(0.,&val_0),"_"," : rdlh_vc0_initfc2_status: Level: Init-FC Flag2 VC0"
&mask_0 = 0x1ffe
&val_0 = ((Data.Long(A:&cdm_ras_des_sd_info_common0+0x4)&(&mask_0))>>17.)
IF (&val_0!=0.)
    PRINT "[cdm_ras_des_sd_info_common0:0x480] V:",FORMAT.HEX(0.,&val_0),"_"," : rdlh_curnt_rx_ack_seqnum[11:0]: Level: Rx ACK SEQ#"
&mask_0 = 0xe
&val_0 = ((Data.Long(A:&cdm_ras_des_sd_info_common0+0x4)&(&mask_0))>>29.)
IF (&val_0!=0.)
    PRINT "[cdm_ras_des_sd_info_common0:0x480] V:",FORMAT.HEX(0.,&val_0),"_"," : xdlh_curnt_seqnum [11:0]: Level: Tx TLP SEQ#"
&mask_0 = 0x1ff
&val_0 = ((Data.Long(A:&cdm_ras_des_sd_info_common0+0x8)&(&mask_0))>>0.)
IF (&val_0!=0.)
    PRINT "[cdm_ras_des_sd_info_common0:0x484] V:",FORMAT.HEX(0.,&val_0),"_"," : xdlh_curnt_seqnum [11:0]: Level: Tx TLP SEQ#"
&mask_0 = 0x2
&val_0 = ((Data.Long(A:&cdm_ras_des_sd_info_common0+0x8)&(&mask_0))>>9.)
IF (&val_0!=0.)
    PRINT "[cdm_ras_des_sd_info_common0:0x484] V:",FORMAT.HEX(0.,&val_0),"_"," : init_eq_pending: Level: Equalization sequence Gen3"
&mask_0 = 0x4
&val_0 = ((Data.Long(A:&cdm_ras_des_sd_info_common0+0x8)&(&mask_0))>>10.)
IF (&val_0!=0.)
    PRINT "[cdm_ras_des_sd_info_common0:0x484] V:",FORMAT.HEX(0.,&val_0),"_"," : init_eq_pending_g4: Level: Equalization sequence Gen4"
&mask_0 = 0x38
&val_0 = ((Data.Long(A:&cdm_ras_des_sd_info_common0+0x8)&(&mask_0))>>11.)
IF (&val_0!=0.)
    PRINT "[cdm_ras_des_sd_info_common0:0x484] V:",FORMAT.HEX(0.,&val_0),"_"," : l1sub_state: Level: L1 sub state"
&mask_0 = 0x4
&val_0 = ((Data.Long(A:&cdm_ras_des_sd_info_common0+0x8)&(&mask_0))>>14.)
IF (&val_0!=0.)
    PRINT "[cdm_ras_des_sd_info_common0:0x484] V:",FORMAT.HEX(0.,&val_0),"_"," : init_eq_pending_g5: Level: Equalization sequence Gen5"

;=================================================================================================
; Register:acc_ras_sd_lxx_ro00, Member: ['cdm_ras_des_sd_info_l000']
;=================================================================================================
&cdm_ras_des_sd_info_l000 = 0xC1000000+0x488
&mask = 0x1
&val  = ((Data.Long(A:&cdm_ras_des_sd_info_l000)&(&mask))>>0.)
IF &val!=0.
    PRINT "[cdm_ras_des_sd_info_l000:0x488] V:", &val, " : mac_phy_txelec_txburst: Level: PIPE: TxElecIdle/TxBurst"
&mask = 0x2
&val  = ((Data.Long(A:&cdm_ras_des_sd_info_l000)&(&mask))>>1.)
IF &val!=0.
    PRINT "[cdm_ras_des_sd_info_l000:0x488] V:", &val, " : phy_mac_rxelec_rxh8exit: Level: PIPE: RxElecIdle/RxHibern8ExitType1"
&mask = 0x4
&val  = ((Data.Long(A:&cdm_ras_des_sd_info_l000)&(&mask))>>2.)
IF &val!=0.
    PRINT "[cdm_ras_des_sd_info_l000:0x488] V:", &val, " : phy_mac_rxvalid_rxburst: Level: PIPE: RxValid/RxBurst"
&mask = 0x8
&val  = ((Data.Long(A:&cdm_ras_des_sd_info_l000)&(&mask))>>3.)
IF &val!=0.
    PRINT "[cdm_ras_des_sd_info_l000:0x488] V:", &val, " : latched_rxdetected: Level: PIPE: Detect Lane"
&mask = 0x10
&val  = ((Data.Long(A:&cdm_ras_des_sd_info_l000)&(&mask))>>4.)
IF &val!=0.
    PRINT "[cdm_ras_des_sd_info_l000:0x488] V:", &val, " : mac_phy_rxpolarity: Level: PIPE: RxPolarity"
&mask = 0x1fe0
&val  = ((Data.Long(A:&cdm_ras_des_sd_info_l000)&(&mask))>>5.)
IF &val!=0.
    PRINT "[cdm_ras_des_sd_info_l000:0x488] V:", &val, " : rmlh_deskew_fifo_ptr: Level: Deskew Pointer"
&mask = 0x7e000
&val  = ((Data.Long(A:&cdm_ras_des_sd_info_l000)&(&mask))>>13.)
IF &val!=0.
    PRINT "[cdm_ras_des_sd_info_l000:0x488] V:", &val, " : mac_cdm_ras_des_fs: Level: Remote Device FS Gen3"
&mask = 0x1f80000
&val  = ((Data.Long(A:&cdm_ras_des_sd_info_l000)&(&mask))>>19.)
IF &val!=0.
    PRINT "[cdm_ras_des_sd_info_l000:0x488] V:", &val, " : mac_cdm_ras_des_lf: Level: Remote Device LF Gen3"
&mask = 0x7e000000
&val  = ((Data.Long(A:&cdm_ras_des_sd_info_l000)&(&mask))>>25.)
IF &val!=0.
    PRINT "[cdm_ras_des_sd_info_l000:0x488] V:", &val, " : mac_cdm_ras_des_coef_rtx[17:12]: Level: Current Remote Transmitter Post Cursor coefficient Gen3"
&mask = 0x80000000
&val  = ((Data.Long(A:&cdm_ras_des_sd_info_l000)&(&mask))>>31.)
IF &val!=0.
    PRINT "[cdm_ras_des_sd_info_l000:0x488] V:", &val, " : mac_cdm_ras_des_coef_rtx[11:6]: Level: Current Remote Transmitter Cursor coefficient Gen3"
&mask_0 = 0x1f
&val_0 = ((Data.Long(A:&cdm_ras_des_sd_info_l000+0x0)&(&mask_0))>>0.)
IF (&val_0!=0.)
    PRINT "[cdm_ras_des_sd_info_l000:0x488] V:",FORMAT.HEX(0.,&val_0),"_"," : mac_cdm_ras_des_coef_rtx[11:6]: Level: Current Remote Transmitter Cursor coefficient Gen3"
&mask_0 = 0x7e
&val_0 = ((Data.Long(A:&cdm_ras_des_sd_info_l000+0x4)&(&mask_0))>>5.)
IF (&val_0!=0.)
    PRINT "[cdm_ras_des_sd_info_l000:0x48c] V:",FORMAT.HEX(0.,&val_0),"_"," : mac_cdm_ras_des_coef_rtx[5:0]: Level: Current Remote Transmitter Pre Cursor coefficient Gen3"
&mask_0 = 0x1f8
&val_0 = ((Data.Long(A:&cdm_ras_des_sd_info_l000+0x4)&(&mask_0))>>11.)
IF (&val_0!=0.)
    PRINT "[cdm_ras_des_sd_info_l000:0x48c] V:",FORMAT.HEX(0.,&val_0),"_"," : mac_cdm_ras_des_coef_ltx[17:12]: Level: Current Local Transmitter Post Cursor coefficient Gen3"
&mask_0 = 0x7e
&val_0 = ((Data.Long(A:&cdm_ras_des_sd_info_l000+0x4)&(&mask_0))>>17.)
IF (&val_0!=0.)
    PRINT "[cdm_ras_des_sd_info_l000:0x48c] V:",FORMAT.HEX(0.,&val_0),"_"," : mac_cdm_ras_des_coef_ltx[11:6]: Level: Current Local Transmitter Cursor coefficient Gen3"
&mask_0 = 0x1f8
&val_0 = ((Data.Long(A:&cdm_ras_des_sd_info_l000+0x4)&(&mask_0))>>23.)
IF (&val_0!=0.)
    PRINT "[cdm_ras_des_sd_info_l000:0x48c] V:",FORMAT.HEX(0.,&val_0),"_"," : mac_cdm_ras_des_coef_ltx[5:0]: Level: Current Local Transmitter Pre Cursor coefficient Gen3"
&mask_0 = 0xe
&val_0 = ((Data.Long(A:&cdm_ras_des_sd_info_l000+0x4)&(&mask_0))>>29.)
IF (&val_0!=0.)
    PRINT "[cdm_ras_des_sd_info_l000:0x48c] V:",FORMAT.HEX(0.,&val_0),"_"," : mac_cdm_ras_des_pset_lrx: Level: Current Local Receiver Preset Hint Gen3"
&mask_0 = 0xff
&val_0 = ((Data.Long(A:&cdm_ras_des_sd_info_l000+0x8)&(&mask_0))>>0.)
IF (&val_0!=0.)
    PRINT "[cdm_ras_des_sd_info_l000:0x490] V:",FORMAT.HEX(0.,&val_0),"_"," : phy_cdm_ras_des_fomfeedback: Level: Current Figure of Merit Gen3"
&mask_0 = 0x1
&val_0 = ((Data.Long(A:&cdm_ras_des_sd_info_l000+0x8)&(&mask_0))>>8.)
IF (&val_0!=0.)
    PRINT "[cdm_ras_des_sd_info_l000:0x490] V:",FORMAT.HEX(0.,&val_0),"_"," : mac_cdm_ras_des_reject_rtx: Level: Receive Reject Coefficient Event status Gen3"
&mask_0 = 0x2
&val_0 = ((Data.Long(A:&cdm_ras_des_sd_info_l000+0x8)&(&mask_0))>>9.)
IF (&val_0!=0.)
    PRINT "[cdm_ras_des_sd_info_l000:0x490] V:",FORMAT.HEX(0.,&val_0),"_"," : eqpa_violate_rule_123[0]: Level: Rule A Violation Event Status Gen3"
&mask_0 = 0x4
&val_0 = ((Data.Long(A:&cdm_ras_des_sd_info_l000+0x8)&(&mask_0))>>10.)
IF (&val_0!=0.)
    PRINT "[cdm_ras_des_sd_info_l000:0x490] V:",FORMAT.HEX(0.,&val_0),"_"," : eqpa_violate_rule_123[1]: Level: Rule B Violation Event Status Gen3"
&mask_0 = 0x8
&val_0 = ((Data.Long(A:&cdm_ras_des_sd_info_l000+0x8)&(&mask_0))>>11.)
IF (&val_0!=0.)
    PRINT "[cdm_ras_des_sd_info_l000:0x490] V:",FORMAT.HEX(0.,&val_0),"_"," : eqpa_violate_rule_123[2]: Level: Rule C Violation Event Status Gen3"
&mask_0 = 0x3
&val_0 = ((Data.Long(A:&cdm_ras_des_sd_info_l000+0x8)&(&mask_0))>>12.)
IF (&val_0!=0.)
    PRINT "[cdm_ras_des_sd_info_l000:0x490] V:",FORMAT.HEX(0.,&val_0),"_"," : eq_convergence_sts [1:0]: Level: Equalization convergence information Gen3"
&mask_0 = 0xfc
&val_0 = ((Data.Long(A:&cdm_ras_des_sd_info_l000+0x8)&(&mask_0))>>14.)
IF (&val_0!=0.)
    PRINT "[cdm_ras_des_sd_info_l000:0x490] V:",FORMAT.HEX(0.,&val_0),"_"," : mac_cdm_ras_des_fs_g4: Level: Remote Device FS Gen4"
&mask_0 = 0x3f
&val_0 = ((Data.Long(A:&cdm_ras_des_sd_info_l000+0x8)&(&mask_0))>>20.)
IF (&val_0!=0.)
    PRINT "[cdm_ras_des_sd_info_l000:0x490] V:",FORMAT.HEX(0.,&val_0),"_"," : mac_cdm_ras_des_lf_g4: Level: Remote Device LF Gen4"
&mask_0 = 0xfc
&val_0 = ((Data.Long(A:&cdm_ras_des_sd_info_l000+0x8)&(&mask_0))>>26.)
IF (&val_0!=0.)
    PRINT "[cdm_ras_des_sd_info_l000:0x490] V:",FORMAT.HEX(0.,&val_0),"_"," : mac_cdm_ras_des_coef_rtx_g4[17:12]: Level: Current Remote Transmitter Post Cursor coefficient Gen4"
&mask_0 = 0x3f
&val_0 = ((Data.Long(A:&cdm_ras_des_sd_info_l000+0xc)&(&mask_0))>>0.)
IF (&val_0!=0.)
    PRINT "[cdm_ras_des_sd_info_l000:0x494] V:",FORMAT.HEX(0.,&val_0),"_"," : mac_cdm_ras_des_coef_rtx_g4[11:6]: Level: Current Remote Transmitter Cursor coefficient Gen4"
&mask_0 = 0xfc
&val_0 = ((Data.Long(A:&cdm_ras_des_sd_info_l000+0xc)&(&mask_0))>>6.)
IF (&val_0!=0.)
    PRINT "[cdm_ras_des_sd_info_l000:0x494] V:",FORMAT.HEX(0.,&val_0),"_"," : mac_cdm_ras_des_coef_rtx_g4[5:0]: Level: Current Remote Transmitter Pre Cursor coefficient Gen4"
&mask_0 = 0x3f
&val_0 = ((Data.Long(A:&cdm_ras_des_sd_info_l000+0xc)&(&mask_0))>>12.)
IF (&val_0!=0.)
    PRINT "[cdm_ras_des_sd_info_l000:0x494] V:",FORMAT.HEX(0.,&val_0),"_"," : mac_cdm_ras_des_coef_ltx_g4[17:12]: Level: Current Local Transmitter Post Cursor coefficient Gen4"
&mask_0 = 0xfc
&val_0 = ((Data.Long(A:&cdm_ras_des_sd_info_l000+0xc)&(&mask_0))>>18.)
IF (&val_0!=0.)
    PRINT "[cdm_ras_des_sd_info_l000:0x494] V:",FORMAT.HEX(0.,&val_0),"_"," : mac_cdm_ras_des_coef_ltx_g4[11:6]: Level: Current Local Transmitter Cursor coefficient Gen4"
&mask_0 = 0x3f
&val_0 = ((Data.Long(A:&cdm_ras_des_sd_info_l000+0xc)&(&mask_0))>>24.)
IF (&val_0!=0.)
    PRINT "[cdm_ras_des_sd_info_l000:0x494] V:",FORMAT.HEX(0.,&val_0),"_"," : mac_cdm_ras_des_coef_ltx_g4[5:0]: Level: Current Local Transmitter Pre Cursor coefficient Gen4"
&mask_0 = 0xc
&val_0 = ((Data.Long(A:&cdm_ras_des_sd_info_l000+0xc)&(&mask_0))>>30.)
IF (&val_0!=0.)
    PRINT "[cdm_ras_des_sd_info_l000:0x494] V:",FORMAT.HEX(0.,&val_0),"_"," : 3'b000: Reserved"
&mask_0 = 0x1
&val_0 = ((Data.Long(A:&cdm_ras_des_sd_info_l000+0x10)&(&mask_0))>>0.)
IF (&val_0!=0.)
    PRINT "[cdm_ras_des_sd_info_l000:0x498] V:",FORMAT.HEX(0.,&val_0),"_"," : 3'b000: Reserved"
&mask_0 = 0x1fe
&val_0 = ((Data.Long(A:&cdm_ras_des_sd_info_l000+0x10)&(&mask_0))>>1.)
IF (&val_0!=0.)
    PRINT "[cdm_ras_des_sd_info_l000:0x498] V:",FORMAT.HEX(0.,&val_0),"_"," : phy_cdm_ras_des_fomfeedback_g4: Level: Current Figure of Merit Gen4"
&mask_0 = 0x2
&val_0 = ((Data.Long(A:&cdm_ras_des_sd_info_l000+0x10)&(&mask_0))>>9.)
IF (&val_0!=0.)
    PRINT "[cdm_ras_des_sd_info_l000:0x498] V:",FORMAT.HEX(0.,&val_0),"_"," : mac_cdm_ras_des_reject_rtx_g4: Level: Receive Reject Coefficient Event status Gen4"
&mask_0 = 0x4
&val_0 = ((Data.Long(A:&cdm_ras_des_sd_info_l000+0x10)&(&mask_0))>>10.)
IF (&val_0!=0.)
    PRINT "[cdm_ras_des_sd_info_l000:0x498] V:",FORMAT.HEX(0.,&val_0),"_"," : eqpa_violate_rule_123_g4[0]: Level: Rule A Violation Event Status Gen4"
&mask_0 = 0x8
&val_0 = ((Data.Long(A:&cdm_ras_des_sd_info_l000+0x10)&(&mask_0))>>11.)
IF (&val_0!=0.)
    PRINT "[cdm_ras_des_sd_info_l000:0x498] V:",FORMAT.HEX(0.,&val_0),"_"," : eqpa_violate_rule_123_g4[1]: Level: Rule B Violation Event Status Gen4"
&mask_0 = 0x1
&val_0 = ((Data.Long(A:&cdm_ras_des_sd_info_l000+0x10)&(&mask_0))>>12.)
IF (&val_0!=0.)
    PRINT "[cdm_ras_des_sd_info_l000:0x498] V:",FORMAT.HEX(0.,&val_0),"_"," : eqpa_violate_rule_123_g4[2]: Level: Rule C Violation Event Status Gen4"
&mask_0 = 0x6
&val_0 = ((Data.Long(A:&cdm_ras_des_sd_info_l000+0x10)&(&mask_0))>>13.)
IF (&val_0!=0.)
    PRINT "[cdm_ras_des_sd_info_l000:0x498] V:",FORMAT.HEX(0.,&val_0),"_"," : eq_convergence_sts_g4 [1:0]: Level: Equalization convergence information Gen4"
&mask_0 = 0x1f8
&val_0 = ((Data.Long(A:&cdm_ras_des_sd_info_l000+0x10)&(&mask_0))>>15.)
IF (&val_0!=0.)
    PRINT "[cdm_ras_des_sd_info_l000:0x498] V:",FORMAT.HEX(0.,&val_0),"_"," : mac_cdm_ras_des_fs_g5: Level: Remote Device FS Gen5"
&mask_0 = 0x7e
&val_0 = ((Data.Long(A:&cdm_ras_des_sd_info_l000+0x10)&(&mask_0))>>21.)
IF (&val_0!=0.)
    PRINT "[cdm_ras_des_sd_info_l000:0x498] V:",FORMAT.HEX(0.,&val_0),"_"," : mac_cdm_ras_des_lf_g5: Level: Remote Device LF Gen5"
&mask_0 = 0xf8
&val_0 = ((Data.Long(A:&cdm_ras_des_sd_info_l000+0x10)&(&mask_0))>>27.)
IF (&val_0!=0.)
    PRINT "[cdm_ras_des_sd_info_l000:0x498] V:",FORMAT.HEX(0.,&val_0),"_"," : mac_cdm_ras_des_coef_rtx_g5[17:12]: Level: Current Remote Transmitter Post Cursor coefficient Gen5"
&mask_0 = 0x1
&val_0 = ((Data.Long(A:&cdm_ras_des_sd_info_l000+0x14)&(&mask_0))>>0.)
IF (&val_0!=0.)
    PRINT "[cdm_ras_des_sd_info_l000:0x49c] V:",FORMAT.HEX(0.,&val_0),"_"," : mac_cdm_ras_des_coef_rtx_g5[17:12]: Level: Current Remote Transmitter Post Cursor coefficient Gen5"
&mask_0 = 0x7e
&val_0 = ((Data.Long(A:&cdm_ras_des_sd_info_l000+0x14)&(&mask_0))>>1.)
IF (&val_0!=0.)
    PRINT "[cdm_ras_des_sd_info_l000:0x49c] V:",FORMAT.HEX(0.,&val_0),"_"," : mac_cdm_ras_des_coef_rtx_g5[11:6]: Level: Current Remote Transmitter Cursor coefficient Gen5"
&mask_0 = 0x1f8
&val_0 = ((Data.Long(A:&cdm_ras_des_sd_info_l000+0x14)&(&mask_0))>>7.)
IF (&val_0!=0.)
    PRINT "[cdm_ras_des_sd_info_l000:0x49c] V:",FORMAT.HEX(0.,&val_0),"_"," : mac_cdm_ras_des_coef_rtx_g5[5:0]: Level: Current Remote Transmitter Pre Cursor coefficient Gen5"
&mask_0 = 0x7e
&val_0 = ((Data.Long(A:&cdm_ras_des_sd_info_l000+0x14)&(&mask_0))>>13.)
IF (&val_0!=0.)
    PRINT "[cdm_ras_des_sd_info_l000:0x49c] V:",FORMAT.HEX(0.,&val_0),"_"," : mac_cdm_ras_des_coef_ltx_g5[17:12]: Level: Current Local Transmitter Post Cursor coefficient Gen5"
&mask_0 = 0x1f8
&val_0 = ((Data.Long(A:&cdm_ras_des_sd_info_l000+0x14)&(&mask_0))>>19.)
IF (&val_0!=0.)
    PRINT "[cdm_ras_des_sd_info_l000:0x49c] V:",FORMAT.HEX(0.,&val_0),"_"," : mac_cdm_ras_des_coef_ltx_g5[11:6]: Level: Current Local Transmitter Cursor coefficient Gen5"
&mask_0 = 0x7e
&val_0 = ((Data.Long(A:&cdm_ras_des_sd_info_l000+0x14)&(&mask_0))>>25.)
IF (&val_0!=0.)
    PRINT "[cdm_ras_des_sd_info_l000:0x49c] V:",FORMAT.HEX(0.,&val_0),"_"," : mac_cdm_ras_des_coef_ltx_g5[5:0]: Level: Current Local Transmitter Pre Cursor coefficient Gen5"
&mask_0 = 0x8
&val_0 = ((Data.Long(A:&cdm_ras_des_sd_info_l000+0x14)&(&mask_0))>>31.)
IF (&val_0!=0.)
    PRINT "[cdm_ras_des_sd_info_l000:0x49c] V:",FORMAT.HEX(0.,&val_0),"_"," : phy_cdm_ras_des_fomfeedback_g5: Level: Current Figure of Merit Gen5"
&mask_0 = 0x7f
&val_0 = ((Data.Long(A:&cdm_ras_des_sd_info_l000+0x18)&(&mask_0))>>0.)
IF (&val_0!=0.)
    PRINT "[cdm_ras_des_sd_info_l000:0x4a0] V:",FORMAT.HEX(0.,&val_0),"_"," : phy_cdm_ras_des_fomfeedback_g5: Level: Current Figure of Merit Gen5"
&mask_0 = 0x8
&val_0 = ((Data.Long(A:&cdm_ras_des_sd_info_l000+0x18)&(&mask_0))>>7.)
IF (&val_0!=0.)
    PRINT "[cdm_ras_des_sd_info_l000:0x4a0] V:",FORMAT.HEX(0.,&val_0),"_"," : mac_cdm_ras_des_reject_rtx_g5: Level: Receive Reject Coefficient Event status Gen5"
&mask_0 = 0x1
&val_0 = ((Data.Long(A:&cdm_ras_des_sd_info_l000+0x18)&(&mask_0))>>8.)
IF (&val_0!=0.)
    PRINT "[cdm_ras_des_sd_info_l000:0x4a0] V:",FORMAT.HEX(0.,&val_0),"_"," : eqpa_violate_rule_123_g5[0]: Level: Rule A Violation Event Status Gen5"
&mask_0 = 0x2
&val_0 = ((Data.Long(A:&cdm_ras_des_sd_info_l000+0x18)&(&mask_0))>>9.)
IF (&val_0!=0.)
    PRINT "[cdm_ras_des_sd_info_l000:0x4a0] V:",FORMAT.HEX(0.,&val_0),"_"," : eqpa_violate_rule_123_g5[1]: Level: Rule B Violation Event Status Gen5"
&mask_0 = 0x4
&val_0 = ((Data.Long(A:&cdm_ras_des_sd_info_l000+0x18)&(&mask_0))>>10.)
IF (&val_0!=0.)
    PRINT "[cdm_ras_des_sd_info_l000:0x4a0] V:",FORMAT.HEX(0.,&val_0),"_"," : eqpa_violate_rule_123_g5[2]: Level: Rule C Violation Event Status Gen5"
&mask_0 = 0x18
&val_0 = ((Data.Long(A:&cdm_ras_des_sd_info_l000+0x18)&(&mask_0))>>11.)
IF (&val_0!=0.)
    PRINT "[cdm_ras_des_sd_info_l000:0x4a0] V:",FORMAT.HEX(0.,&val_0),"_"," : eq_convergence_sts_g5 [1:0]: Level: Equalization convergence information Gen5"
&mask_0 = 0x7e
&val_0 = ((Data.Long(A:&cdm_ras_des_sd_info_l000+0x18)&(&mask_0))>>13.)
IF (&val_0!=0.)
    PRINT "[cdm_ras_des_sd_info_l000:0x4a0] V:",FORMAT.HEX(0.,&val_0),"_"," : mac_cdm_ras_des_fs_g6: Level: Remote Device FS Gen6"
&mask_0 = 0x1f8
&val_0 = ((Data.Long(A:&cdm_ras_des_sd_info_l000+0x18)&(&mask_0))>>19.)
IF (&val_0!=0.)
    PRINT "[cdm_ras_des_sd_info_l000:0x4a0] V:",FORMAT.HEX(0.,&val_0),"_"," : mac_cdm_ras_des_lf_g6: Level: Remote Device LF Gen6"
&mask_0 = 0x3e
&val_0 = ((Data.Long(A:&cdm_ras_des_sd_info_l000+0x18)&(&mask_0))>>25.)
IF (&val_0!=0.)
    PRINT "[cdm_ras_des_sd_info_l000:0x4a0] V:",FORMAT.HEX(0.,&val_0),"_"," : mac_cdm_ras_des_coef_rtx_g6[17:13]: Level: Current Remote Transmitter Post Cursor coefficient Gen6"
&mask_0 = 0xc
&val_0 = ((Data.Long(A:&cdm_ras_des_sd_info_l000+0x18)&(&mask_0))>>30.)
IF (&val_0!=0.)
    PRINT "[cdm_ras_des_sd_info_l000:0x4a0] V:",FORMAT.HEX(0.,&val_0),"_"," : mac_cdm_ras_des_coef_rtx_g6[8:7]: Level: Current Remote Transmitter Cursor coefficient Gen6"
&mask_0 = 0xf
&val_0 = ((Data.Long(A:&cdm_ras_des_sd_info_l000+0x1c)&(&mask_0))>>0.)
IF (&val_0!=0.)
    PRINT "[cdm_ras_des_sd_info_l000:0x4a4] V:",FORMAT.HEX(0.,&val_0),"_"," : mac_cdm_ras_des_coef_rtx_g6[12:9]: Level: Current Remote Transmitter Cursor coefficient Gen6"
&mask_0 = 0x3
&val_0 = ((Data.Long(A:&cdm_ras_des_sd_info_l000+0x1c)&(&mask_0))>>4.)
IF (&val_0!=0.)
    PRINT "[cdm_ras_des_sd_info_l000:0x4a4] V:",FORMAT.HEX(0.,&val_0),"_"," : mac_cdm_ras_des_coef_rtx_g6[4:3]: Level: Current Remote Transmitter Pre Cursor coefficient Gen6"

;=================================================================================================
; Register:acc_ras_sd_lxx_ro08, Member: ['cdm_ras_des_sd_info_l100']
;=================================================================================================
&cdm_ras_des_sd_info_l100 = 0xC1000000+0x4a8
&mask = 0x1
&val  = ((Data.Long(A:&cdm_ras_des_sd_info_l100)&(&mask))>>0.)
IF &val!=0.
    PRINT "[cdm_ras_des_sd_info_l100:0x4a8] V:", &val, " : mac_phy_txelec_txburst: Level: PIPE: TxElecIdle/TxBurst"
&mask = 0x2
&val  = ((Data.Long(A:&cdm_ras_des_sd_info_l100)&(&mask))>>1.)
IF &val!=0.
    PRINT "[cdm_ras_des_sd_info_l100:0x4a8] V:", &val, " : phy_mac_rxelec_rxh8exit: Level: PIPE: RxElecIdle/RxHibern8ExitType1"
&mask = 0x4
&val  = ((Data.Long(A:&cdm_ras_des_sd_info_l100)&(&mask))>>2.)
IF &val!=0.
    PRINT "[cdm_ras_des_sd_info_l100:0x4a8] V:", &val, " : phy_mac_rxvalid_rxburst: Level: PIPE: RxValid/RxBurst"
&mask = 0x8
&val  = ((Data.Long(A:&cdm_ras_des_sd_info_l100)&(&mask))>>3.)
IF &val!=0.
    PRINT "[cdm_ras_des_sd_info_l100:0x4a8] V:", &val, " : latched_rxdetected: Level: PIPE: Detect Lane"
&mask = 0x10
&val  = ((Data.Long(A:&cdm_ras_des_sd_info_l100)&(&mask))>>4.)
IF &val!=0.
    PRINT "[cdm_ras_des_sd_info_l100:0x4a8] V:", &val, " : mac_phy_rxpolarity: Level: PIPE: RxPolarity"
&mask = 0x1fe0
&val  = ((Data.Long(A:&cdm_ras_des_sd_info_l100)&(&mask))>>5.)
IF &val!=0.
    PRINT "[cdm_ras_des_sd_info_l100:0x4a8] V:", &val, " : rmlh_deskew_fifo_ptr: Level: Deskew Pointer"
&mask = 0x7e000
&val  = ((Data.Long(A:&cdm_ras_des_sd_info_l100)&(&mask))>>13.)
IF &val!=0.
    PRINT "[cdm_ras_des_sd_info_l100:0x4a8] V:", &val, " : mac_cdm_ras_des_fs: Level: Remote Device FS Gen3"
&mask = 0x1f80000
&val  = ((Data.Long(A:&cdm_ras_des_sd_info_l100)&(&mask))>>19.)
IF &val!=0.
    PRINT "[cdm_ras_des_sd_info_l100:0x4a8] V:", &val, " : mac_cdm_ras_des_lf: Level: Remote Device LF Gen3"
&mask = 0x7e000000
&val  = ((Data.Long(A:&cdm_ras_des_sd_info_l100)&(&mask))>>25.)
IF &val!=0.
    PRINT "[cdm_ras_des_sd_info_l100:0x4a8] V:", &val, " : mac_cdm_ras_des_coef_rtx[17:12]: Level: Current Remote Transmitter Post Cursor coefficient Gen3"
&mask = 0x80000000
&val  = ((Data.Long(A:&cdm_ras_des_sd_info_l100)&(&mask))>>31.)
IF &val!=0.
    PRINT "[cdm_ras_des_sd_info_l100:0x4a8] V:", &val, " : mac_cdm_ras_des_coef_rtx[11:6]: Level: Current Remote Transmitter Cursor coefficient Gen3"
&mask_0 = 0x1f
&val_0 = ((Data.Long(A:&cdm_ras_des_sd_info_l100+0x0)&(&mask_0))>>0.)
IF (&val_0!=0.)
    PRINT "[cdm_ras_des_sd_info_l100:0x4a8] V:",FORMAT.HEX(0.,&val_0),"_"," : mac_cdm_ras_des_coef_rtx[11:6]: Level: Current Remote Transmitter Cursor coefficient Gen3"
&mask_0 = 0x7e
&val_0 = ((Data.Long(A:&cdm_ras_des_sd_info_l100+0x4)&(&mask_0))>>5.)
IF (&val_0!=0.)
    PRINT "[cdm_ras_des_sd_info_l100:0x4ac] V:",FORMAT.HEX(0.,&val_0),"_"," : mac_cdm_ras_des_coef_rtx[5:0]: Level: Current Remote Transmitter Pre Cursor coefficient Gen3"
&mask_0 = 0x1f8
&val_0 = ((Data.Long(A:&cdm_ras_des_sd_info_l100+0x4)&(&mask_0))>>11.)
IF (&val_0!=0.)
    PRINT "[cdm_ras_des_sd_info_l100:0x4ac] V:",FORMAT.HEX(0.,&val_0),"_"," : mac_cdm_ras_des_coef_ltx[17:12]: Level: Current Local Transmitter Post Cursor coefficient Gen3"
&mask_0 = 0x7e
&val_0 = ((Data.Long(A:&cdm_ras_des_sd_info_l100+0x4)&(&mask_0))>>17.)
IF (&val_0!=0.)
    PRINT "[cdm_ras_des_sd_info_l100:0x4ac] V:",FORMAT.HEX(0.,&val_0),"_"," : mac_cdm_ras_des_coef_ltx[11:6]: Level: Current Local Transmitter Cursor coefficient Gen3"
&mask_0 = 0x1f8
&val_0 = ((Data.Long(A:&cdm_ras_des_sd_info_l100+0x4)&(&mask_0))>>23.)
IF (&val_0!=0.)
    PRINT "[cdm_ras_des_sd_info_l100:0x4ac] V:",FORMAT.HEX(0.,&val_0),"_"," : mac_cdm_ras_des_coef_ltx[5:0]: Level: Current Local Transmitter Pre Cursor coefficient Gen3"
&mask_0 = 0xe
&val_0 = ((Data.Long(A:&cdm_ras_des_sd_info_l100+0x4)&(&mask_0))>>29.)
IF (&val_0!=0.)
    PRINT "[cdm_ras_des_sd_info_l100:0x4ac] V:",FORMAT.HEX(0.,&val_0),"_"," : mac_cdm_ras_des_pset_lrx: Level: Current Local Receiver Preset Hint Gen3"
&mask_0 = 0xff
&val_0 = ((Data.Long(A:&cdm_ras_des_sd_info_l100+0x8)&(&mask_0))>>0.)
IF (&val_0!=0.)
    PRINT "[cdm_ras_des_sd_info_l100:0x4b0] V:",FORMAT.HEX(0.,&val_0),"_"," : phy_cdm_ras_des_fomfeedback: Level: Current Figure of Merit Gen3"
&mask_0 = 0x1
&val_0 = ((Data.Long(A:&cdm_ras_des_sd_info_l100+0x8)&(&mask_0))>>8.)
IF (&val_0!=0.)
    PRINT "[cdm_ras_des_sd_info_l100:0x4b0] V:",FORMAT.HEX(0.,&val_0),"_"," : mac_cdm_ras_des_reject_rtx: Level: Receive Reject Coefficient Event status Gen3"
&mask_0 = 0x2
&val_0 = ((Data.Long(A:&cdm_ras_des_sd_info_l100+0x8)&(&mask_0))>>9.)
IF (&val_0!=0.)
    PRINT "[cdm_ras_des_sd_info_l100:0x4b0] V:",FORMAT.HEX(0.,&val_0),"_"," : eqpa_violate_rule_123[0]: Level: Rule A Violation Event Status Gen3"
&mask_0 = 0x4
&val_0 = ((Data.Long(A:&cdm_ras_des_sd_info_l100+0x8)&(&mask_0))>>10.)
IF (&val_0!=0.)
    PRINT "[cdm_ras_des_sd_info_l100:0x4b0] V:",FORMAT.HEX(0.,&val_0),"_"," : eqpa_violate_rule_123[1]: Level: Rule B Violation Event Status Gen3"
&mask_0 = 0x8
&val_0 = ((Data.Long(A:&cdm_ras_des_sd_info_l100+0x8)&(&mask_0))>>11.)
IF (&val_0!=0.)
    PRINT "[cdm_ras_des_sd_info_l100:0x4b0] V:",FORMAT.HEX(0.,&val_0),"_"," : eqpa_violate_rule_123[2]: Level: Rule C Violation Event Status Gen3"
&mask_0 = 0x3
&val_0 = ((Data.Long(A:&cdm_ras_des_sd_info_l100+0x8)&(&mask_0))>>12.)
IF (&val_0!=0.)
    PRINT "[cdm_ras_des_sd_info_l100:0x4b0] V:",FORMAT.HEX(0.,&val_0),"_"," : eq_convergence_sts [1:0]: Level: Equalization convergence information Gen3"
&mask_0 = 0xfc
&val_0 = ((Data.Long(A:&cdm_ras_des_sd_info_l100+0x8)&(&mask_0))>>14.)
IF (&val_0!=0.)
    PRINT "[cdm_ras_des_sd_info_l100:0x4b0] V:",FORMAT.HEX(0.,&val_0),"_"," : mac_cdm_ras_des_fs_g4: Level: Remote Device FS Gen4"
&mask_0 = 0x3f
&val_0 = ((Data.Long(A:&cdm_ras_des_sd_info_l100+0x8)&(&mask_0))>>20.)
IF (&val_0!=0.)
    PRINT "[cdm_ras_des_sd_info_l100:0x4b0] V:",FORMAT.HEX(0.,&val_0),"_"," : mac_cdm_ras_des_lf_g4: Level: Remote Device LF Gen4"
&mask_0 = 0xfc
&val_0 = ((Data.Long(A:&cdm_ras_des_sd_info_l100+0x8)&(&mask_0))>>26.)
IF (&val_0!=0.)
    PRINT "[cdm_ras_des_sd_info_l100:0x4b0] V:",FORMAT.HEX(0.,&val_0),"_"," : mac_cdm_ras_des_coef_rtx_g4[17:12]: Level: Current Remote Transmitter Post Cursor coefficient Gen4"
&mask_0 = 0x3f
&val_0 = ((Data.Long(A:&cdm_ras_des_sd_info_l100+0xc)&(&mask_0))>>0.)
IF (&val_0!=0.)
    PRINT "[cdm_ras_des_sd_info_l100:0x4b4] V:",FORMAT.HEX(0.,&val_0),"_"," : mac_cdm_ras_des_coef_rtx_g4[11:6]: Level: Current Remote Transmitter Cursor coefficient Gen4"
&mask_0 = 0xfc
&val_0 = ((Data.Long(A:&cdm_ras_des_sd_info_l100+0xc)&(&mask_0))>>6.)
IF (&val_0!=0.)
    PRINT "[cdm_ras_des_sd_info_l100:0x4b4] V:",FORMAT.HEX(0.,&val_0),"_"," : mac_cdm_ras_des_coef_rtx_g4[5:0]: Level: Current Remote Transmitter Pre Cursor coefficient Gen4"
&mask_0 = 0x3f
&val_0 = ((Data.Long(A:&cdm_ras_des_sd_info_l100+0xc)&(&mask_0))>>12.)
IF (&val_0!=0.)
    PRINT "[cdm_ras_des_sd_info_l100:0x4b4] V:",FORMAT.HEX(0.,&val_0),"_"," : mac_cdm_ras_des_coef_ltx_g4[17:12]: Level: Current Local Transmitter Post Cursor coefficient Gen4"
&mask_0 = 0xfc
&val_0 = ((Data.Long(A:&cdm_ras_des_sd_info_l100+0xc)&(&mask_0))>>18.)
IF (&val_0!=0.)
    PRINT "[cdm_ras_des_sd_info_l100:0x4b4] V:",FORMAT.HEX(0.,&val_0),"_"," : mac_cdm_ras_des_coef_ltx_g4[11:6]: Level: Current Local Transmitter Cursor coefficient Gen4"
&mask_0 = 0x3f
&val_0 = ((Data.Long(A:&cdm_ras_des_sd_info_l100+0xc)&(&mask_0))>>24.)
IF (&val_0!=0.)
    PRINT "[cdm_ras_des_sd_info_l100:0x4b4] V:",FORMAT.HEX(0.,&val_0),"_"," : mac_cdm_ras_des_coef_ltx_g4[5:0]: Level: Current Local Transmitter Pre Cursor coefficient Gen4"
&mask_0 = 0xc
&val_0 = ((Data.Long(A:&cdm_ras_des_sd_info_l100+0xc)&(&mask_0))>>30.)
IF (&val_0!=0.)
    PRINT "[cdm_ras_des_sd_info_l100:0x4b4] V:",FORMAT.HEX(0.,&val_0),"_"," : 3'b000: Reserved"
&mask_0 = 0x1
&val_0 = ((Data.Long(A:&cdm_ras_des_sd_info_l100+0x10)&(&mask_0))>>0.)
IF (&val_0!=0.)
    PRINT "[cdm_ras_des_sd_info_l100:0x4b8] V:",FORMAT.HEX(0.,&val_0),"_"," : 3'b000: Reserved"
&mask_0 = 0x1fe
&val_0 = ((Data.Long(A:&cdm_ras_des_sd_info_l100+0x10)&(&mask_0))>>1.)
IF (&val_0!=0.)
    PRINT "[cdm_ras_des_sd_info_l100:0x4b8] V:",FORMAT.HEX(0.,&val_0),"_"," : phy_cdm_ras_des_fomfeedback_g4: Level: Current Figure of Merit Gen4"
&mask_0 = 0x2
&val_0 = ((Data.Long(A:&cdm_ras_des_sd_info_l100+0x10)&(&mask_0))>>9.)
IF (&val_0!=0.)
    PRINT "[cdm_ras_des_sd_info_l100:0x4b8] V:",FORMAT.HEX(0.,&val_0),"_"," : mac_cdm_ras_des_reject_rtx_g4: Level: Receive Reject Coefficient Event status Gen4"
&mask_0 = 0x4
&val_0 = ((Data.Long(A:&cdm_ras_des_sd_info_l100+0x10)&(&mask_0))>>10.)
IF (&val_0!=0.)
    PRINT "[cdm_ras_des_sd_info_l100:0x4b8] V:",FORMAT.HEX(0.,&val_0),"_"," : eqpa_violate_rule_123_g4[0]: Level: Rule A Violation Event Status Gen4"
&mask_0 = 0x8
&val_0 = ((Data.Long(A:&cdm_ras_des_sd_info_l100+0x10)&(&mask_0))>>11.)
IF (&val_0!=0.)
    PRINT "[cdm_ras_des_sd_info_l100:0x4b8] V:",FORMAT.HEX(0.,&val_0),"_"," : eqpa_violate_rule_123_g4[1]: Level: Rule B Violation Event Status Gen4"
&mask_0 = 0x1
&val_0 = ((Data.Long(A:&cdm_ras_des_sd_info_l100+0x10)&(&mask_0))>>12.)
IF (&val_0!=0.)
    PRINT "[cdm_ras_des_sd_info_l100:0x4b8] V:",FORMAT.HEX(0.,&val_0),"_"," : eqpa_violate_rule_123_g4[2]: Level: Rule C Violation Event Status Gen4"
&mask_0 = 0x6
&val_0 = ((Data.Long(A:&cdm_ras_des_sd_info_l100+0x10)&(&mask_0))>>13.)
IF (&val_0!=0.)
    PRINT "[cdm_ras_des_sd_info_l100:0x4b8] V:",FORMAT.HEX(0.,&val_0),"_"," : eq_convergence_sts_g4 [1:0]: Level: Equalization convergence information Gen4"
&mask_0 = 0x1f8
&val_0 = ((Data.Long(A:&cdm_ras_des_sd_info_l100+0x10)&(&mask_0))>>15.)
IF (&val_0!=0.)
    PRINT "[cdm_ras_des_sd_info_l100:0x4b8] V:",FORMAT.HEX(0.,&val_0),"_"," : mac_cdm_ras_des_fs_g5: Level: Remote Device FS Gen5"
&mask_0 = 0x7e
&val_0 = ((Data.Long(A:&cdm_ras_des_sd_info_l100+0x10)&(&mask_0))>>21.)
IF (&val_0!=0.)
    PRINT "[cdm_ras_des_sd_info_l100:0x4b8] V:",FORMAT.HEX(0.,&val_0),"_"," : mac_cdm_ras_des_lf_g5: Level: Remote Device LF Gen5"
&mask_0 = 0xf8
&val_0 = ((Data.Long(A:&cdm_ras_des_sd_info_l100+0x10)&(&mask_0))>>27.)
IF (&val_0!=0.)
    PRINT "[cdm_ras_des_sd_info_l100:0x4b8] V:",FORMAT.HEX(0.,&val_0),"_"," : mac_cdm_ras_des_coef_rtx_g5[17:12]: Level: Current Remote Transmitter Post Cursor coefficient Gen5"
&mask_0 = 0x1
&val_0 = ((Data.Long(A:&cdm_ras_des_sd_info_l100+0x14)&(&mask_0))>>0.)
IF (&val_0!=0.)
    PRINT "[cdm_ras_des_sd_info_l100:0x4bc] V:",FORMAT.HEX(0.,&val_0),"_"," : mac_cdm_ras_des_coef_rtx_g5[17:12]: Level: Current Remote Transmitter Post Cursor coefficient Gen5"
&mask_0 = 0x7e
&val_0 = ((Data.Long(A:&cdm_ras_des_sd_info_l100+0x14)&(&mask_0))>>1.)
IF (&val_0!=0.)
    PRINT "[cdm_ras_des_sd_info_l100:0x4bc] V:",FORMAT.HEX(0.,&val_0),"_"," : mac_cdm_ras_des_coef_rtx_g5[11:6]: Level: Current Remote Transmitter Cursor coefficient Gen5"
&mask_0 = 0x1f8
&val_0 = ((Data.Long(A:&cdm_ras_des_sd_info_l100+0x14)&(&mask_0))>>7.)
IF (&val_0!=0.)
    PRINT "[cdm_ras_des_sd_info_l100:0x4bc] V:",FORMAT.HEX(0.,&val_0),"_"," : mac_cdm_ras_des_coef_rtx_g5[5:0]: Level: Current Remote Transmitter Pre Cursor coefficient Gen5"
&mask_0 = 0x7e
&val_0 = ((Data.Long(A:&cdm_ras_des_sd_info_l100+0x14)&(&mask_0))>>13.)
IF (&val_0!=0.)
    PRINT "[cdm_ras_des_sd_info_l100:0x4bc] V:",FORMAT.HEX(0.,&val_0),"_"," : mac_cdm_ras_des_coef_ltx_g5[17:12]: Level: Current Local Transmitter Post Cursor coefficient Gen5"
&mask_0 = 0x1f8
&val_0 = ((Data.Long(A:&cdm_ras_des_sd_info_l100+0x14)&(&mask_0))>>19.)
IF (&val_0!=0.)
    PRINT "[cdm_ras_des_sd_info_l100:0x4bc] V:",FORMAT.HEX(0.,&val_0),"_"," : mac_cdm_ras_des_coef_ltx_g5[11:6]: Level: Current Local Transmitter Cursor coefficient Gen5"
&mask_0 = 0x7e
&val_0 = ((Data.Long(A:&cdm_ras_des_sd_info_l100+0x14)&(&mask_0))>>25.)
IF (&val_0!=0.)
    PRINT "[cdm_ras_des_sd_info_l100:0x4bc] V:",FORMAT.HEX(0.,&val_0),"_"," : mac_cdm_ras_des_coef_ltx_g5[5:0]: Level: Current Local Transmitter Pre Cursor coefficient Gen5"
&mask_0 = 0x8
&val_0 = ((Data.Long(A:&cdm_ras_des_sd_info_l100+0x14)&(&mask_0))>>31.)
IF (&val_0!=0.)
    PRINT "[cdm_ras_des_sd_info_l100:0x4bc] V:",FORMAT.HEX(0.,&val_0),"_"," : phy_cdm_ras_des_fomfeedback_g5: Level: Current Figure of Merit Gen5"
&mask_0 = 0x7f
&val_0 = ((Data.Long(A:&cdm_ras_des_sd_info_l100+0x18)&(&mask_0))>>0.)
IF (&val_0!=0.)
    PRINT "[cdm_ras_des_sd_info_l100:0x4c0] V:",FORMAT.HEX(0.,&val_0),"_"," : phy_cdm_ras_des_fomfeedback_g5: Level: Current Figure of Merit Gen5"
&mask_0 = 0x8
&val_0 = ((Data.Long(A:&cdm_ras_des_sd_info_l100+0x18)&(&mask_0))>>7.)
IF (&val_0!=0.)
    PRINT "[cdm_ras_des_sd_info_l100:0x4c0] V:",FORMAT.HEX(0.,&val_0),"_"," : mac_cdm_ras_des_reject_rtx_g5: Level: Receive Reject Coefficient Event status Gen5"
&mask_0 = 0x1
&val_0 = ((Data.Long(A:&cdm_ras_des_sd_info_l100+0x18)&(&mask_0))>>8.)
IF (&val_0!=0.)
    PRINT "[cdm_ras_des_sd_info_l100:0x4c0] V:",FORMAT.HEX(0.,&val_0),"_"," : eqpa_violate_rule_123_g5[0]: Level: Rule A Violation Event Status Gen5"
&mask_0 = 0x2
&val_0 = ((Data.Long(A:&cdm_ras_des_sd_info_l100+0x18)&(&mask_0))>>9.)
IF (&val_0!=0.)
    PRINT "[cdm_ras_des_sd_info_l100:0x4c0] V:",FORMAT.HEX(0.,&val_0),"_"," : eqpa_violate_rule_123_g5[1]: Level: Rule B Violation Event Status Gen5"
&mask_0 = 0x4
&val_0 = ((Data.Long(A:&cdm_ras_des_sd_info_l100+0x18)&(&mask_0))>>10.)
IF (&val_0!=0.)
    PRINT "[cdm_ras_des_sd_info_l100:0x4c0] V:",FORMAT.HEX(0.,&val_0),"_"," : eqpa_violate_rule_123_g5[2]: Level: Rule C Violation Event Status Gen5"
&mask_0 = 0x18
&val_0 = ((Data.Long(A:&cdm_ras_des_sd_info_l100+0x18)&(&mask_0))>>11.)
IF (&val_0!=0.)
    PRINT "[cdm_ras_des_sd_info_l100:0x4c0] V:",FORMAT.HEX(0.,&val_0),"_"," : eq_convergence_sts_g5 [1:0]: Level: Equalization convergence information Gen5"
&mask_0 = 0x7e
&val_0 = ((Data.Long(A:&cdm_ras_des_sd_info_l100+0x18)&(&mask_0))>>13.)
IF (&val_0!=0.)
    PRINT "[cdm_ras_des_sd_info_l100:0x4c0] V:",FORMAT.HEX(0.,&val_0),"_"," : mac_cdm_ras_des_fs_g6: Level: Remote Device FS Gen6"
&mask_0 = 0x1f8
&val_0 = ((Data.Long(A:&cdm_ras_des_sd_info_l100+0x18)&(&mask_0))>>19.)
IF (&val_0!=0.)
    PRINT "[cdm_ras_des_sd_info_l100:0x4c0] V:",FORMAT.HEX(0.,&val_0),"_"," : mac_cdm_ras_des_lf_g6: Level: Remote Device LF Gen6"
&mask_0 = 0x3e
&val_0 = ((Data.Long(A:&cdm_ras_des_sd_info_l100+0x18)&(&mask_0))>>25.)
IF (&val_0!=0.)
    PRINT "[cdm_ras_des_sd_info_l100:0x4c0] V:",FORMAT.HEX(0.,&val_0),"_"," : mac_cdm_ras_des_coef_rtx_g6[17:13]: Level: Current Remote Transmitter Post Cursor coefficient Gen6"
&mask_0 = 0xc
&val_0 = ((Data.Long(A:&cdm_ras_des_sd_info_l100+0x18)&(&mask_0))>>30.)
IF (&val_0!=0.)
    PRINT "[cdm_ras_des_sd_info_l100:0x4c0] V:",FORMAT.HEX(0.,&val_0),"_"," : mac_cdm_ras_des_coef_rtx_g6[8:7]: Level: Current Remote Transmitter Cursor coefficient Gen6"
&mask_0 = 0xf
&val_0 = ((Data.Long(A:&cdm_ras_des_sd_info_l100+0x1c)&(&mask_0))>>0.)
IF (&val_0!=0.)
    PRINT "[cdm_ras_des_sd_info_l100:0x4c4] V:",FORMAT.HEX(0.,&val_0),"_"," : mac_cdm_ras_des_coef_rtx_g6[12:9]: Level: Current Remote Transmitter Cursor coefficient Gen6"
&mask_0 = 0x3
&val_0 = ((Data.Long(A:&cdm_ras_des_sd_info_l100+0x1c)&(&mask_0))>>4.)
IF (&val_0!=0.)
    PRINT "[cdm_ras_des_sd_info_l100:0x4c4] V:",FORMAT.HEX(0.,&val_0),"_"," : mac_cdm_ras_des_coef_rtx_g6[4:3]: Level: Current Remote Transmitter Pre Cursor coefficient Gen6"

;=================================================================================================
; Register:acc_ras_sd_lxx_ro16, Member: ['cdm_ras_des_sd_info_l200']
;=================================================================================================
&cdm_ras_des_sd_info_l200 = 0xC1000000+0x4c8
&mask = 0x1
&val  = ((Data.Long(A:&cdm_ras_des_sd_info_l200)&(&mask))>>0.)
IF &val!=0.
    PRINT "[cdm_ras_des_sd_info_l200:0x4c8] V:", &val, " : mac_phy_txelec_txburst: Level: PIPE: TxElecIdle/TxBurst"
&mask = 0x2
&val  = ((Data.Long(A:&cdm_ras_des_sd_info_l200)&(&mask))>>1.)
IF &val!=0.
    PRINT "[cdm_ras_des_sd_info_l200:0x4c8] V:", &val, " : phy_mac_rxelec_rxh8exit: Level: PIPE: RxElecIdle/RxHibern8ExitType1"
&mask = 0x4
&val  = ((Data.Long(A:&cdm_ras_des_sd_info_l200)&(&mask))>>2.)
IF &val!=0.
    PRINT "[cdm_ras_des_sd_info_l200:0x4c8] V:", &val, " : phy_mac_rxvalid_rxburst: Level: PIPE: RxValid/RxBurst"
&mask = 0x8
&val  = ((Data.Long(A:&cdm_ras_des_sd_info_l200)&(&mask))>>3.)
IF &val!=0.
    PRINT "[cdm_ras_des_sd_info_l200:0x4c8] V:", &val, " : latched_rxdetected: Level: PIPE: Detect Lane"
&mask = 0x10
&val  = ((Data.Long(A:&cdm_ras_des_sd_info_l200)&(&mask))>>4.)
IF &val!=0.
    PRINT "[cdm_ras_des_sd_info_l200:0x4c8] V:", &val, " : mac_phy_rxpolarity: Level: PIPE: RxPolarity"
&mask = 0x1fe0
&val  = ((Data.Long(A:&cdm_ras_des_sd_info_l200)&(&mask))>>5.)
IF &val!=0.
    PRINT "[cdm_ras_des_sd_info_l200:0x4c8] V:", &val, " : rmlh_deskew_fifo_ptr: Level: Deskew Pointer"
&mask = 0x7e000
&val  = ((Data.Long(A:&cdm_ras_des_sd_info_l200)&(&mask))>>13.)
IF &val!=0.
    PRINT "[cdm_ras_des_sd_info_l200:0x4c8] V:", &val, " : mac_cdm_ras_des_fs: Level: Remote Device FS Gen3"
&mask = 0x1f80000
&val  = ((Data.Long(A:&cdm_ras_des_sd_info_l200)&(&mask))>>19.)
IF &val!=0.
    PRINT "[cdm_ras_des_sd_info_l200:0x4c8] V:", &val, " : mac_cdm_ras_des_lf: Level: Remote Device LF Gen3"
&mask = 0x7e000000
&val  = ((Data.Long(A:&cdm_ras_des_sd_info_l200)&(&mask))>>25.)
IF &val!=0.
    PRINT "[cdm_ras_des_sd_info_l200:0x4c8] V:", &val, " : mac_cdm_ras_des_coef_rtx[17:12]: Level: Current Remote Transmitter Post Cursor coefficient Gen3"
&mask = 0x80000000
&val  = ((Data.Long(A:&cdm_ras_des_sd_info_l200)&(&mask))>>31.)
IF &val!=0.
    PRINT "[cdm_ras_des_sd_info_l200:0x4c8] V:", &val, " : mac_cdm_ras_des_coef_rtx[11:6]: Level: Current Remote Transmitter Cursor coefficient Gen3"
&mask_0 = 0x1f
&val_0 = ((Data.Long(A:&cdm_ras_des_sd_info_l200+0x0)&(&mask_0))>>0.)
IF (&val_0!=0.)
    PRINT "[cdm_ras_des_sd_info_l200:0x4c8] V:",FORMAT.HEX(0.,&val_0),"_"," : mac_cdm_ras_des_coef_rtx[11:6]: Level: Current Remote Transmitter Cursor coefficient Gen3"
&mask_0 = 0x7e
&val_0 = ((Data.Long(A:&cdm_ras_des_sd_info_l200+0x4)&(&mask_0))>>5.)
IF (&val_0!=0.)
    PRINT "[cdm_ras_des_sd_info_l200:0x4cc] V:",FORMAT.HEX(0.,&val_0),"_"," : mac_cdm_ras_des_coef_rtx[5:0]: Level: Current Remote Transmitter Pre Cursor coefficient Gen3"
&mask_0 = 0x1f8
&val_0 = ((Data.Long(A:&cdm_ras_des_sd_info_l200+0x4)&(&mask_0))>>11.)
IF (&val_0!=0.)
    PRINT "[cdm_ras_des_sd_info_l200:0x4cc] V:",FORMAT.HEX(0.,&val_0),"_"," : mac_cdm_ras_des_coef_ltx[17:12]: Level: Current Local Transmitter Post Cursor coefficient Gen3"
&mask_0 = 0x7e
&val_0 = ((Data.Long(A:&cdm_ras_des_sd_info_l200+0x4)&(&mask_0))>>17.)
IF (&val_0!=0.)
    PRINT "[cdm_ras_des_sd_info_l200:0x4cc] V:",FORMAT.HEX(0.,&val_0),"_"," : mac_cdm_ras_des_coef_ltx[11:6]: Level: Current Local Transmitter Cursor coefficient Gen3"
&mask_0 = 0x1f8
&val_0 = ((Data.Long(A:&cdm_ras_des_sd_info_l200+0x4)&(&mask_0))>>23.)
IF (&val_0!=0.)
    PRINT "[cdm_ras_des_sd_info_l200:0x4cc] V:",FORMAT.HEX(0.,&val_0),"_"," : mac_cdm_ras_des_coef_ltx[5:0]: Level: Current Local Transmitter Pre Cursor coefficient Gen3"
&mask_0 = 0xe
&val_0 = ((Data.Long(A:&cdm_ras_des_sd_info_l200+0x4)&(&mask_0))>>29.)
IF (&val_0!=0.)
    PRINT "[cdm_ras_des_sd_info_l200:0x4cc] V:",FORMAT.HEX(0.,&val_0),"_"," : mac_cdm_ras_des_pset_lrx: Level: Current Local Receiver Preset Hint Gen3"
&mask_0 = 0xff
&val_0 = ((Data.Long(A:&cdm_ras_des_sd_info_l200+0x8)&(&mask_0))>>0.)
IF (&val_0!=0.)
    PRINT "[cdm_ras_des_sd_info_l200:0x4d0] V:",FORMAT.HEX(0.,&val_0),"_"," : phy_cdm_ras_des_fomfeedback: Level: Current Figure of Merit Gen3"
&mask_0 = 0x1
&val_0 = ((Data.Long(A:&cdm_ras_des_sd_info_l200+0x8)&(&mask_0))>>8.)
IF (&val_0!=0.)
    PRINT "[cdm_ras_des_sd_info_l200:0x4d0] V:",FORMAT.HEX(0.,&val_0),"_"," : mac_cdm_ras_des_reject_rtx: Level: Receive Reject Coefficient Event status Gen3"
&mask_0 = 0x2
&val_0 = ((Data.Long(A:&cdm_ras_des_sd_info_l200+0x8)&(&mask_0))>>9.)
IF (&val_0!=0.)
    PRINT "[cdm_ras_des_sd_info_l200:0x4d0] V:",FORMAT.HEX(0.,&val_0),"_"," : eqpa_violate_rule_123[0]: Level: Rule A Violation Event Status Gen3"
&mask_0 = 0x4
&val_0 = ((Data.Long(A:&cdm_ras_des_sd_info_l200+0x8)&(&mask_0))>>10.)
IF (&val_0!=0.)
    PRINT "[cdm_ras_des_sd_info_l200:0x4d0] V:",FORMAT.HEX(0.,&val_0),"_"," : eqpa_violate_rule_123[1]: Level: Rule B Violation Event Status Gen3"
&mask_0 = 0x8
&val_0 = ((Data.Long(A:&cdm_ras_des_sd_info_l200+0x8)&(&mask_0))>>11.)
IF (&val_0!=0.)
    PRINT "[cdm_ras_des_sd_info_l200:0x4d0] V:",FORMAT.HEX(0.,&val_0),"_"," : eqpa_violate_rule_123[2]: Level: Rule C Violation Event Status Gen3"
&mask_0 = 0x3
&val_0 = ((Data.Long(A:&cdm_ras_des_sd_info_l200+0x8)&(&mask_0))>>12.)
IF (&val_0!=0.)
    PRINT "[cdm_ras_des_sd_info_l200:0x4d0] V:",FORMAT.HEX(0.,&val_0),"_"," : eq_convergence_sts [1:0]: Level: Equalization convergence information Gen3"
&mask_0 = 0xfc
&val_0 = ((Data.Long(A:&cdm_ras_des_sd_info_l200+0x8)&(&mask_0))>>14.)
IF (&val_0!=0.)
    PRINT "[cdm_ras_des_sd_info_l200:0x4d0] V:",FORMAT.HEX(0.,&val_0),"_"," : mac_cdm_ras_des_fs_g4: Level: Remote Device FS Gen4"
&mask_0 = 0x3f
&val_0 = ((Data.Long(A:&cdm_ras_des_sd_info_l200+0x8)&(&mask_0))>>20.)
IF (&val_0!=0.)
    PRINT "[cdm_ras_des_sd_info_l200:0x4d0] V:",FORMAT.HEX(0.,&val_0),"_"," : mac_cdm_ras_des_lf_g4: Level: Remote Device LF Gen4"
&mask_0 = 0xfc
&val_0 = ((Data.Long(A:&cdm_ras_des_sd_info_l200+0x8)&(&mask_0))>>26.)
IF (&val_0!=0.)
    PRINT "[cdm_ras_des_sd_info_l200:0x4d0] V:",FORMAT.HEX(0.,&val_0),"_"," : mac_cdm_ras_des_coef_rtx_g4[17:12]: Level: Current Remote Transmitter Post Cursor coefficient Gen4"
&mask_0 = 0x3f
&val_0 = ((Data.Long(A:&cdm_ras_des_sd_info_l200+0xc)&(&mask_0))>>0.)
IF (&val_0!=0.)
    PRINT "[cdm_ras_des_sd_info_l200:0x4d4] V:",FORMAT.HEX(0.,&val_0),"_"," : mac_cdm_ras_des_coef_rtx_g4[11:6]: Level: Current Remote Transmitter Cursor coefficient Gen4"
&mask_0 = 0xfc
&val_0 = ((Data.Long(A:&cdm_ras_des_sd_info_l200+0xc)&(&mask_0))>>6.)
IF (&val_0!=0.)
    PRINT "[cdm_ras_des_sd_info_l200:0x4d4] V:",FORMAT.HEX(0.,&val_0),"_"," : mac_cdm_ras_des_coef_rtx_g4[5:0]: Level: Current Remote Transmitter Pre Cursor coefficient Gen4"
&mask_0 = 0x3f
&val_0 = ((Data.Long(A:&cdm_ras_des_sd_info_l200+0xc)&(&mask_0))>>12.)
IF (&val_0!=0.)
    PRINT "[cdm_ras_des_sd_info_l200:0x4d4] V:",FORMAT.HEX(0.,&val_0),"_"," : mac_cdm_ras_des_coef_ltx_g4[17:12]: Level: Current Local Transmitter Post Cursor coefficient Gen4"
&mask_0 = 0xfc
&val_0 = ((Data.Long(A:&cdm_ras_des_sd_info_l200+0xc)&(&mask_0))>>18.)
IF (&val_0!=0.)
    PRINT "[cdm_ras_des_sd_info_l200:0x4d4] V:",FORMAT.HEX(0.,&val_0),"_"," : mac_cdm_ras_des_coef_ltx_g4[11:6]: Level: Current Local Transmitter Cursor coefficient Gen4"
&mask_0 = 0x3f
&val_0 = ((Data.Long(A:&cdm_ras_des_sd_info_l200+0xc)&(&mask_0))>>24.)
IF (&val_0!=0.)
    PRINT "[cdm_ras_des_sd_info_l200:0x4d4] V:",FORMAT.HEX(0.,&val_0),"_"," : mac_cdm_ras_des_coef_ltx_g4[5:0]: Level: Current Local Transmitter Pre Cursor coefficient Gen4"
&mask_0 = 0xc
&val_0 = ((Data.Long(A:&cdm_ras_des_sd_info_l200+0xc)&(&mask_0))>>30.)
IF (&val_0!=0.)
    PRINT "[cdm_ras_des_sd_info_l200:0x4d4] V:",FORMAT.HEX(0.,&val_0),"_"," : 3'b000: Reserved"
&mask_0 = 0x1
&val_0 = ((Data.Long(A:&cdm_ras_des_sd_info_l200+0x10)&(&mask_0))>>0.)
IF (&val_0!=0.)
    PRINT "[cdm_ras_des_sd_info_l200:0x4d8] V:",FORMAT.HEX(0.,&val_0),"_"," : 3'b000: Reserved"
&mask_0 = 0x1fe
&val_0 = ((Data.Long(A:&cdm_ras_des_sd_info_l200+0x10)&(&mask_0))>>1.)
IF (&val_0!=0.)
    PRINT "[cdm_ras_des_sd_info_l200:0x4d8] V:",FORMAT.HEX(0.,&val_0),"_"," : phy_cdm_ras_des_fomfeedback_g4: Level: Current Figure of Merit Gen4"
&mask_0 = 0x2
&val_0 = ((Data.Long(A:&cdm_ras_des_sd_info_l200+0x10)&(&mask_0))>>9.)
IF (&val_0!=0.)
    PRINT "[cdm_ras_des_sd_info_l200:0x4d8] V:",FORMAT.HEX(0.,&val_0),"_"," : mac_cdm_ras_des_reject_rtx_g4: Level: Receive Reject Coefficient Event status Gen4"
&mask_0 = 0x4
&val_0 = ((Data.Long(A:&cdm_ras_des_sd_info_l200+0x10)&(&mask_0))>>10.)
IF (&val_0!=0.)
    PRINT "[cdm_ras_des_sd_info_l200:0x4d8] V:",FORMAT.HEX(0.,&val_0),"_"," : eqpa_violate_rule_123_g4[0]: Level: Rule A Violation Event Status Gen4"
&mask_0 = 0x8
&val_0 = ((Data.Long(A:&cdm_ras_des_sd_info_l200+0x10)&(&mask_0))>>11.)
IF (&val_0!=0.)
    PRINT "[cdm_ras_des_sd_info_l200:0x4d8] V:",FORMAT.HEX(0.,&val_0),"_"," : eqpa_violate_rule_123_g4[1]: Level: Rule B Violation Event Status Gen4"
&mask_0 = 0x1
&val_0 = ((Data.Long(A:&cdm_ras_des_sd_info_l200+0x10)&(&mask_0))>>12.)
IF (&val_0!=0.)
    PRINT "[cdm_ras_des_sd_info_l200:0x4d8] V:",FORMAT.HEX(0.,&val_0),"_"," : eqpa_violate_rule_123_g4[2]: Level: Rule C Violation Event Status Gen4"
&mask_0 = 0x6
&val_0 = ((Data.Long(A:&cdm_ras_des_sd_info_l200+0x10)&(&mask_0))>>13.)
IF (&val_0!=0.)
    PRINT "[cdm_ras_des_sd_info_l200:0x4d8] V:",FORMAT.HEX(0.,&val_0),"_"," : eq_convergence_sts_g4 [1:0]: Level: Equalization convergence information Gen4"
&mask_0 = 0x1f8
&val_0 = ((Data.Long(A:&cdm_ras_des_sd_info_l200+0x10)&(&mask_0))>>15.)
IF (&val_0!=0.)
    PRINT "[cdm_ras_des_sd_info_l200:0x4d8] V:",FORMAT.HEX(0.,&val_0),"_"," : mac_cdm_ras_des_fs_g5: Level: Remote Device FS Gen5"
&mask_0 = 0x7e
&val_0 = ((Data.Long(A:&cdm_ras_des_sd_info_l200+0x10)&(&mask_0))>>21.)
IF (&val_0!=0.)
    PRINT "[cdm_ras_des_sd_info_l200:0x4d8] V:",FORMAT.HEX(0.,&val_0),"_"," : mac_cdm_ras_des_lf_g5: Level: Remote Device LF Gen5"
&mask_0 = 0xf8
&val_0 = ((Data.Long(A:&cdm_ras_des_sd_info_l200+0x10)&(&mask_0))>>27.)
IF (&val_0!=0.)
    PRINT "[cdm_ras_des_sd_info_l200:0x4d8] V:",FORMAT.HEX(0.,&val_0),"_"," : mac_cdm_ras_des_coef_rtx_g5[17:12]: Level: Current Remote Transmitter Post Cursor coefficient Gen5"
&mask_0 = 0x1
&val_0 = ((Data.Long(A:&cdm_ras_des_sd_info_l200+0x14)&(&mask_0))>>0.)
IF (&val_0!=0.)
    PRINT "[cdm_ras_des_sd_info_l200:0x4dc] V:",FORMAT.HEX(0.,&val_0),"_"," : mac_cdm_ras_des_coef_rtx_g5[17:12]: Level: Current Remote Transmitter Post Cursor coefficient Gen5"
&mask_0 = 0x7e
&val_0 = ((Data.Long(A:&cdm_ras_des_sd_info_l200+0x14)&(&mask_0))>>1.)
IF (&val_0!=0.)
    PRINT "[cdm_ras_des_sd_info_l200:0x4dc] V:",FORMAT.HEX(0.,&val_0),"_"," : mac_cdm_ras_des_coef_rtx_g5[11:6]: Level: Current Remote Transmitter Cursor coefficient Gen5"
&mask_0 = 0x1f8
&val_0 = ((Data.Long(A:&cdm_ras_des_sd_info_l200+0x14)&(&mask_0))>>7.)
IF (&val_0!=0.)
    PRINT "[cdm_ras_des_sd_info_l200:0x4dc] V:",FORMAT.HEX(0.,&val_0),"_"," : mac_cdm_ras_des_coef_rtx_g5[5:0]: Level: Current Remote Transmitter Pre Cursor coefficient Gen5"
&mask_0 = 0x7e
&val_0 = ((Data.Long(A:&cdm_ras_des_sd_info_l200+0x14)&(&mask_0))>>13.)
IF (&val_0!=0.)
    PRINT "[cdm_ras_des_sd_info_l200:0x4dc] V:",FORMAT.HEX(0.,&val_0),"_"," : mac_cdm_ras_des_coef_ltx_g5[17:12]: Level: Current Local Transmitter Post Cursor coefficient Gen5"
&mask_0 = 0x1f8
&val_0 = ((Data.Long(A:&cdm_ras_des_sd_info_l200+0x14)&(&mask_0))>>19.)
IF (&val_0!=0.)
    PRINT "[cdm_ras_des_sd_info_l200:0x4dc] V:",FORMAT.HEX(0.,&val_0),"_"," : mac_cdm_ras_des_coef_ltx_g5[11:6]: Level: Current Local Transmitter Cursor coefficient Gen5"
&mask_0 = 0x7e
&val_0 = ((Data.Long(A:&cdm_ras_des_sd_info_l200+0x14)&(&mask_0))>>25.)
IF (&val_0!=0.)
    PRINT "[cdm_ras_des_sd_info_l200:0x4dc] V:",FORMAT.HEX(0.,&val_0),"_"," : mac_cdm_ras_des_coef_ltx_g5[5:0]: Level: Current Local Transmitter Pre Cursor coefficient Gen5"
&mask_0 = 0x8
&val_0 = ((Data.Long(A:&cdm_ras_des_sd_info_l200+0x14)&(&mask_0))>>31.)
IF (&val_0!=0.)
    PRINT "[cdm_ras_des_sd_info_l200:0x4dc] V:",FORMAT.HEX(0.,&val_0),"_"," : phy_cdm_ras_des_fomfeedback_g5: Level: Current Figure of Merit Gen5"
&mask_0 = 0x7f
&val_0 = ((Data.Long(A:&cdm_ras_des_sd_info_l200+0x18)&(&mask_0))>>0.)
IF (&val_0!=0.)
    PRINT "[cdm_ras_des_sd_info_l200:0x4e0] V:",FORMAT.HEX(0.,&val_0),"_"," : phy_cdm_ras_des_fomfeedback_g5: Level: Current Figure of Merit Gen5"
&mask_0 = 0x8
&val_0 = ((Data.Long(A:&cdm_ras_des_sd_info_l200+0x18)&(&mask_0))>>7.)
IF (&val_0!=0.)
    PRINT "[cdm_ras_des_sd_info_l200:0x4e0] V:",FORMAT.HEX(0.,&val_0),"_"," : mac_cdm_ras_des_reject_rtx_g5: Level: Receive Reject Coefficient Event status Gen5"
&mask_0 = 0x1
&val_0 = ((Data.Long(A:&cdm_ras_des_sd_info_l200+0x18)&(&mask_0))>>8.)
IF (&val_0!=0.)
    PRINT "[cdm_ras_des_sd_info_l200:0x4e0] V:",FORMAT.HEX(0.,&val_0),"_"," : eqpa_violate_rule_123_g5[0]: Level: Rule A Violation Event Status Gen5"
&mask_0 = 0x2
&val_0 = ((Data.Long(A:&cdm_ras_des_sd_info_l200+0x18)&(&mask_0))>>9.)
IF (&val_0!=0.)
    PRINT "[cdm_ras_des_sd_info_l200:0x4e0] V:",FORMAT.HEX(0.,&val_0),"_"," : eqpa_violate_rule_123_g5[1]: Level: Rule B Violation Event Status Gen5"
&mask_0 = 0x4
&val_0 = ((Data.Long(A:&cdm_ras_des_sd_info_l200+0x18)&(&mask_0))>>10.)
IF (&val_0!=0.)
    PRINT "[cdm_ras_des_sd_info_l200:0x4e0] V:",FORMAT.HEX(0.,&val_0),"_"," : eqpa_violate_rule_123_g5[2]: Level: Rule C Violation Event Status Gen5"
&mask_0 = 0x18
&val_0 = ((Data.Long(A:&cdm_ras_des_sd_info_l200+0x18)&(&mask_0))>>11.)
IF (&val_0!=0.)
    PRINT "[cdm_ras_des_sd_info_l200:0x4e0] V:",FORMAT.HEX(0.,&val_0),"_"," : eq_convergence_sts_g5 [1:0]: Level: Equalization convergence information Gen5"
&mask_0 = 0x7e
&val_0 = ((Data.Long(A:&cdm_ras_des_sd_info_l200+0x18)&(&mask_0))>>13.)
IF (&val_0!=0.)
    PRINT "[cdm_ras_des_sd_info_l200:0x4e0] V:",FORMAT.HEX(0.,&val_0),"_"," : mac_cdm_ras_des_fs_g6: Level: Remote Device FS Gen6"
&mask_0 = 0x1f8
&val_0 = ((Data.Long(A:&cdm_ras_des_sd_info_l200+0x18)&(&mask_0))>>19.)
IF (&val_0!=0.)
    PRINT "[cdm_ras_des_sd_info_l200:0x4e0] V:",FORMAT.HEX(0.,&val_0),"_"," : mac_cdm_ras_des_lf_g6: Level: Remote Device LF Gen6"
&mask_0 = 0x3e
&val_0 = ((Data.Long(A:&cdm_ras_des_sd_info_l200+0x18)&(&mask_0))>>25.)
IF (&val_0!=0.)
    PRINT "[cdm_ras_des_sd_info_l200:0x4e0] V:",FORMAT.HEX(0.,&val_0),"_"," : mac_cdm_ras_des_coef_rtx_g6[17:13]: Level: Current Remote Transmitter Post Cursor coefficient Gen6"
&mask_0 = 0xc
&val_0 = ((Data.Long(A:&cdm_ras_des_sd_info_l200+0x18)&(&mask_0))>>30.)
IF (&val_0!=0.)
    PRINT "[cdm_ras_des_sd_info_l200:0x4e0] V:",FORMAT.HEX(0.,&val_0),"_"," : mac_cdm_ras_des_coef_rtx_g6[8:7]: Level: Current Remote Transmitter Cursor coefficient Gen6"
&mask_0 = 0xf
&val_0 = ((Data.Long(A:&cdm_ras_des_sd_info_l200+0x1c)&(&mask_0))>>0.)
IF (&val_0!=0.)
    PRINT "[cdm_ras_des_sd_info_l200:0x4e4] V:",FORMAT.HEX(0.,&val_0),"_"," : mac_cdm_ras_des_coef_rtx_g6[12:9]: Level: Current Remote Transmitter Cursor coefficient Gen6"
&mask_0 = 0x3
&val_0 = ((Data.Long(A:&cdm_ras_des_sd_info_l200+0x1c)&(&mask_0))>>4.)
IF (&val_0!=0.)
    PRINT "[cdm_ras_des_sd_info_l200:0x4e4] V:",FORMAT.HEX(0.,&val_0),"_"," : mac_cdm_ras_des_coef_rtx_g6[4:3]: Level: Current Remote Transmitter Pre Cursor coefficient Gen6"

;=================================================================================================
; Register:acc_ras_sd_lxx_ro24, Member: ['cdm_ras_des_sd_info_l300']
;=================================================================================================
&cdm_ras_des_sd_info_l300 = 0xC1000000+0x4e8
&mask = 0x1
&val  = ((Data.Long(A:&cdm_ras_des_sd_info_l300)&(&mask))>>0.)
IF &val!=0.
    PRINT "[cdm_ras_des_sd_info_l300:0x4e8] V:", &val, " : mac_phy_txelec_txburst: Level: PIPE: TxElecIdle/TxBurst"
&mask = 0x2
&val  = ((Data.Long(A:&cdm_ras_des_sd_info_l300)&(&mask))>>1.)
IF &val!=0.
    PRINT "[cdm_ras_des_sd_info_l300:0x4e8] V:", &val, " : phy_mac_rxelec_rxh8exit: Level: PIPE: RxElecIdle/RxHibern8ExitType1"
&mask = 0x4
&val  = ((Data.Long(A:&cdm_ras_des_sd_info_l300)&(&mask))>>2.)
IF &val!=0.
    PRINT "[cdm_ras_des_sd_info_l300:0x4e8] V:", &val, " : phy_mac_rxvalid_rxburst: Level: PIPE: RxValid/RxBurst"
&mask = 0x8
&val  = ((Data.Long(A:&cdm_ras_des_sd_info_l300)&(&mask))>>3.)
IF &val!=0.
    PRINT "[cdm_ras_des_sd_info_l300:0x4e8] V:", &val, " : latched_rxdetected: Level: PIPE: Detect Lane"
&mask = 0x10
&val  = ((Data.Long(A:&cdm_ras_des_sd_info_l300)&(&mask))>>4.)
IF &val!=0.
    PRINT "[cdm_ras_des_sd_info_l300:0x4e8] V:", &val, " : mac_phy_rxpolarity: Level: PIPE: RxPolarity"
&mask = 0x1fe0
&val  = ((Data.Long(A:&cdm_ras_des_sd_info_l300)&(&mask))>>5.)
IF &val!=0.
    PRINT "[cdm_ras_des_sd_info_l300:0x4e8] V:", &val, " : rmlh_deskew_fifo_ptr: Level: Deskew Pointer"
&mask = 0x7e000
&val  = ((Data.Long(A:&cdm_ras_des_sd_info_l300)&(&mask))>>13.)
IF &val!=0.
    PRINT "[cdm_ras_des_sd_info_l300:0x4e8] V:", &val, " : mac_cdm_ras_des_fs: Level: Remote Device FS Gen3"
&mask = 0x1f80000
&val  = ((Data.Long(A:&cdm_ras_des_sd_info_l300)&(&mask))>>19.)
IF &val!=0.
    PRINT "[cdm_ras_des_sd_info_l300:0x4e8] V:", &val, " : mac_cdm_ras_des_lf: Level: Remote Device LF Gen3"
&mask = 0x7e000000
&val  = ((Data.Long(A:&cdm_ras_des_sd_info_l300)&(&mask))>>25.)
IF &val!=0.
    PRINT "[cdm_ras_des_sd_info_l300:0x4e8] V:", &val, " : mac_cdm_ras_des_coef_rtx[17:12]: Level: Current Remote Transmitter Post Cursor coefficient Gen3"
&mask = 0x80000000
&val  = ((Data.Long(A:&cdm_ras_des_sd_info_l300)&(&mask))>>31.)
IF &val!=0.
    PRINT "[cdm_ras_des_sd_info_l300:0x4e8] V:", &val, " : mac_cdm_ras_des_coef_rtx[11:6]: Level: Current Remote Transmitter Cursor coefficient Gen3"
&mask_0 = 0x1f
&val_0 = ((Data.Long(A:&cdm_ras_des_sd_info_l300+0x0)&(&mask_0))>>0.)
IF (&val_0!=0.)
    PRINT "[cdm_ras_des_sd_info_l300:0x4e8] V:",FORMAT.HEX(0.,&val_0),"_"," : mac_cdm_ras_des_coef_rtx[11:6]: Level: Current Remote Transmitter Cursor coefficient Gen3"
&mask_0 = 0x7e
&val_0 = ((Data.Long(A:&cdm_ras_des_sd_info_l300+0x4)&(&mask_0))>>5.)
IF (&val_0!=0.)
    PRINT "[cdm_ras_des_sd_info_l300:0x4ec] V:",FORMAT.HEX(0.,&val_0),"_"," : mac_cdm_ras_des_coef_rtx[5:0]: Level: Current Remote Transmitter Pre Cursor coefficient Gen3"
&mask_0 = 0x1f8
&val_0 = ((Data.Long(A:&cdm_ras_des_sd_info_l300+0x4)&(&mask_0))>>11.)
IF (&val_0!=0.)
    PRINT "[cdm_ras_des_sd_info_l300:0x4ec] V:",FORMAT.HEX(0.,&val_0),"_"," : mac_cdm_ras_des_coef_ltx[17:12]: Level: Current Local Transmitter Post Cursor coefficient Gen3"
&mask_0 = 0x7e
&val_0 = ((Data.Long(A:&cdm_ras_des_sd_info_l300+0x4)&(&mask_0))>>17.)
IF (&val_0!=0.)
    PRINT "[cdm_ras_des_sd_info_l300:0x4ec] V:",FORMAT.HEX(0.,&val_0),"_"," : mac_cdm_ras_des_coef_ltx[11:6]: Level: Current Local Transmitter Cursor coefficient Gen3"
&mask_0 = 0x1f8
&val_0 = ((Data.Long(A:&cdm_ras_des_sd_info_l300+0x4)&(&mask_0))>>23.)
IF (&val_0!=0.)
    PRINT "[cdm_ras_des_sd_info_l300:0x4ec] V:",FORMAT.HEX(0.,&val_0),"_"," : mac_cdm_ras_des_coef_ltx[5:0]: Level: Current Local Transmitter Pre Cursor coefficient Gen3"
&mask_0 = 0xe
&val_0 = ((Data.Long(A:&cdm_ras_des_sd_info_l300+0x4)&(&mask_0))>>29.)
IF (&val_0!=0.)
    PRINT "[cdm_ras_des_sd_info_l300:0x4ec] V:",FORMAT.HEX(0.,&val_0),"_"," : mac_cdm_ras_des_pset_lrx: Level: Current Local Receiver Preset Hint Gen3"
&mask_0 = 0xff
&val_0 = ((Data.Long(A:&cdm_ras_des_sd_info_l300+0x8)&(&mask_0))>>0.)
IF (&val_0!=0.)
    PRINT "[cdm_ras_des_sd_info_l300:0x4f0] V:",FORMAT.HEX(0.,&val_0),"_"," : phy_cdm_ras_des_fomfeedback: Level: Current Figure of Merit Gen3"
&mask_0 = 0x1
&val_0 = ((Data.Long(A:&cdm_ras_des_sd_info_l300+0x8)&(&mask_0))>>8.)
IF (&val_0!=0.)
    PRINT "[cdm_ras_des_sd_info_l300:0x4f0] V:",FORMAT.HEX(0.,&val_0),"_"," : mac_cdm_ras_des_reject_rtx: Level: Receive Reject Coefficient Event status Gen3"
&mask_0 = 0x2
&val_0 = ((Data.Long(A:&cdm_ras_des_sd_info_l300+0x8)&(&mask_0))>>9.)
IF (&val_0!=0.)
    PRINT "[cdm_ras_des_sd_info_l300:0x4f0] V:",FORMAT.HEX(0.,&val_0),"_"," : eqpa_violate_rule_123[0]: Level: Rule A Violation Event Status Gen3"
&mask_0 = 0x4
&val_0 = ((Data.Long(A:&cdm_ras_des_sd_info_l300+0x8)&(&mask_0))>>10.)
IF (&val_0!=0.)
    PRINT "[cdm_ras_des_sd_info_l300:0x4f0] V:",FORMAT.HEX(0.,&val_0),"_"," : eqpa_violate_rule_123[1]: Level: Rule B Violation Event Status Gen3"
&mask_0 = 0x8
&val_0 = ((Data.Long(A:&cdm_ras_des_sd_info_l300+0x8)&(&mask_0))>>11.)
IF (&val_0!=0.)
    PRINT "[cdm_ras_des_sd_info_l300:0x4f0] V:",FORMAT.HEX(0.,&val_0),"_"," : eqpa_violate_rule_123[2]: Level: Rule C Violation Event Status Gen3"
&mask_0 = 0x3
&val_0 = ((Data.Long(A:&cdm_ras_des_sd_info_l300+0x8)&(&mask_0))>>12.)
IF (&val_0!=0.)
    PRINT "[cdm_ras_des_sd_info_l300:0x4f0] V:",FORMAT.HEX(0.,&val_0),"_"," : eq_convergence_sts [1:0]: Level: Equalization convergence information Gen3"
&mask_0 = 0xfc
&val_0 = ((Data.Long(A:&cdm_ras_des_sd_info_l300+0x8)&(&mask_0))>>14.)
IF (&val_0!=0.)
    PRINT "[cdm_ras_des_sd_info_l300:0x4f0] V:",FORMAT.HEX(0.,&val_0),"_"," : mac_cdm_ras_des_fs_g4: Level: Remote Device FS Gen4"
&mask_0 = 0x3f
&val_0 = ((Data.Long(A:&cdm_ras_des_sd_info_l300+0x8)&(&mask_0))>>20.)
IF (&val_0!=0.)
    PRINT "[cdm_ras_des_sd_info_l300:0x4f0] V:",FORMAT.HEX(0.,&val_0),"_"," : mac_cdm_ras_des_lf_g4: Level: Remote Device LF Gen4"
&mask_0 = 0xfc
&val_0 = ((Data.Long(A:&cdm_ras_des_sd_info_l300+0x8)&(&mask_0))>>26.)
IF (&val_0!=0.)
    PRINT "[cdm_ras_des_sd_info_l300:0x4f0] V:",FORMAT.HEX(0.,&val_0),"_"," : mac_cdm_ras_des_coef_rtx_g4[17:12]: Level: Current Remote Transmitter Post Cursor coefficient Gen4"
&mask_0 = 0x3f
&val_0 = ((Data.Long(A:&cdm_ras_des_sd_info_l300+0xc)&(&mask_0))>>0.)
IF (&val_0!=0.)
    PRINT "[cdm_ras_des_sd_info_l300:0x4f4] V:",FORMAT.HEX(0.,&val_0),"_"," : mac_cdm_ras_des_coef_rtx_g4[11:6]: Level: Current Remote Transmitter Cursor coefficient Gen4"
&mask_0 = 0xfc
&val_0 = ((Data.Long(A:&cdm_ras_des_sd_info_l300+0xc)&(&mask_0))>>6.)
IF (&val_0!=0.)
    PRINT "[cdm_ras_des_sd_info_l300:0x4f4] V:",FORMAT.HEX(0.,&val_0),"_"," : mac_cdm_ras_des_coef_rtx_g4[5:0]: Level: Current Remote Transmitter Pre Cursor coefficient Gen4"
&mask_0 = 0x3f
&val_0 = ((Data.Long(A:&cdm_ras_des_sd_info_l300+0xc)&(&mask_0))>>12.)
IF (&val_0!=0.)
    PRINT "[cdm_ras_des_sd_info_l300:0x4f4] V:",FORMAT.HEX(0.,&val_0),"_"," : mac_cdm_ras_des_coef_ltx_g4[17:12]: Level: Current Local Transmitter Post Cursor coefficient Gen4"
&mask_0 = 0xfc
&val_0 = ((Data.Long(A:&cdm_ras_des_sd_info_l300+0xc)&(&mask_0))>>18.)
IF (&val_0!=0.)
    PRINT "[cdm_ras_des_sd_info_l300:0x4f4] V:",FORMAT.HEX(0.,&val_0),"_"," : mac_cdm_ras_des_coef_ltx_g4[11:6]: Level: Current Local Transmitter Cursor coefficient Gen4"
&mask_0 = 0x3f
&val_0 = ((Data.Long(A:&cdm_ras_des_sd_info_l300+0xc)&(&mask_0))>>24.)
IF (&val_0!=0.)
    PRINT "[cdm_ras_des_sd_info_l300:0x4f4] V:",FORMAT.HEX(0.,&val_0),"_"," : mac_cdm_ras_des_coef_ltx_g4[5:0]: Level: Current Local Transmitter Pre Cursor coefficient Gen4"
&mask_0 = 0xc
&val_0 = ((Data.Long(A:&cdm_ras_des_sd_info_l300+0xc)&(&mask_0))>>30.)
IF (&val_0!=0.)
    PRINT "[cdm_ras_des_sd_info_l300:0x4f4] V:",FORMAT.HEX(0.,&val_0),"_"," : 3'b000: Reserved"
&mask_0 = 0x1
&val_0 = ((Data.Long(A:&cdm_ras_des_sd_info_l300+0x10)&(&mask_0))>>0.)
IF (&val_0!=0.)
    PRINT "[cdm_ras_des_sd_info_l300:0x4f8] V:",FORMAT.HEX(0.,&val_0),"_"," : 3'b000: Reserved"
&mask_0 = 0x1fe
&val_0 = ((Data.Long(A:&cdm_ras_des_sd_info_l300+0x10)&(&mask_0))>>1.)
IF (&val_0!=0.)
    PRINT "[cdm_ras_des_sd_info_l300:0x4f8] V:",FORMAT.HEX(0.,&val_0),"_"," : phy_cdm_ras_des_fomfeedback_g4: Level: Current Figure of Merit Gen4"
&mask_0 = 0x2
&val_0 = ((Data.Long(A:&cdm_ras_des_sd_info_l300+0x10)&(&mask_0))>>9.)
IF (&val_0!=0.)
    PRINT "[cdm_ras_des_sd_info_l300:0x4f8] V:",FORMAT.HEX(0.,&val_0),"_"," : mac_cdm_ras_des_reject_rtx_g4: Level: Receive Reject Coefficient Event status Gen4"
&mask_0 = 0x4
&val_0 = ((Data.Long(A:&cdm_ras_des_sd_info_l300+0x10)&(&mask_0))>>10.)
IF (&val_0!=0.)
    PRINT "[cdm_ras_des_sd_info_l300:0x4f8] V:",FORMAT.HEX(0.,&val_0),"_"," : eqpa_violate_rule_123_g4[0]: Level: Rule A Violation Event Status Gen4"
&mask_0 = 0x8
&val_0 = ((Data.Long(A:&cdm_ras_des_sd_info_l300+0x10)&(&mask_0))>>11.)
IF (&val_0!=0.)
    PRINT "[cdm_ras_des_sd_info_l300:0x4f8] V:",FORMAT.HEX(0.,&val_0),"_"," : eqpa_violate_rule_123_g4[1]: Level: Rule B Violation Event Status Gen4"
&mask_0 = 0x1
&val_0 = ((Data.Long(A:&cdm_ras_des_sd_info_l300+0x10)&(&mask_0))>>12.)
IF (&val_0!=0.)
    PRINT "[cdm_ras_des_sd_info_l300:0x4f8] V:",FORMAT.HEX(0.,&val_0),"_"," : eqpa_violate_rule_123_g4[2]: Level: Rule C Violation Event Status Gen4"
&mask_0 = 0x6
&val_0 = ((Data.Long(A:&cdm_ras_des_sd_info_l300+0x10)&(&mask_0))>>13.)
IF (&val_0!=0.)
    PRINT "[cdm_ras_des_sd_info_l300:0x4f8] V:",FORMAT.HEX(0.,&val_0),"_"," : eq_convergence_sts_g4 [1:0]: Level: Equalization convergence information Gen4"
&mask_0 = 0x1f8
&val_0 = ((Data.Long(A:&cdm_ras_des_sd_info_l300+0x10)&(&mask_0))>>15.)
IF (&val_0!=0.)
    PRINT "[cdm_ras_des_sd_info_l300:0x4f8] V:",FORMAT.HEX(0.,&val_0),"_"," : mac_cdm_ras_des_fs_g5: Level: Remote Device FS Gen5"
&mask_0 = 0x7e
&val_0 = ((Data.Long(A:&cdm_ras_des_sd_info_l300+0x10)&(&mask_0))>>21.)
IF (&val_0!=0.)
    PRINT "[cdm_ras_des_sd_info_l300:0x4f8] V:",FORMAT.HEX(0.,&val_0),"_"," : mac_cdm_ras_des_lf_g5: Level: Remote Device LF Gen5"
&mask_0 = 0xf8
&val_0 = ((Data.Long(A:&cdm_ras_des_sd_info_l300+0x10)&(&mask_0))>>27.)
IF (&val_0!=0.)
    PRINT "[cdm_ras_des_sd_info_l300:0x4f8] V:",FORMAT.HEX(0.,&val_0),"_"," : mac_cdm_ras_des_coef_rtx_g5[17:12]: Level: Current Remote Transmitter Post Cursor coefficient Gen5"
&mask_0 = 0x1
&val_0 = ((Data.Long(A:&cdm_ras_des_sd_info_l300+0x14)&(&mask_0))>>0.)
IF (&val_0!=0.)
    PRINT "[cdm_ras_des_sd_info_l300:0x4fc] V:",FORMAT.HEX(0.,&val_0),"_"," : mac_cdm_ras_des_coef_rtx_g5[17:12]: Level: Current Remote Transmitter Post Cursor coefficient Gen5"
&mask_0 = 0x7e
&val_0 = ((Data.Long(A:&cdm_ras_des_sd_info_l300+0x14)&(&mask_0))>>1.)
IF (&val_0!=0.)
    PRINT "[cdm_ras_des_sd_info_l300:0x4fc] V:",FORMAT.HEX(0.,&val_0),"_"," : mac_cdm_ras_des_coef_rtx_g5[11:6]: Level: Current Remote Transmitter Cursor coefficient Gen5"
&mask_0 = 0x1f8
&val_0 = ((Data.Long(A:&cdm_ras_des_sd_info_l300+0x14)&(&mask_0))>>7.)
IF (&val_0!=0.)
    PRINT "[cdm_ras_des_sd_info_l300:0x4fc] V:",FORMAT.HEX(0.,&val_0),"_"," : mac_cdm_ras_des_coef_rtx_g5[5:0]: Level: Current Remote Transmitter Pre Cursor coefficient Gen5"
&mask_0 = 0x7e
&val_0 = ((Data.Long(A:&cdm_ras_des_sd_info_l300+0x14)&(&mask_0))>>13.)
IF (&val_0!=0.)
    PRINT "[cdm_ras_des_sd_info_l300:0x4fc] V:",FORMAT.HEX(0.,&val_0),"_"," : mac_cdm_ras_des_coef_ltx_g5[17:12]: Level: Current Local Transmitter Post Cursor coefficient Gen5"
&mask_0 = 0x1f8
&val_0 = ((Data.Long(A:&cdm_ras_des_sd_info_l300+0x14)&(&mask_0))>>19.)
IF (&val_0!=0.)
    PRINT "[cdm_ras_des_sd_info_l300:0x4fc] V:",FORMAT.HEX(0.,&val_0),"_"," : mac_cdm_ras_des_coef_ltx_g5[11:6]: Level: Current Local Transmitter Cursor coefficient Gen5"
&mask_0 = 0x7e
&val_0 = ((Data.Long(A:&cdm_ras_des_sd_info_l300+0x14)&(&mask_0))>>25.)
IF (&val_0!=0.)
    PRINT "[cdm_ras_des_sd_info_l300:0x4fc] V:",FORMAT.HEX(0.,&val_0),"_"," : mac_cdm_ras_des_coef_ltx_g5[5:0]: Level: Current Local Transmitter Pre Cursor coefficient Gen5"
&mask_0 = 0x8
&val_0 = ((Data.Long(A:&cdm_ras_des_sd_info_l300+0x14)&(&mask_0))>>31.)
IF (&val_0!=0.)
    PRINT "[cdm_ras_des_sd_info_l300:0x4fc] V:",FORMAT.HEX(0.,&val_0),"_"," : phy_cdm_ras_des_fomfeedback_g5: Level: Current Figure of Merit Gen5"
&mask_0 = 0x7f
&val_0 = ((Data.Long(A:&cdm_ras_des_sd_info_l300+0x18)&(&mask_0))>>0.)
IF (&val_0!=0.)
    PRINT "[cdm_ras_des_sd_info_l300:0x500] V:",FORMAT.HEX(0.,&val_0),"_"," : phy_cdm_ras_des_fomfeedback_g5: Level: Current Figure of Merit Gen5"
&mask_0 = 0x8
&val_0 = ((Data.Long(A:&cdm_ras_des_sd_info_l300+0x18)&(&mask_0))>>7.)
IF (&val_0!=0.)
    PRINT "[cdm_ras_des_sd_info_l300:0x500] V:",FORMAT.HEX(0.,&val_0),"_"," : mac_cdm_ras_des_reject_rtx_g5: Level: Receive Reject Coefficient Event status Gen5"
&mask_0 = 0x1
&val_0 = ((Data.Long(A:&cdm_ras_des_sd_info_l300+0x18)&(&mask_0))>>8.)
IF (&val_0!=0.)
    PRINT "[cdm_ras_des_sd_info_l300:0x500] V:",FORMAT.HEX(0.,&val_0),"_"," : eqpa_violate_rule_123_g5[0]: Level: Rule A Violation Event Status Gen5"
&mask_0 = 0x2
&val_0 = ((Data.Long(A:&cdm_ras_des_sd_info_l300+0x18)&(&mask_0))>>9.)
IF (&val_0!=0.)
    PRINT "[cdm_ras_des_sd_info_l300:0x500] V:",FORMAT.HEX(0.,&val_0),"_"," : eqpa_violate_rule_123_g5[1]: Level: Rule B Violation Event Status Gen5"
&mask_0 = 0x4
&val_0 = ((Data.Long(A:&cdm_ras_des_sd_info_l300+0x18)&(&mask_0))>>10.)
IF (&val_0!=0.)
    PRINT "[cdm_ras_des_sd_info_l300:0x500] V:",FORMAT.HEX(0.,&val_0),"_"," : eqpa_violate_rule_123_g5[2]: Level: Rule C Violation Event Status Gen5"
&mask_0 = 0x18
&val_0 = ((Data.Long(A:&cdm_ras_des_sd_info_l300+0x18)&(&mask_0))>>11.)
IF (&val_0!=0.)
    PRINT "[cdm_ras_des_sd_info_l300:0x500] V:",FORMAT.HEX(0.,&val_0),"_"," : eq_convergence_sts_g5 [1:0]: Level: Equalization convergence information Gen5"
&mask_0 = 0x7e
&val_0 = ((Data.Long(A:&cdm_ras_des_sd_info_l300+0x18)&(&mask_0))>>13.)
IF (&val_0!=0.)
    PRINT "[cdm_ras_des_sd_info_l300:0x500] V:",FORMAT.HEX(0.,&val_0),"_"," : mac_cdm_ras_des_fs_g6: Level: Remote Device FS Gen6"
&mask_0 = 0x1f8
&val_0 = ((Data.Long(A:&cdm_ras_des_sd_info_l300+0x18)&(&mask_0))>>19.)
IF (&val_0!=0.)
    PRINT "[cdm_ras_des_sd_info_l300:0x500] V:",FORMAT.HEX(0.,&val_0),"_"," : mac_cdm_ras_des_lf_g6: Level: Remote Device LF Gen6"
&mask_0 = 0x3e
&val_0 = ((Data.Long(A:&cdm_ras_des_sd_info_l300+0x18)&(&mask_0))>>25.)
IF (&val_0!=0.)
    PRINT "[cdm_ras_des_sd_info_l300:0x500] V:",FORMAT.HEX(0.,&val_0),"_"," : mac_cdm_ras_des_coef_rtx_g6[17:13]: Level: Current Remote Transmitter Post Cursor coefficient Gen6"
&mask_0 = 0xc
&val_0 = ((Data.Long(A:&cdm_ras_des_sd_info_l300+0x18)&(&mask_0))>>30.)
IF (&val_0!=0.)
    PRINT "[cdm_ras_des_sd_info_l300:0x500] V:",FORMAT.HEX(0.,&val_0),"_"," : mac_cdm_ras_des_coef_rtx_g6[8:7]: Level: Current Remote Transmitter Cursor coefficient Gen6"
&mask_0 = 0xf
&val_0 = ((Data.Long(A:&cdm_ras_des_sd_info_l300+0x1c)&(&mask_0))>>0.)
IF (&val_0!=0.)
    PRINT "[cdm_ras_des_sd_info_l300:0x504] V:",FORMAT.HEX(0.,&val_0),"_"," : mac_cdm_ras_des_coef_rtx_g6[12:9]: Level: Current Remote Transmitter Cursor coefficient Gen6"
&mask_0 = 0x3
&val_0 = ((Data.Long(A:&cdm_ras_des_sd_info_l300+0x1c)&(&mask_0))>>4.)
IF (&val_0!=0.)
    PRINT "[cdm_ras_des_sd_info_l300:0x504] V:",FORMAT.HEX(0.,&val_0),"_"," : mac_cdm_ras_des_coef_rtx_g6[4:3]: Level: Current Remote Transmitter Pre Cursor coefficient Gen6"

;=================================================================================================
; Register:acc_ras_sd_vxx_ro00, Member: ['cdm_ras_des_sd_info_v000']
;=================================================================================================
&cdm_ras_des_sd_info_v000 = 0xC1000000+0x508
&mask = 0xff
&val  = ((Data.Long(A:&cdm_ras_des_sd_info_v000)&(&mask))>>0.)
IF &val!=0.
    PRINT "[cdm_ras_des_sd_info_v000:0x508] V:", &val, " : xadm_fc_cnsmd_ph: Level: Credit Consumed (PH) VCn"
&mask = 0xfff00
&val  = ((Data.Long(A:&cdm_ras_des_sd_info_v000)&(&mask))>>8.)
IF &val!=0.
    PRINT "[cdm_ras_des_sd_info_v000:0x508] V:", &val, " : xadm_fc_cnsmd_pd: Level: Credit Consumed (PD) VCn"
&mask = 0xff00000
&val  = ((Data.Long(A:&cdm_ras_des_sd_info_v000)&(&mask))>>20.)
IF &val!=0.
    PRINT "[cdm_ras_des_sd_info_v000:0x508] V:", &val, " : xadm_fc_cnsmd_nph: Level: Credit Consumed (NH) VCn"
&mask = 0xf0000000
&val  = ((Data.Long(A:&cdm_ras_des_sd_info_v000)&(&mask))>>28.)
IF &val!=0.
    PRINT "[cdm_ras_des_sd_info_v000:0x508] V:", &val, " : xadm_fc_cnsmd_npd: Level: Credit Consumed (ND) VCn"
&mask_0 = 0xff
&val_0 = ((Data.Long(A:&cdm_ras_des_sd_info_v000+0x0)&(&mask_0))>>0.)
IF (&val_0!=0.)
    PRINT "[cdm_ras_des_sd_info_v000:0x508] V:",FORMAT.HEX(0.,&val_0),"_"," : xadm_fc_cnsmd_npd: Level: Credit Consumed (ND) VCn"
&mask_0 = 0xff
&val_0 = ((Data.Long(A:&cdm_ras_des_sd_info_v000+0x4)&(&mask_0))>>8.)
IF (&val_0!=0.)
    PRINT "[cdm_ras_des_sd_info_v000:0x50c] V:",FORMAT.HEX(0.,&val_0),"_"," : xadm_fc_cnsmd_cplh: Level: Credit Consumed (CH) VCn"
&mask_0 = 0xfff
&val_0 = ((Data.Long(A:&cdm_ras_des_sd_info_v000+0x4)&(&mask_0))>>16.)
IF (&val_0!=0.)
    PRINT "[cdm_ras_des_sd_info_v000:0x50c] V:",FORMAT.HEX(0.,&val_0),"_"," : xadm_fc_cnsmd_cpld: Level: Credit Consumed (CD) VCn"
&mask_0 = 0xf
&val_0 = ((Data.Long(A:&cdm_ras_des_sd_info_v000+0x4)&(&mask_0))>>28.)
IF (&val_0!=0.)
    PRINT "[cdm_ras_des_sd_info_v000:0x50c] V:",FORMAT.HEX(0.,&val_0),"_"," : xadm_fc_limit_ph: Level: Credit Limit (PH) VCn"
&mask_0 = 0xf
&val_0 = ((Data.Long(A:&cdm_ras_des_sd_info_v000+0x8)&(&mask_0))>>0.)
IF (&val_0!=0.)
    PRINT "[cdm_ras_des_sd_info_v000:0x510] V:",FORMAT.HEX(0.,&val_0),"_"," : xadm_fc_limit_ph: Level: Credit Limit (PH) VCn"
&mask_0 = 0xfff
&val_0 = ((Data.Long(A:&cdm_ras_des_sd_info_v000+0x8)&(&mask_0))>>4.)
IF (&val_0!=0.)
    PRINT "[cdm_ras_des_sd_info_v000:0x510] V:",FORMAT.HEX(0.,&val_0),"_"," : xadm_fc_limit_pd: Level: Credit Limit (PD) VCn"
&mask_0 = 0xff
&val_0 = ((Data.Long(A:&cdm_ras_des_sd_info_v000+0x8)&(&mask_0))>>16.)
IF (&val_0!=0.)
    PRINT "[cdm_ras_des_sd_info_v000:0x510] V:",FORMAT.HEX(0.,&val_0),"_"," : xadm_fc_limit_nph: Level: Credit Limit (NH) VCn"
&mask_0 = 0xff
&val_0 = ((Data.Long(A:&cdm_ras_des_sd_info_v000+0x8)&(&mask_0))>>24.)
IF (&val_0!=0.)
    PRINT "[cdm_ras_des_sd_info_v000:0x510] V:",FORMAT.HEX(0.,&val_0),"_"," : xadm_fc_limit_npd: Level: Credit Limit (ND) VCn"
&mask_0 = 0xf
&val_0 = ((Data.Long(A:&cdm_ras_des_sd_info_v000+0xc)&(&mask_0))>>0.)
IF (&val_0!=0.)
    PRINT "[cdm_ras_des_sd_info_v000:0x514] V:",FORMAT.HEX(0.,&val_0),"_"," : xadm_fc_limit_npd: Level: Credit Limit (ND) VCn"
&mask_0 = 0xff
&val_0 = ((Data.Long(A:&cdm_ras_des_sd_info_v000+0xc)&(&mask_0))>>4.)
IF (&val_0!=0.)
    PRINT "[cdm_ras_des_sd_info_v000:0x514] V:",FORMAT.HEX(0.,&val_0),"_"," : xadm_fc_limit_cplh: Level: Credit Limit (CH) VCn"
&mask_0 = 0xfff
&val_0 = ((Data.Long(A:&cdm_ras_des_sd_info_v000+0xc)&(&mask_0))>>12.)
IF (&val_0!=0.)
    PRINT "[cdm_ras_des_sd_info_v000:0x514] V:",FORMAT.HEX(0.,&val_0),"_"," : xadm_fc_limit_cpld: Level: Credit Limit (CD) VCn"
&mask_0 = 0xff
&val_0 = ((Data.Long(A:&cdm_ras_des_sd_info_v000+0xc)&(&mask_0))>>24.)
IF (&val_0!=0.)
    PRINT "[cdm_ras_des_sd_info_v000:0x514] V:",FORMAT.HEX(0.,&val_0),"_"," : rtlh_fc_rcvd_ph: Level: Credit Received (PH) VCn"
&mask_0 = 0xfff
&val_0 = ((Data.Long(A:&cdm_ras_des_sd_info_v000+0x10)&(&mask_0))>>0.)
IF (&val_0!=0.)
    PRINT "[cdm_ras_des_sd_info_v000:0x518] V:",FORMAT.HEX(0.,&val_0),"_"," : rtlh_fc_rcvd_pd: Level: Credit Received (PD) VCn"
&mask_0 = 0xff
&val_0 = ((Data.Long(A:&cdm_ras_des_sd_info_v000+0x10)&(&mask_0))>>12.)
IF (&val_0!=0.)
    PRINT "[cdm_ras_des_sd_info_v000:0x518] V:",FORMAT.HEX(0.,&val_0),"_"," : rtlh_fc_rcvd_nph: Level: Credit Received (NH) VCn"
&mask_0 = 0xfff
&val_0 = ((Data.Long(A:&cdm_ras_des_sd_info_v000+0x10)&(&mask_0))>>20.)
IF (&val_0!=0.)
    PRINT "[cdm_ras_des_sd_info_v000:0x518] V:",FORMAT.HEX(0.,&val_0),"_"," : rtlh_fc_rcvd_npd: Level: Credit Received (ND) VCn"
&mask_0 = 0xff
&val_0 = ((Data.Long(A:&cdm_ras_des_sd_info_v000+0x14)&(&mask_0))>>0.)
IF (&val_0!=0.)
    PRINT "[cdm_ras_des_sd_info_v000:0x51c] V:",FORMAT.HEX(0.,&val_0),"_"," : rtlh_fc_rcvd_cplh: Level: Credit Received (CH) VCn"
&mask_0 = 0xfff
&val_0 = ((Data.Long(A:&cdm_ras_des_sd_info_v000+0x14)&(&mask_0))>>8.)
IF (&val_0!=0.)
    PRINT "[cdm_ras_des_sd_info_v000:0x51c] V:",FORMAT.HEX(0.,&val_0),"_"," : rtlh_fc_rcvd_cpld: Level: Credit Received (CD) VCn"
&mask_0 = 0xff
&val_0 = ((Data.Long(A:&cdm_ras_des_sd_info_v000+0x14)&(&mask_0))>>20.)
IF (&val_0!=0.)
    PRINT "[cdm_ras_des_sd_info_v000:0x51c] V:",FORMAT.HEX(0.,&val_0),"_"," : rtlh_fc_allctd_ph: Level: Credit Allocated (PH) VCn"
&mask_0 = 0xf
&val_0 = ((Data.Long(A:&cdm_ras_des_sd_info_v000+0x14)&(&mask_0))>>28.)
IF (&val_0!=0.)
    PRINT "[cdm_ras_des_sd_info_v000:0x51c] V:",FORMAT.HEX(0.,&val_0),"_"," : rtlh_fc_allctd_pd: Level: Credit Allocated (PD) VCn"
&mask_0 = 0xff
&val_0 = ((Data.Long(A:&cdm_ras_des_sd_info_v000+0x18)&(&mask_0))>>0.)
IF (&val_0!=0.)
    PRINT "[cdm_ras_des_sd_info_v000:0x520] V:",FORMAT.HEX(0.,&val_0),"_"," : rtlh_fc_allctd_pd: Level: Credit Allocated (PD) VCn"
&mask_0 = 0xff
&val_0 = ((Data.Long(A:&cdm_ras_des_sd_info_v000+0x18)&(&mask_0))>>8.)
IF (&val_0!=0.)
    PRINT "[cdm_ras_des_sd_info_v000:0x520] V:",FORMAT.HEX(0.,&val_0),"_"," : rtlh_fc_allctd_nph: Level: Credit Allocated (NH) VCn"
&mask_0 = 0xfff
&val_0 = ((Data.Long(A:&cdm_ras_des_sd_info_v000+0x18)&(&mask_0))>>16.)
IF (&val_0!=0.)
    PRINT "[cdm_ras_des_sd_info_v000:0x520] V:",FORMAT.HEX(0.,&val_0),"_"," : rtlh_fc_allctd_npd: Level: Credit Allocated (ND) VCn "
&mask_0 = 0xf
&val_0 = ((Data.Long(A:&cdm_ras_des_sd_info_v000+0x18)&(&mask_0))>>28.)
IF (&val_0!=0.)
    PRINT "[cdm_ras_des_sd_info_v000:0x520] V:",FORMAT.HEX(0.,&val_0),"_"," : rtlh_fc_allctd_cplh: Level: Credit Allocated (CH) VCn "
&mask_0 = 0xf
&val_0 = ((Data.Long(A:&cdm_ras_des_sd_info_v000+0x1c)&(&mask_0))>>0.)
IF (&val_0!=0.)
    PRINT "[cdm_ras_des_sd_info_v000:0x524] V:",FORMAT.HEX(0.,&val_0),"_"," : rtlh_fc_allctd_npd: Level: Credit Allocated (CH) VCn"
&mask_0 = 0xfff
&val_0 = ((Data.Long(A:&cdm_ras_des_sd_info_v000+0x1c)&(&mask_0))>>4.)
IF (&val_0!=0.)
    PRINT "[cdm_ras_des_sd_info_v000:0x524] V:",FORMAT.HEX(0.,&val_0),"_"," : rtlh_fc_allctd_cpld: Level: Credit Allocated (CD) VCn"

;=================================================================================================
; Register:acc_ras_tba_com_ro00, Member: ['cdm_ras_des_tba_info_common', 'RESERVED_7']
;=================================================================================================
&cdm_ras_des_tba_info_common = 0xC1000000+0x578
&mask = 0x1
&val  = ((Data.Long(A:&cdm_ras_des_tba_info_common)&(&mask))>>0.)
IF &val!=0.
    PRINT "[cdm_ras_des_tba_info_common:0x578] V:", &val, " : smlh_in_l0s: Tx L0s"
&mask = 0x2
&val  = ((Data.Long(A:&cdm_ras_des_tba_info_common)&(&mask))>>1.)
IF &val!=0.
    PRINT "[cdm_ras_des_tba_info_common:0x578] V:", &val, " : smlh_in_rl0s: Rx L0s"
&mask = 0x4
&val  = ((Data.Long(A:&cdm_ras_des_tba_info_common)&(&mask))>>2.)
IF &val!=0.
    PRINT "[cdm_ras_des_tba_info_common:0x578] V:", &val, " : smlh_in_l0: L0"
&mask = 0x8
&val  = ((Data.Long(A:&cdm_ras_des_tba_info_common)&(&mask))>>3.)
IF &val!=0.
    PRINT "[cdm_ras_des_tba_info_common:0x578] V:", &val, " : smlh_in_l1: L1"
&mask = 0x10
&val  = ((Data.Long(A:&cdm_ras_des_tba_info_common)&(&mask))>>4.)
IF &val!=0.
    PRINT "[cdm_ras_des_tba_info_common:0x578] V:", &val, " : pm_in_l11: L1.1"
&mask = 0x20
&val  = ((Data.Long(A:&cdm_ras_des_tba_info_common)&(&mask))>>5.)
IF &val!=0.
    PRINT "[cdm_ras_des_tba_info_common:0x578] V:", &val, " : pm_in_l12: L1.2"
&mask = 0x40
&val  = ((Data.Long(A:&cdm_ras_des_tba_info_common)&(&mask))>>6.)
IF &val!=0.
    PRINT "[cdm_ras_des_tba_info_common:0x578] V:", &val, " : smlh_link_in_training: Config/Recovery"

